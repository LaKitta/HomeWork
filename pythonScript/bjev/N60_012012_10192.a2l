/begin MEASUREMENT LuSOC_EEInChgFullLast_flg "初始化上次充电结束状态" UBYTE NO_COMPU_METHOD 0 0 0 1 ECU_ADDRESS 0x7000d109 FORMAT "%.15" /end MEASUREMENT
/begin MEASUREMENT LuSOC_EEInBattDchCVLim_enum "初始化上次放电阶段状态" UBYTE NO_COMPU_METHOD 0 0 0 1 ECU_ADDRESS 0x7000d107 FORMAT "%.15" /end MEASUREMENT
/begin MEASUREMENT LuSOC_EEInBattDisChrgDnOff_flg "初始化上次放电降功率状态" UBYTE NO_COMPU_METHOD 0 0 0 1 ECU_ADDRESS 0x7000d108 FORMAT "%.15" /end MEASUREMENT
/begin MEASUREMENT LuSOC_EEInStatOCVDiffCV_enum "初始化静态一致性修正系数" UWORD NO_COMPU_METHOD 0 0 0 1 ECU_ADDRESS 0x7000cdbc FORMAT "%.15" /end MEASUREMENT
/begin MEASUREMENT LuSOC_EEInChgDiffCV_enum "初始化充电一致性修正系数" UWORD NO_COMPU_METHOD 0 0 0 1 ECU_ADDRESS 0x7000cdb4 FORMAT "%.15" /end MEASUREMENT
/begin MEASUREMENT LuSOC_EEInBattChgEnLast_enum "初始化上次下电状态(充电或行车)" UBYTE NO_COMPU_METHOD 0 0 0 1 ECU_ADDRESS 0x7000d106 FORMAT "%.15" /end MEASUREMENT
/begin MEASUREMENT LuSOC_EEInfacChgFullDiff_enum "初始化充电电流容量修正系数" UWORD NO_COMPU_METHOD 0 0 0 1 ECU_ADDRESS 0x7000cdc2 FORMAT "%.15" /end MEASUREMENT
/begin MEASUREMENT LuSOC_EEInCheckCode_enum "初始化CheckCode" UWORD NO_COMPU_METHOD 0 0 0 1 ECU_ADDRESS 0x7000cdb2 FORMAT "%.15" /end MEASUREMENT
/begin MEASUREMENT LuSOC_EEInSOCTempMax_pct "初始化当前温度上限SOC" UWORD NO_COMPU_METHOD 0 0 0 1 ECU_ADDRESS 0x7000cdb8 FORMAT "%.15" /end MEASUREMENT
/begin MEASUREMENT LuSOC_EEInSOCTempMin_pct "初始化当前温度下限SOC" UWORD NO_COMPU_METHOD 0 0 0 1 ECU_ADDRESS 0x7000cdba FORMAT "%.15" /end MEASUREMENT
/begin MEASUREMENT LuSOC_EEInfacTempCp_enum "初始化温度容量修正系数" UWORD NO_COMPU_METHOD 0 0 0 1 ECU_ADDRESS 0x7000cdc6 FORMAT "%.15" /end MEASUREMENT
/begin MEASUREMENT LeSOC_EepromErr_enum "EE故障标志位" UBYTE NO_COMPU_METHOD 0 0 0 1 ECU_ADDRESS 0x7000d0f9 FORMAT "%.15" /end MEASUREMENT
/begin MEASUREMENT LuSOC_EEInpActSOC_pct "EE读取的真实SOC" UWORD NO_COMPU_METHOD 0 0 0 1 ECU_ADDRESS 0x7000cdc8 FORMAT "%.15" /end MEASUREMENT
/begin MEASUREMENT LlSOC_EEInpAvlbCpAct_Ah "EE读取的真实可用容量" ULONG NO_COMPU_METHOD 0 0 0 1 ECU_ADDRESS 0x7000c77c FORMAT "%.15" /end MEASUREMENT
/begin MEASUREMENT LuSOC_EEInpDispSOC_pct "EE读取的显示SOC" UWORD NO_COMPU_METHOD 0 0 0 1 ECU_ADDRESS 0x7000ced2 FORMAT "%.15" /end MEASUREMENT
/begin MEASUREMENT LlSOC_EEInpBattAvlbCp_Ah "EE读取的显示可用容量" ULONG NO_COMPU_METHOD 0 0 0 1 ECU_ADDRESS 0x7000c780 FORMAT "%.15" /end MEASUREMENT
/begin MEASUREMENT LlSOC_EEInpBattRatedCp_Ah "EE读取的显示额定容量" ULONG NO_COMPU_METHOD 0 0 0 1 ECU_ADDRESS 0x7000c788 FORMAT "%.15" /end MEASUREMENT
/begin MEASUREMENT LlSOC_EEInpBattChgRatedCp_Ah "EE读取的显示充电额定容量" ULONG NO_COMPU_METHOD 0 0 0 1 ECU_ADDRESS 0x7000c784 FORMAT "%.15" /end MEASUREMENT
/begin MEASUREMENT LuSOC_EEInpfacBattDiff_enum "EE读取的一致性容量修正系数" UWORD NO_COMPU_METHOD 0 0 0 1 ECU_ADDRESS 0x7000cedc FORMAT "%.15" /end MEASUREMENT
/begin MEASUREMENT LuSOC_EEInpfacDchOCV_enum "EE读取的放电OCV修正系数" UWORD NO_COMPU_METHOD 0 0 0 1 ECU_ADDRESS 0x7000cee0 FORMAT "%.15" /end MEASUREMENT
/begin MEASUREMENT LuSOC_EEInpfacBattDchDiff_enum "EE读取的放电一致性修正系数" UWORD NO_COMPU_METHOD 0 0 0 1 ECU_ADDRESS 0x7000ceda FORMAT "%.15" /end MEASUREMENT
/begin MEASUREMENT LuSOC_EEInpChgFullLast_flg "EE读取的上次充电结束状态" UBYTE NO_COMPU_METHOD 0 0 0 1 ECU_ADDRESS 0x7000d10d FORMAT "%.15" /end MEASUREMENT
/begin MEASUREMENT LuSOC_EEInpBattDchCVLim_enum "EE读取的上次放电阶段状态" UBYTE NO_COMPU_METHOD 0 0 0 1 ECU_ADDRESS 0x7000d10b FORMAT "%.15" /end MEASUREMENT
/begin MEASUREMENT LuSOC_EEInpBattDisChrgDnOff_flg "EE读取的上次放电降功率状态" UBYTE NO_COMPU_METHOD 0 0 0 1 ECU_ADDRESS 0x7000d10c FORMAT "%.15" /end MEASUREMENT
/begin MEASUREMENT LuSOC_EEInpStatOCVDiffCV_enum "EE读取的静态一致性修正系数" UWORD NO_COMPU_METHOD 0 0 0 1 ECU_ADDRESS 0x7000ced8 FORMAT "%.15" /end MEASUREMENT
/begin MEASUREMENT LuSOC_EEInpChgDiffCV_enum "EE读取的充电一致性修正系数" UWORD NO_COMPU_METHOD 0 0 0 1 ECU_ADDRESS 0x7000ced0 FORMAT "%.15" /end MEASUREMENT
/begin MEASUREMENT LuSOC_EEInpBattChgEnLast_enum "EE读取的上次下电状态(充电或行车)" UBYTE NO_COMPU_METHOD 0 0 0 1 ECU_ADDRESS 0x7000d10a FORMAT "%.15" /end MEASUREMENT
/begin MEASUREMENT LuSOC_EEInpfacChgFullDiff_enum "EE读取的充电电流容量修正系数" UWORD NO_COMPU_METHOD 0 0 0 1 ECU_ADDRESS 0x7000cede FORMAT "%.15" /end MEASUREMENT
/begin MEASUREMENT LuSOC_EEInpCheckCode_enum "EE读取的CheckCode" UWORD NO_COMPU_METHOD 0 0 0 1 ECU_ADDRESS 0x7000cece FORMAT "%.15" /end MEASUREMENT
/begin MEASUREMENT LuSOC_EEInpSOCTempMax_pct "EE读取的当前温度上限SOC" UWORD NO_COMPU_METHOD 0 0 0 1 ECU_ADDRESS 0x7000ced4 FORMAT "%.15" /end MEASUREMENT
/begin MEASUREMENT LuSOC_EEInpSOCTempMin_pct "EE读取的当前温度下限SOC" UWORD NO_COMPU_METHOD 0 0 0 1 ECU_ADDRESS 0x7000ced6 FORMAT "%.15" /end MEASUREMENT
/begin MEASUREMENT LuSOC_EEInpfacTempCp_enum "EE读取的温度容量修正系数" UWORD NO_COMPU_METHOD 0 0 0 1 ECU_ADDRESS 0x7000cee2 FORMAT "%.15" /end MEASUREMENT
/begin MEASUREMENT LeSOC_TempMaxRaw_degC "单体电芯最高温度CCP" UBYTE NO_COMPU_METHOD 0 0 0 1 ECU_ADDRESS 0x7000d0fe FORMAT "%.15" /end MEASUREMENT
/begin MEASUREMENT LbSOC_TempMaxErr_flg "SOC最高温度异常标志位" UBYTE NO_COMPU_METHOD 0 0 0 1 ECU_ADDRESS 0x7000d006 FORMAT "%.15" /end MEASUREMENT
/begin MEASUREMENT LeSOC_TempMax_degC "SOC最高温度" UBYTE NO_COMPU_METHOD 0 0 0 1 ECU_ADDRESS 0x7000d0ff FORMAT "%.15" /end MEASUREMENT
/begin MEASUREMENT LeSOC_TempMinRaw_degC "单体电芯最低温度CCP" UBYTE NO_COMPU_METHOD 0 0 0 1 ECU_ADDRESS 0x7000d100 FORMAT "%.15" /end MEASUREMENT
