/* @@@@ File written by CANAPE_VERSION 13 0 0 @@@@ */ ASAP2_VERSION 1 61
/begin PROJECT C33_1125 ""
/begin MODULE CPP ""
/begin MOD_COMMON "" BYTE_ORDER MSB_FIRST ALIGNMENT_BYTE 1 ALIGNMENT_WORD 2 ALIGNMENT_LONG 4 ALIGNMENT_INT64 8 ALIGNMENT_FLOAT32_IEEE 4 ALIGNMENT_FLOAT64_IEEE 8 /end MOD_COMMON
/begin MOD_PAR "" /end MOD_PAR
/begin MEASUREMENT VbFTD_CellVoltUnbaErr_flg "电池单体不均衡预警标志位" UBYTE NO_COMPU_METHOD 0 0 0 1 ECU_ADDRESS 0x70014a72 FORMAT "%.15" /end MEASUREMENT
/begin MEASUREMENT VbFTD_CellVoltUnbaFilterErrL2_flg "  电池单体不均衡故障标志位" UBYTE NO_COMPU_METHOD 0 0 0 1 ECU_ADDRESS 0x70014a73 FORMAT "%.15" /end MEASUREMENT
/begin MEASUREMENT LsCTM_BMUMinTemp_deg "单体最低温度" SWORD NO_COMPU_METHOD 0 0 0 1 ECU_ADDRESS 0x70003c19 FORMAT "%.15" /end MEASUREMENT
/begin MEASUREMENT LsBTM_BMUMinTemp_deg "单体最低温度1" SWORD NO_COMPU_METHOD 0 0 0 1 ECU_ADDRESS 0x70002b65 FORMAT "%.15" /end MEASUREMENT
/begin MEASUREMENT LsBTM_BMUMaxTemp_deg "单体最高温度1" SWORD NO_COMPU_METHOD 0 0 0 1 ECU_ADDRESS 0x70002b64 FORMAT "%.15" /end MEASUREMENT
/begin MEASUREMENT VuSOC_ActSOCPre_pct "OCV预估SOC" UWORD NO_COMPU_METHOD 0 0 0 1 ECU_ADDRESS 0x7001460a FORMAT "%.15" /end MEASUREMENT
/begin MEASUREMENT LuSOC_StatOCVDiffCV_enum "静态压差一致性系数" UWORD NO_COMPU_METHOD 0 0 0 1 ECU_ADDRESS 0x70013b56 FORMAT "%.15" /end MEASUREMENT
/begin MEASUREMENT LuSOC_ChgDiffCV_enum "充电压差一致性系数" UWORD NO_COMPU_METHOD 0 0 0 1 ECU_ADDRESS 0x70013b54 FORMAT "%.15" /end MEASUREMENT
/begin MEASUREMENT VbFTD_BMUCANErr_flg "子板通讯丢失故障数组" UBYTE NO_COMPU_METHOD 0 0 0 1 ECU_ADDRESS 0x70014a5f FORMAT "%.15" /end MEASUREMENT
/begin MEASUREMENT VlSOC_BattActDisChgCp_Ah "实际放电安时" ULONG NO_COMPU_METHOD 0 0 0 1 ECU_ADDRESS 0x70013dac FORMAT "%.15" /end MEASUREMENT
/begin MEASUREMENT VlSOC_BattActChgCp_Ah "实际充电安时" ULONG NO_COMPU_METHOD 0 0 0 1 ECU_ADDRESS 0x70013da6 FORMAT "%.15" /end MEASUREMENT
/begin MEASUREMENT VlSOC_BattChgRatedCp_Ah "充电额定容量" ULONG NO_COMPU_METHOD 0 0 0 1 ECU_ADDRESS 0x70013dc0 FORMAT "%.15" /end MEASUREMENT
/begin MEASUREMENT VlSOC_BattRatedCp_Ah "额定容量" ULONG NO_COMPU_METHOD 0 0 0 1 ECU_ADDRESS 0x70013dca FORMAT "%.15" /end MEASUREMENT
/begin MEASUREMENT VeTEMP_P1MaxTempNum_enum "电池包1最高温度编号" UBYTE NO_COMPU_METHOD 0 0 0 1 ECU_ADDRESS 0x70014b86 FORMAT "%.15" /end MEASUREMENT
/begin MEASUREMENT VeTEMP_P1MinTempNum_enum "电池包1最低温度编号" UBYTE NO_COMPU_METHOD 0 0 0 1 ECU_ADDRESS 0x70014b87 FORMAT "%.15" /end MEASUREMENT
/begin MEASUREMENT VsTEMP_PTCMaxTemp_deg "PTC温度采集点最高温度" UBYTE NO_COMPU_METHOD 0 0 0 1 ECU_ADDRESS 0x70014da5 FORMAT "%.15" /end MEASUREMENT
/begin MEASUREMENT VsTEMP_PTCMinTemp_deg "PTC温度采集点最低温度" UBYTE NO_COMPU_METHOD 0 0 0 1 ECU_ADDRESS 0x70014da6 FORMAT "%.15" /end MEASUREMENT
/begin MEASUREMENT VsTEMP_PTCAveTemp_deg "PTC平均温度" UBYTE NO_COMPU_METHOD 0 0 0 1 ECU_ADDRESS 0x70014da4 FORMAT "%.15" /end MEASUREMENT
/begin MEASUREMENT VeBATST_BMUMinCellVltNum_enum "单体电芯最低电压编号" UBYTE NO_COMPU_METHOD 0 0 0 1 ECU_ADDRESS 0x70014ac8 FORMAT "%.15" /end MEASUREMENT
/begin MEASUREMENT LslSOC_BattSysI_A "系统电流" SLONG NO_COMPU_METHOD 0 0 0 1 ECU_ADDRESS 0x7000c7c6 FORMAT "%.15" /end MEASUREMENT
/begin MEASUREMENT VePWRCTL_PwrDwnStep_enum "降功率阶段标志位" UBYTE NO_COMPU_METHOD 0 0 0 1 ECU_ADDRESS 0x70014b6b FORMAT "%.15" /end MEASUREMENT
/begin MEASUREMENT VuBATST_OriBMUMaxCellVlt_mv "原始系统最高单体电压" UWORD NO_COMPU_METHOD 0 0 0 1 ECU_ADDRESS 0x700145be FORMAT "%.15" /end MEASUREMENT
/begin MEASUREMENT VuBATST_OriBMUMinCellVlt_mv "原始系统最低单体电压" UWORD NO_COMPU_METHOD 0 0 0 1 ECU_ADDRESS 0x700145c0 FORMAT "%.15" /end MEASUREMENT
/begin MEASUREMENT VuBATST_OriBMUSecMaxCellVlt_mv "原始系统次高单体电压" UWORD NO_COMPU_METHOD 0 0 0 1 ECU_ADDRESS 0x700145c2 FORMAT "%.15" /end MEASUREMENT
/begin MEASUREMENT VuBATST_OriBMUSecMinCellVlt_mv "原始系统次高单体电压" UWORD NO_COMPU_METHOD 0 0 0 1 ECU_ADDRESS 0x700145c4 FORMAT "%.15" /end MEASUREMENT
/begin MEASUREMENT VeBATST_OriBMUMaxVltNum_enum "原始最大单体电压编号" UBYTE NO_COMPU_METHOD 0 0 0 1 ECU_ADDRESS 0x70013b62 FORMAT "%.15" /end MEASUREMENT
/begin MEASUREMENT VeBATST_OriBMUMinVltNum_enum "原始最小单体电压编号" UBYTE NO_COMPU_METHOD 0 0 0 1 ECU_ADDRESS 0x70013b64 FORMAT "%.15" /end MEASUREMENT
/begin MEASUREMENT VlCRTINT_DischrgAhIntg_Ah "空" ULONG NO_COMPU_METHOD 0 0 0 1 ECU_ADDRESS 0x70013d5c FORMAT "%.15" /end MEASUREMENT
/begin MEASUREMENT VlCRTINT_ChrgAhIntg_Ah "空" ULONG NO_COMPU_METHOD 0 0 0 1 ECU_ADDRESS 0x70013d54 FORMAT "%.15" /end MEASUREMENT
/begin MEASUREMENT VlCRTINT_DischrgAhIntgODO_Ah "空" ULONG NO_COMPU_METHOD 0 0 0 1 ECU_ADDRESS 0x70013d58 FORMAT "%.15" /end MEASUREMENT
/begin MEASUREMENT VlCRTINT_ChrgAhIntgODO_Ah "空" ULONG NO_COMPU_METHOD 0 0 0 1 ECU_ADDRESS 0x70013d50 FORMAT "%.15" /end MEASUREMENT
/begin MEASUREMENT LuSOC_facBattCmltCp_enum "空" UWORD NO_COMPU_METHOD 0 0 0 1 ECU_ADDRESS 0x70013b58 FORMAT "%.15" /end MEASUREMENT
/begin MEASUREMENT LlSOC_BattStandgTi_min "空" ULONG NO_COMPU_METHOD 0 0 0 1 ECU_ADDRESS 0x7000c740 FORMAT "%.15" /end MEASUREMENT
/begin MEASUREMENT LuSOC_facBattTempCp_enum "空" UWORD NO_COMPU_METHOD 0 0 0 1 ECU_ADDRESS 0x70013b5a FORMAT "%.15" /end MEASUREMENT
/begin MEASUREMENT VuBATST_BMUCellVltDiff_mv "单体电芯电压极差" UWORD NO_COMPU_METHOD 0 0 0 1 ECU_ADDRESS 0x70013e38 FORMAT "%.15" /end MEASUREMENT
/begin MEASUREMENT LeSOC_BattChgStg_enum "空" UBYTE NO_COMPU_METHOD 0 0 0 1 ECU_ADDRESS 0x7000d0ea FORMAT "%.15" /end MEASUREMENT
/begin MEASUREMENT LeSOC_BattFchStg_enum "空" UBYTE NO_COMPU_METHOD 0 0 0 1 ECU_ADDRESS 0x7000d0ec FORMAT "%.15" /end MEASUREMENT
/begin MEASUREMENT LbSOC_BattChgFull_flg "空" UBYTE NO_COMPU_METHOD 0 0 0 1 ECU_ADDRESS 0x7000cfbc FORMAT "%.15" /end MEASUREMENT
/begin MEASUREMENT BMSIN_MLIF_Rly1Ans_enum "正极继电器应答指令信号" UBYTE NO_COMPU_METHOD 0 0 0 1 ECU_ADDRESS 0x70014877 FORMAT "%.15" /end MEASUREMENT
/begin MEASUREMENT BMSIN_MLIF_Rly1Cmd_enum "正极继电器响应控制指令信号" UBYTE NO_COMPU_METHOD 0 0 0 1 ECU_ADDRESS 0x70014878 FORMAT "%.15" /end MEASUREMENT
/begin MEASUREMENT VbCTCTR_BatteryErrPrectDbSt_enum "动力电池二级保护故障标志" UBYTE NO_COMPU_METHOD 0 0 0 1 ECU_ADDRESS 0x700038e2 FORMAT "%.15" /end MEASUREMENT
/begin MEASUREMENT BMSIN_MLIF_Rly1Req_enum "正极继电器请求指令信号" UBYTE NO_COMPU_METHOD 0 0 0 1 ECU_ADDRESS 0x70014879 FORMAT "%.15" /end MEASUREMENT
/begin MEASUREMENT LlCRTINT_MemChrgAhODO_Ah "初始EEPROM历史累计充电总安时" ULONG NO_COMPU_METHOD 0 0 0 1 ECU_ADDRESS 0x700036d4 FORMAT "%.15" /end MEASUREMENT
/begin MEASUREMENT LlCRTINT_MemDischrgAhODO_Ah "初始EEPROM历史累计放电总安时" ULONG NO_COMPU_METHOD 0 0 0 1 ECU_ADDRESS 0x700036d8 FORMAT "%.15" /end MEASUREMENT
/begin MEASUREMENT LbSOC_FirstMsgRcv_flg "空" UBYTE NO_COMPU_METHOD 0 0 0 1 ECU_ADDRESS 0x7000cfe5 FORMAT "%.15" /end MEASUREMENT
/begin MEASUREMENT LeSOC_BattE2Err_enum "空" UBYTE NO_COMPU_METHOD 0 0 0 1 ECU_ADDRESS 0x7000d0eb FORMAT "%.15" /end MEASUREMENT
/begin MEASUREMENT VuBATST_P1MaxCellVlt_mv "电池包1单体电芯最大电压" UWORD NO_COMPU_METHOD 0 0 0 1 ECU_ADDRESS 0x700145c6 FORMAT "%.15" /end MEASUREMENT
/begin MEASUREMENT VuBATST_P1MinCellVlt_mv "电池包1单体电芯最小电压" UWORD NO_COMPU_METHOD 0 0 0 1 ECU_ADDRESS 0x700145c8 FORMAT "%.15" /end MEASUREMENT
/begin MEASUREMENT VeBATST_P1MaxCellVltNum_enum "电池包1单体电芯最大电压编号" UBYTE NO_COMPU_METHOD 0 0 0 1 ECU_ADDRESS 0x70013b6c FORMAT "%.15" /end MEASUREMENT
/begin MEASUREMENT VeBATST_P1MinCellVltNum_enum "电池包1单体电芯最小电压编号" UBYTE NO_COMPU_METHOD 0 0 0 1 ECU_ADDRESS 0x70013b6e FORMAT "%.15" /end MEASUREMENT
/begin MEASUREMENT VeFTD_LinkRErrNm2EE_enum "铜排松动所在电芯编号2" UBYTE NO_COMPU_METHOD 0 0 0 1 ECU_ADDRESS 0x70014b4b FORMAT "%.15" /end MEASUREMENT
/begin MEASUREMENT VlSOC_AvlbCpFull_Ah "电池目标可用容量" ULONG NO_COMPU_METHOD 0 0 0 1 ECU_ADDRESS 0x70013da0 FORMAT "%.15" /end MEASUREMENT
/begin MEASUREMENT VbFTD_BMU1CANErr_flg "子板1内部通讯丢失标志位" UBYTE NO_COMPU_METHOD 0 0 0 1 ECU_ADDRESS 0x70007e93 FORMAT "%.15" /end MEASUREMENT
/begin MEASUREMENT VbFTD_BMU2CANErr_flg "子板2内部通讯丢失标志位" UBYTE NO_COMPU_METHOD 0 0 0 1 ECU_ADDRESS 0x70007e94 FORMAT "%.15" /end MEASUREMENT
/begin MEASUREMENT VbFTD_BMU3CANErr_flg "子板3内部通讯丢失标志位" UBYTE NO_COMPU_METHOD 0 0 0 1 ECU_ADDRESS 0x70007e95 FORMAT "%.15" /end MEASUREMENT
/begin MEASUREMENT VbFTD_BMU4CANErr_flg "子板4内部通讯丢失标志位" UBYTE NO_COMPU_METHOD 0 0 0 1 ECU_ADDRESS 0x70007e96 FORMAT "%.15" /end MEASUREMENT
/begin MEASUREMENT VbFTD_BMU5CANErr_flg "子板5内部通讯丢失标志位" UBYTE NO_COMPU_METHOD 0 0 0 1 ECU_ADDRESS 0x70007e97 FORMAT "%.15" /end MEASUREMENT
/begin MEASUREMENT VbFTD_BMU6CANErr_flg "子板6内部通讯丢失标志位" UBYTE NO_COMPU_METHOD 0 0 0 1 ECU_ADDRESS 0x70007e98 FORMAT "%.15" /end MEASUREMENT
/begin MEASUREMENT VbFTD_BMU7CANErr_flg "子板7内部通讯丢失标志位" UBYTE NO_COMPU_METHOD 0 0 0 1 ECU_ADDRESS 0x70007e99 FORMAT "%.15" /end MEASUREMENT
/begin MEASUREMENT VbFTD_BMU8CANErr_flg "子板8内部通讯丢失标志位" UBYTE NO_COMPU_METHOD 0 0 0 1 ECU_ADDRESS 0x70007e9a FORMAT "%.15" /end MEASUREMENT
/begin MEASUREMENT VbFTD_BMU9CANErr_flg "子板9内部通讯丢失标志位" UBYTE NO_COMPU_METHOD 0 0 0 1 ECU_ADDRESS 0x70007e9b FORMAT "%.15" /end MEASUREMENT
/begin MEASUREMENT VbFTD_BMU10CANErr_flg "子板10内部通讯丢失标志位" UBYTE NO_COMPU_METHOD 0 0 0 1 ECU_ADDRESS 0x70007e92 FORMAT "%.15" /end MEASUREMENT
/begin MEASUREMENT VbCTM_ChgIErr_flg "慢充电流异常标志位" UBYTE NO_COMPU_METHOD 0 0 0 1 ECU_ADDRESS 0x70014a27 FORMAT "%.15" /end MEASUREMENT
/begin MEASUREMENT VbCTM_ACTempHi_flg "交流插座过温故障" UBYTE NO_COMPU_METHOD 0 0 0 1 ECU_ADDRESS 0x70014a22 FORMAT "%.15" /end MEASUREMENT
/begin MEASUREMENT VbCTM_ChgCanErr_flg "充电机通讯故障" UBYTE NO_COMPU_METHOD 0 0 0 1 ECU_ADDRESS 0x70014a25 FORMAT "%.15" /end MEASUREMENT
/begin MEASUREMENT VbCEL_CMULost_flg "CMU通讯故障" UBYTE NO_COMPU_METHOD 0 0 0 1 ECU_ADDRESS 0x70014a06 FORMAT "%.15" /end MEASUREMENT
/begin MEASUREMENT LbPBL_InnerCANErrArray_flg "杨跃武20171012" UBYTE NO_COMPU_METHOD 0 0 0 1 ECU_ADDRESS 0x7000982b FORMAT "%.15" /end MEASUREMENT
/begin MEASUREMENT LuPBL_OriBMUMinCellVlt_mv "杨跃武20171012_2" UWORD NO_COMPU_METHOD 0 0 0 1 ECU_ADDRESS 0x70009432 FORMAT "%.15" /end MEASUREMENT
/begin MEASUREMENT LuPBL_OriBMUMaxCellVlt_mv "杨跃武20171012_3" UWORD NO_COMPU_METHOD 0 0 0 1 ECU_ADDRESS 0x70009430 FORMAT "%.15" /end MEASUREMENT
/begin MEASUREMENT VeCTM_S2Cmd_enum "S2开关指令" UBYTE NO_COMPU_METHOD 0 0 0 1 ECU_ADDRESS 0x70014afa FORMAT "%.15" /end MEASUREMENT
/begin MEASUREMENT VeSOC_BattDisChrgDnOff_enum "停止主动降功率标志位" UBYTE NO_COMPU_METHOD 0 0 0 1 ECU_ADDRESS 0x70014b71 FORMAT "%.15" /end MEASUREMENT
/begin MEASUREMENT VbBATST_BMUn12s5v_flg "BMU采集电压5V异常标志位" UBYTE NO_COMPU_METHOD 0 0 0 1 ECU_ADDRESS 0x700149ed FORMAT "%.15" /end MEASUREMENT
/begin MEASUREMENT VeBATST_ERRVoltFilt_CT "自增1计数器" UWORD NO_COMPU_METHOD 0 0 0 1 ECU_ADDRESS 0x70002566 FORMAT "%.15" /end MEASUREMENT
/begin MEASUREMENT LuSOC_facChgFullDiff_enum "充电电流修正系数" UWORD NO_COMPU_METHOD 0 0 0 1 ECU_ADDRESS 0x70013b5c FORMAT "%.15" /end MEASUREMENT
/begin MEASUREMENT LfFTD_ModVltSum_V "模组电压累加和" FLOAT32_IEEE NO_COMPU_METHOD 0 0 0 1 ECU_ADDRESS 0x70007ab8 FORMAT "%.15" /end MEASUREMENT
/begin MEASUREMENT LfFTD_CellVltSum_V "单体电压累加和" FLOAT32_IEEE NO_COMPU_METHOD 0 0 0 1 ECU_ADDRESS 0x70007aac FORMAT "%.15" /end MEASUREMENT
/begin MEASUREMENT LfHRD_EquVltSum_V "等效电压累加和" FLOAT32_IEEE NO_COMPU_METHOD 0 0 0 1 ECU_ADDRESS 0x70007aca FORMAT "%.15" /end MEASUREMENT
/begin MEASUREMENT VbFTD_TempOverWrn_flg "温度过高预警" UBYTE NO_COMPU_METHOD 0 0 0 1 ECU_ADDRESS 0x70014a8d FORMAT "%.15" /end MEASUREMENT
/begin MEASUREMENT VbPBL_BMUBalaWorkMAb_flag "子板工作模式异常标志" UBYTE NO_COMPU_METHOD 0 0 0 1 ECU_ADDRESS 0x70014aa4 FORMAT "%.15" /end MEASUREMENT
/begin MEASUREMENT LeBCM_PumPWMOnMinT_enum "加热水泵占空比" UBYTE NO_COMPU_METHOD 0 0 0 1 ECU_ADDRESS 0x70002ab7 FORMAT "%.15" /end MEASUREMENT
/begin MEASUREMENT LeBCM_PumPWMOnMaxT_enum "冷却水泵占空比" UBYTE NO_COMPU_METHOD 0 0 0 1 ECU_ADDRESS 0x70002ab6 FORMAT "%.15" /end MEASUREMENT
/begin MEASUREMENT LeBCM_PumPWMOnOutWatT_enum "加热或冷却水泵占空比" UBYTE NO_COMPU_METHOD 0 0 0 1 ECU_ADDRESS 0x70002ab8 FORMAT "%.15" /end MEASUREMENT
/begin MEASUREMENT LeBCM_PumPWMOnDiffT_enum "温差水泵占空比" UBYTE NO_COMPU_METHOD 0 0 0 1 ECU_ADDRESS 0x70002ab5 FORMAT "%.15" /end MEASUREMENT
/begin MEASUREMENT PWM1 "占空比1" UBYTE NO_COMPU_METHOD 0 0 0 1 ECU_ADDRESS 0x700149e4 FORMAT "%.15" /end MEASUREMENT
/begin MEASUREMENT PWM2 "占空比2" UBYTE NO_COMPU_METHOD 0 0 0 1 ECU_ADDRESS 0x700149e5 FORMAT "%.15" /end MEASUREMENT
/begin MEASUREMENT PWM3 "占空比3" UBYTE NO_COMPU_METHOD 0 0 0 1 ECU_ADDRESS 0x700149e6 FORMAT "%.15" /end MEASUREMENT
/begin MEASUREMENT PWM4 "占空比4" UBYTE NO_COMPU_METHOD 0 0 0 1 ECU_ADDRESS 0x700149e7 FORMAT "%.15" /end MEASUREMENT
/begin MEASUREMENT LfFTD_12VBttry_V "12V采集信号" UWORD NO_COMPU_METHOD 0 0 0 1 ECU_ADDRESS 0x70005174 FORMAT "%.15" /end MEASUREMENT
/begin MEASUREMENT LsBCM_BMUMinTemp_deg "单体最低温度液冷" SWORD NO_COMPU_METHOD 0 0 0 1 ECU_ADDRESS 0x70002ad9 FORMAT "%.15" /end MEASUREMENT
/begin MEASUREMENT LsBCM_BMUMaxTemp_deg "单体最高温度液冷" SWORD NO_COMPU_METHOD 0 0 0 1 ECU_ADDRESS 0x70002ad8 FORMAT "%.15" /end MEASUREMENT
/begin MEASUREMENT LsBCM_BattOutPutTemp_deg "电池包出水口温度" SWORD NO_COMPU_METHOD 0 0 0 1 ECU_ADDRESS 0x70002adb FORMAT "%.15" /end MEASUREMENT
/begin MEASUREMENT LeBCM_PTCNowState_enum "PTC当前工作状态" UBYTE NO_COMPU_METHOD 0 0 0 1 ECU_ADDRESS 0x70002ab4 FORMAT "%.15" /end MEASUREMENT
/begin MEASUREMENT LbBCM_BMSECCEASCmd_flg "空调暖风系统使能指令" UBYTE NO_COMPU_METHOD 0 0 0 1 ECU_ADDRESS 0x70002a9f FORMAT "%.15" /end MEASUREMENT
/begin MEASUREMENT LeBCM_BMSAndECCLife_enum "ECC和BMS通讯生命信号" UBYTE NO_COMPU_METHOD 0 0 0 1 ECU_ADDRESS 0x70002aac FORMAT "%.15" /end MEASUREMENT
/begin MEASUREMENT LeBCM_BMSAndEWP_BLife_enum "EWP和BMS通讯生命信号" UBYTE NO_COMPU_METHOD 0 0 0 1 ECU_ADDRESS 0x70002aad FORMAT "%.15" /end MEASUREMENT
/begin MEASUREMENT LbBCM_BattOutputSenT_flg "电池出水口温度传感器故障" UBYTE NO_COMPU_METHOD 0 0 0 1 ECU_ADDRESS 0x70002aa0 FORMAT "%.15" /end MEASUREMENT
/begin MEASUREMENT LeBCM_EASState_enum "EAS状态" UBYTE NO_COMPU_METHOD 0 0 0 1 ECU_ADDRESS 0x70002ab2 FORMAT "%.15" /end MEASUREMENT
/begin MEASUREMENT LbBCM_PTCState_flg "PTC状态" UBYTE NO_COMPU_METHOD 0 0 0 1 ECU_ADDRESS 0x70002aa6 FORMAT "%.15" /end MEASUREMENT
/begin MEASUREMENT LfBCM_BattSOC_pct "电池包的SOC值" FLOAT32_IEEE NO_COMPU_METHOD 0 0 0 1 ECU_ADDRESS 0x70002ad5 FORMAT "%.15" /end MEASUREMENT
/begin MEASUREMENT LbBCM_ChgStopNorm_flg "慢充正常充满标志位" UBYTE NO_COMPU_METHOD 0 0 0 1 ECU_ADDRESS 0x70002aa1 FORMAT "%.15" /end MEASUREMENT
/begin MEASUREMENT LbSOC_PreLck_flg "SOC预充状态锁存标志位" UBYTE NO_COMPU_METHOD 0 0 0 1 ECU_ADDRESS 0x7000cff5 FORMAT "%.15" /end MEASUREMENT
/begin MEASUREMENT LuSOC_StatMaxVLck_V "单体静态最高电压" UWORD NO_COMPU_METHOD 0 0 0 1 ECU_ADDRESS 0x7000cf56 FORMAT "%.15" /end MEASUREMENT
/begin MEASUREMENT LuSOC_StatMinVLck_V "单体静态最低电压" UWORD NO_COMPU_METHOD 0 0 0 1 ECU_ADDRESS 0x7000cf58 FORMAT "%.15" /end MEASUREMENT
/begin MEASUREMENT LbFCH_SumCapAh_flg "LbFCH_SumCapAh_flg" UBYTE NO_COMPU_METHOD 0 0 0 1 ECU_ADDRESS 0x70005040 FORMAT "%.15" /end MEASUREMENT
/begin MEASUREMENT LeBATST_ChipWrMode_enum "均衡保持标志位" UBYTE NO_COMPU_METHOD 0 0 0 1 ECU_ADDRESS 0x7000270e FORMAT "%.15" /end MEASUREMENT
/begin MEASUREMENT VfBATST_ModuAccuTotaVlt_V "模组累加电压_构架三" UWORD NO_COMPU_METHOD 0 0 0 1 ECU_ADDRESS 0x70013b9a FORMAT "%.15" /end MEASUREMENT
/begin MEASUREMENT VfBATST_AvgCellAccuV_V "总电压等效电压_构架三" UWORD NO_COMPU_METHOD 0 0 0 1 ECU_ADDRESS 0x70013b96 FORMAT "%.15" /end MEASUREMENT
/begin MEASUREMENT VfBATST_ValidCellAccuV_V "单体累加电压_构架三" UWORD NO_COMPU_METHOD 0 0 0 1 ECU_ADDRESS 0x70013ba2 FORMAT "%.15" /end MEASUREMENT
/begin MEASUREMENT VbBCM_BattHeatWrmChkCmplt_flg "动力电池加热保温需求判断完成" UBYTE NO_COMPU_METHOD 0 0 0 1 ECU_ADDRESS 0x700149f0 FORMAT "%.15" /end MEASUREMENT
/begin MEASUREMENT VeBCM_BattHeatWrmReq_enum "电池预加热保温需求" UBYTE NO_COMPU_METHOD 0 0 0 1 ECU_ADDRESS 0x70014ad6 FORMAT "%.15" /end MEASUREMENT
/begin MEASUREMENT VeBCM_BattHeatManNeed_enum "动力电池热管理需求" UBYTE NO_COMPU_METHOD 0 0 0 1 ECU_ADDRESS 0x70014ad3 FORMAT "%.15" /end MEASUREMENT
/begin MEASUREMENT VbFTD_BCUPowerOff_flg "主正继电器断开标志位" UBYTE NO_COMPU_METHOD 0 0 0 1 ECU_ADDRESS 0x70014a5e FORMAT "%.15" /end MEASUREMENT
/begin MEASUREMENT LeCTM_BattChrgReq_enum "动力电池充电需求" UBYTE NO_COMPU_METHOD 0 0 0 1 ECU_ADDRESS 0x70003bf1 FORMAT "%.15" /end MEASUREMENT
/begin MEASUREMENT LeCTM_BattHeatWrmReq_enum "动力电池预加热保温需求" UBYTE NO_COMPU_METHOD 0 0 0 1 ECU_ADDRESS 0x70003bf3 FORMAT "%.15" /end MEASUREMENT
/begin MEASUREMENT LeCTM_ChrgPwrSplSt_enum "供电设备状态" UBYTE NO_COMPU_METHOD 0 0 0 1 ECU_ADDRESS 0x70003c00 FORMAT "%.15" /end MEASUREMENT
/begin MEASUREMENT LuCTM_OBCCnntSt_enum "充电枪连接状态" UWORD NO_COMPU_METHOD 0 0 0 1 ECU_ADDRESS 0x70003c1e FORMAT "%.15" /end MEASUREMENT
/begin MEASUREMENT TemUseMode "余温利用模式" UBYTE NO_COMPU_METHOD 0 0 0 1 ECU_ADDRESS 0x700149ea FORMAT "%.15" /end MEASUREMENT
/begin MEASUREMENT VbBCM_BMSAndECCLost_flg "BMS与ECC通讯丢失标志位" UBYTE NO_COMPU_METHOD 0 0 0 1 ECU_ADDRESS 0x700149ee FORMAT "%.15" /end MEASUREMENT
/begin MEASUREMENT LuCCS_RemdChgTime_min "慢充时间T1" UWORD NO_COMPU_METHOD 0 0 0 1 ECU_ADDRESS 0x7000346a FORMAT "%.15" /end MEASUREMENT
/begin MEASUREMENT VbBCM_BMSAndEWP_BLost_flg "BMS与EWP_B通讯丢失标志位" UBYTE NO_COMPU_METHOD 0 0 0 1 ECU_ADDRESS 0x700149ef FORMAT "%.15" /end MEASUREMENT
/begin MEASUREMENT PWM6 "占空比6" UBYTE NO_COMPU_METHOD 0 0 0 1 ECU_ADDRESS 0x700149e9 FORMAT "%.15" /end MEASUREMENT
/begin MEASUREMENT LsFTD_Fmax_deg "第一组单体电芯最高温度" SWORD NO_COMPU_METHOD 0 0 0 1 ECU_ADDRESS 0x70007e8a FORMAT "%.15" /end MEASUREMENT
/begin MEASUREMENT LsFTD_Fmin_deg "第一组单体电芯最低温度" SWORD NO_COMPU_METHOD 0 0 0 1 ECU_ADDRESS 0x70007e8b FORMAT "%.15" /end MEASUREMENT
/begin MEASUREMENT LsFTD_Smax_deg "第二组单体电芯最高温度" SWORD NO_COMPU_METHOD 0 0 0 1 ECU_ADDRESS 0x70007e8e FORMAT "%.15" /end MEASUREMENT
/begin MEASUREMENT LsFTD_Smix_deg "第二组单体电芯最低温度" SWORD NO_COMPU_METHOD 0 0 0 1 ECU_ADDRESS 0x70007e8f FORMAT "%.15" /end MEASUREMENT
/begin MEASUREMENT LsFTD_Tmax_deg "第三组单体电芯最高温度" SWORD NO_COMPU_METHOD 0 0 0 1 ECU_ADDRESS 0x70007e90 FORMAT "%.15" /end MEASUREMENT
/begin MEASUREMENT LsFTD_Tmix_deg "第三组单体电芯最低温度" SWORD NO_COMPU_METHOD 0 0 0 1 ECU_ADDRESS 0x70007e91 FORMAT "%.15" /end MEASUREMENT
/begin MEASUREMENT LsFTD_Fomax_deg "第四组单体电芯最高温度" SWORD NO_COMPU_METHOD 0 0 0 1 ECU_ADDRESS 0x70007e8c FORMAT "%.15" /end MEASUREMENT
/begin MEASUREMENT LsFTD_Fomix_deg "第四组单体电芯最低温度" SWORD NO_COMPU_METHOD 0 0 0 1 ECU_ADDRESS 0x70007e8d FORMAT "%.15" /end MEASUREMENT
/begin MEASUREMENT LbSOC_OCVStatEna_flg "静态OCV使能" UBYTE NO_COMPU_METHOD 0 0 0 1 ECU_ADDRESS 0x7000cfef FORMAT "%.15" /end MEASUREMENT
/begin MEASUREMENT LuFCH_DIAG_V1_V "内部总电压V1" UWORD NO_COMPU_METHOD 0 0 0 1 ECU_ADDRESS 0x70005024 FORMAT "%.15" /end MEASUREMENT
/begin MEASUREMENT VuFCH_ReqChargeVlt_V "请求电压" UWORD NO_COMPU_METHOD 0 0 0 1 ECU_ADDRESS 0x700145f4 FORMAT "%.15" /end MEASUREMENT
/begin MEASUREMENT LlFCH_FCHSocketTemp1_R "快充座温度采集电阻1" ULONG NO_COMPU_METHOD 0 0 0 1 ECU_ADDRESS 0x7000500a FORMAT "%.15" /end MEASUREMENT
/begin MEASUREMENT LlFCH_FCHSocketTemp2_R "快充座温度采集电阻2" ULONG NO_COMPU_METHOD 0 0 0 1 ECU_ADDRESS 0x7000500e FORMAT "%.15" /end MEASUREMENT
/begin MEASUREMENT ViFCH_SocketTemp1_deg "快充座温度1" UWORD NO_COMPU_METHOD 0 0 0 1 ECU_ADDRESS 0x70014ba1 FORMAT "%.15" /end MEASUREMENT
/begin MEASUREMENT ViFCH_SocketTemp2_deg "快充座温度2" UWORD NO_COMPU_METHOD 0 0 0 1 ECU_ADDRESS 0x70014ba2 FORMAT "%.15" /end MEASUREMENT
/begin MEASUREMENT VeCTM_CHGDischgMode_enum "车辆充放电模式" UBYTE NO_COMPU_METHOD 0 0 0 1 ECU_ADDRESS 0x70014af0 FORMAT "%.15" /end MEASUREMENT
/begin MEASUREMENT LeCTM_VBUStCmd_enum "整车STATE" UBYTE NO_COMPU_METHOD 0 0 0 1 ECU_ADDRESS 0x70003b88 FORMAT "%.15" /end MEASUREMENT
/begin MEASUREMENT LuSOC_EPRCheckCode_enum "SOC校验标志CheckCode" UWORD NO_COMPU_METHOD 0 0 0 1 ECU_ADDRESS 0x7000cee4 FORMAT "%.15" /end MEASUREMENT
/begin MEASUREMENT VeCTM_BattChgSt_enum "充电状态" UBYTE NO_COMPU_METHOD 0 0 0 1 ECU_ADDRESS 0x70014aef FORMAT "%.15" /end MEASUREMENT
/begin MEASUREMENT VeOUTDEAL_BattChgSt_enum "充电状态-2" UBYTE NO_COMPU_METHOD 0 0 0 1 ECU_ADDRESS 0x70014b4e FORMAT "%.15" /end MEASUREMENT
/begin MEASUREMENT VeBTM_BattHeatMode_enum "动力电池加热类型" UBYTE NO_COMPU_METHOD 0 0 0 1 ECU_ADDRESS 0x70014ada FORMAT "%.15" /end MEASUREMENT
/begin MEASUREMENT VeOUTDEAL_BattHeatMode_enum "动力电池加热类型" UBYTE NO_COMPU_METHOD 0 0 0 1 ECU_ADDRESS 0x70014b4f FORMAT "%.15" /end MEASUREMENT
/begin MEASUREMENT LuCTM_SetStopDisChgRang_Km "设置里程" UWORD NO_COMPU_METHOD 0 0 0 1 ECU_ADDRESS 0x70003bae FORMAT "%.15" /end MEASUREMENT
/begin MEASUREMENT LuCTM_RemainRang_Km "设置里程" UWORD NO_COMPU_METHOD 0 0 0 1 ECU_ADDRESS 0x70003baa FORMAT "%.15" /end MEASUREMENT
/begin MEASUREMENT VbFCH_CutoffCharge_flg "SOC修正请求标志位" UBYTE NO_COMPU_METHOD 0 0 0 1 ECU_ADDRESS 0x70014a43 FORMAT "%.15" /end MEASUREMENT
/begin MEASUREMENT VbPBL_BalaMOSDiagFinish_flag "均衡MOS诊断结束标志" UBYTE NO_COMPU_METHOD 0 0 0 1 ECU_ADDRESS 0x70014aa7 FORMAT "%.15" /end MEASUREMENT
/begin MEASUREMENT LbPWRCTL_LwVltErr_flg "功率" UBYTE NO_COMPU_METHOD 0 0 0 1 ECU_ADDRESS 0x7000a91b FORMAT "%.15" /end MEASUREMENT
/begin MEASUREMENT VuSOC_BattSOC_pct "显示SOC观测值" UWORD NO_COMPU_METHOD 0 0 0 1 ECU_ADDRESS 0x70014716 FORMAT "%.15" /end MEASUREMENT
/begin MEASUREMENT LeVVST_VehSt_enum "虚拟状态机状态输入" UBYTE NO_COMPU_METHOD 0 0 0 1 ECU_ADDRESS 0x7000e98c FORMAT "%.15" /end MEASUREMENT
/begin MEASUREMENT VeVVST_VehSt_enum "虚拟状态机状态输出" UWORD NO_COMPU_METHOD 0 0 0 1 ECU_ADDRESS 0x70014b9b FORMAT "%.15" /end MEASUREMENT
/begin MEASUREMENT LuCTCTR_VehSta_enum "输入到模型的state" UWORD NO_COMPU_METHOD 0 0 0 1 ECU_ADDRESS 0x70003892 FORMAT "%.15" /end MEASUREMENT
/begin MEASUREMENT VuCTCTR_BCUCheck_enum "自检计数器变量" UWORD NO_COMPU_METHOD 0 0 0 1 ECU_ADDRESS 0x700145ea FORMAT "%.15" /end MEASUREMENT
/begin MEASUREMENT LbFCH_CHM_Received "握手接受标志位" UBYTE NO_COMPU_METHOD 0 0 0 1 ECU_ADDRESS 0x70014976 FORMAT "%.15" /end MEASUREMENT
/begin MEASUREMENT LbFCH_CRM00_Received "配置接受标志位" UBYTE NO_COMPU_METHOD 0 0 0 1 ECU_ADDRESS 0x70014979 FORMAT "%.15" /end MEASUREMENT
/begin MEASUREMENT LbFCH_CRMAA_Received "配置成功标志位" UBYTE NO_COMPU_METHOD 0 0 0 1 ECU_ADDRESS 0x7001497a FORMAT "%.15" /end MEASUREMENT
/begin MEASUREMENT LbFCH_CTS_Received "CTS接受标志位" UBYTE NO_COMPU_METHOD 0 0 0 1 ECU_ADDRESS 0x7001497e FORMAT "%.15" /end MEASUREMENT
/begin MEASUREMENT LbFCH_CML_Received "CML接受标志位" UBYTE NO_COMPU_METHOD 0 0 0 1 ECU_ADDRESS 0x70014978 FORMAT "%.15" /end MEASUREMENT
/begin MEASUREMENT LbFCH_CRO_Received "CRO接受标志位" UBYTE NO_COMPU_METHOD 0 0 0 1 ECU_ADDRESS 0x7001497b FORMAT "%.15" /end MEASUREMENT
/begin MEASUREMENT LbFCH_CCS_Received "CCS接受标志位" UBYTE NO_COMPU_METHOD 0 0 0 1 ECU_ADDRESS 0x70014973 FORMAT "%.15" /end MEASUREMENT
/begin MEASUREMENT LbFCH_CST_Received "CST接受标志位" UBYTE NO_COMPU_METHOD 0 0 0 1 ECU_ADDRESS 0x7001497d FORMAT "%.15" /end MEASUREMENT
/begin MEASUREMENT LbFCH_CSD_Received "CSD接受标志位" UBYTE NO_COMPU_METHOD 0 0 0 1 ECU_ADDRESS 0x7001497c FORMAT "%.15" /end MEASUREMENT
/begin MEASUREMENT LeFCH_VBUStCmd_enum "快充输入" UBYTE NO_COMPU_METHOD 0 0 0 1 ECU_ADDRESS 0x70005002 FORMAT "%.15" /end MEASUREMENT
/begin MEASUREMENT LlTEMP_BMUnAllResist_O "温度对应电阻值" ULONG NO_COMPU_METHOD 0 0 0 1 ECU_ADDRESS 0x7000e43c FORMAT "%.15" /end MEASUREMENT
/begin MEASUREMENT VsTEMP_BMUnAllTemp_deg "通道温度值" UBYTE NO_COMPU_METHOD 0 0 0 1 ECU_ADDRESS 0x70014c89 FORMAT "%.15" /end MEASUREMENT
/begin MEASUREMENT LuFCH_FCHCC2_PE_V "cc2电压" UBYTE NO_COMPU_METHOD 0 0 0 1 ECU_ADDRESS 0x70005098 FORMAT "%.15" /end MEASUREMENT
/begin MEASUREMENT LsFTD_BatMinTemp_deg "最低温度" SWORD NO_COMPU_METHOD 0 0 0 1 ECU_ADDRESS 0x70007e89 FORMAT "%.15" /end MEASUREMENT
/begin MEASUREMENT LeFTD_CellVltChnlErr_enum "单体电压采集电路故障" UBYTE NO_COMPU_METHOD 0 0 0 1 ECU_ADDRESS 0x70007d82 FORMAT "%.15" /end MEASUREMENT
/begin MEASUREMENT LeFTD_VCURnew_NULL "214报文Life值" UBYTE NO_COMPU_METHOD 0 0 0 1 ECU_ADDRESS 0x70005181 FORMAT "%.15" /end MEASUREMENT
/begin MEASUREMENT VbFTD_VCUComErr_flg "VCU节点通讯丢失故障" UBYTE NO_COMPU_METHOD 0 0 0 1 ECU_ADDRESS 0x70014a90 FORMAT "%.15" /end MEASUREMENT
/begin MEASUREMENT VsBCM_InWatNeeTemp_T "电池包入水口需求温度" UBYTE NO_COMPU_METHOD 0 0 0 1 ECU_ADDRESS 0x70014ba4 FORMAT "%.15" /end MEASUREMENT
/begin MEASUREMENT LbOUTDEAL_BattHeatWrmChkCmplt_flg_BCM "保温加热判断完成标志位" UBYTE NO_COMPU_METHOD 0 0 0 1 ECU_ADDRESS 0x70007fc0 FORMAT "%.15" /end MEASUREMENT
/begin MEASUREMENT VeBCM_CoolPumSpeRatCmd_enum "水泵1" UBYTE NO_COMPU_METHOD 0 0 0 1 ECU_ADDRESS 0x70014ad8 FORMAT "%.15" /end MEASUREMENT
/begin MEASUREMENT VbBCM_CoolPumDriCmd_flg "水泵1" UBYTE NO_COMPU_METHOD 0 0 0 1 ECU_ADDRESS 0x700149f1 FORMAT "%.15" /end MEASUREMENT
/begin MEASUREMENT LsBCM_CoolChk_T "制冷进入的最高温度阈值" UBYTE NO_COMPU_METHOD 0 0 0 1 ECU_ADDRESS 0x70002add FORMAT "%.15" /end MEASUREMENT
/begin MEASUREMENT LsBCM_CoolCheckDown_T "制冷退出的最高温度阈值" UBYTE NO_COMPU_METHOD 0 0 0 1 ECU_ADDRESS 0x70002adc FORMAT "%.15" /end MEASUREMENT
/begin MEASUREMENT LsBCM_CoolInWatReqTemp_T "制冷时请求的入水口温度" UBYTE NO_COMPU_METHOD 0 0 0 1 ECU_ADDRESS 0x70002ade FORMAT "%.15" /end MEASUREMENT
/begin MEASUREMENT LsBCM_MotCoolChk_T "行车制冷进入的最高温度阈值" UBYTE NO_COMPU_METHOD 0 0 0 1 ECU_ADDRESS 0x70002ae1 FORMAT "%.15" /end MEASUREMENT
/begin MEASUREMENT LsBCM_MotCoolCheckDown_T "行车制冷退出的最高温度阈值" UBYTE NO_COMPU_METHOD 0 0 0 1 ECU_ADDRESS 0x70002ae0 FORMAT "%.15" /end MEASUREMENT
/begin MEASUREMENT LsBCM_MotCoolInWatReqTemp_T "行车制冷时请求的入水口温度" UBYTE NO_COMPU_METHOD 0 0 0 1 ECU_ADDRESS 0x70002ae2 FORMAT "%.15" /end MEASUREMENT
/begin MEASUREMENT VeCRTINT_BattAdptNum_enum "窗口计数器" UBYTE NO_COMPU_METHOD 0 0 0 1 ECU_ADDRESS 0x70014aec FORMAT "%.15" /end MEASUREMENT
/begin MEASUREMENT VbCRTINT_BMSParaUsed_flag "电池自适应标志位" UBYTE NO_COMPU_METHOD 0 0 0 1 ECU_ADDRESS 0x70014a07 FORMAT "%.15" /end MEASUREMENT
/begin MEASUREMENT LeCTM_DischgBtnCount_enum "放电按钮" UBYTE NO_COMPU_METHOD 0 0 0 1 ECU_ADDRESS 0x70003c04 FORMAT "%.15" /end MEASUREMENT
/begin MEASUREMENT LsFCH_InstCurrent_A "电流" UWORD NO_COMPU_METHOD 0 0 0 1 ECU_ADDRESS 0x70005012 FORMAT "%.15" /end MEASUREMENT
/begin MEASUREMENT LeFCH_BattSOC_pct "soc" UWORD NO_COMPU_METHOD 0 0 0 1 ECU_ADDRESS 0x70004ff6 FORMAT "%.15" /end MEASUREMENT
/begin MEASUREMENT LuFCH_BattRatedCap_Ah "额定容量" UWORD NO_COMPU_METHOD 0 0 0 1 ECU_ADDRESS 0x7000501c FORMAT "%.15" /end MEASUREMENT
/begin MEASUREMENT LuFCH_BattAvlbCap_Ah "可用容量" UWORD NO_COMPU_METHOD 0 0 0 1 ECU_ADDRESS 0x70005018 FORMAT "%.15" /end MEASUREMENT
/begin MEASUREMENT VbBATEP_BMSHWVerFault_flg "硬件版本号故障" UBYTE NO_COMPU_METHOD 0 0 0 1 ECU_ADDRESS 0x700149eb FORMAT "%.15" /end MEASUREMENT
/begin MEASUREMENT LbFTD_BCUInit_flg "低压电源异常故障查询" UBYTE NO_COMPU_METHOD 0 0 0 1 ECU_ADDRESS 0x7000517d FORMAT "%.15" /end MEASUREMENT
/begin MEASUREMENT VbCTCTR_BMSBrush_flg "BMS软件刷写标志位" UBYTE NO_COMPU_METHOD 0 0 0 1 ECU_ADDRESS 0x70014a0d FORMAT "%.15" /end MEASUREMENT
/begin MEASUREMENT VbCTCTR_BCUPowerDownCmd_flg "BMS低压下电请求信号标志位" UBYTE NO_COMPU_METHOD 0 0 0 1 ECU_ADDRESS 0x70014a0b FORMAT "%.15" /end MEASUREMENT
/begin MEASUREMENT LeBCM_EHUHeatPreservatRq_enum "保温可调" UBYTE NO_COMPU_METHOD 0 0 0 1 ECU_ADDRESS 0x70002ab3 FORMAT "%.15" /end MEASUREMENT
/begin MEASUREMENT LeBCM_BMSHeatPreservatStEE_enum "保温可调" UBYTE NO_COMPU_METHOD 0 0 0 1 ECU_ADDRESS 0x70002aae FORMAT "%.15" /end MEASUREMENT
/begin MEASUREMENT LbBCM_EPPROMErr_flg "保温可调" UBYTE NO_COMPU_METHOD 0 0 0 1 ECU_ADDRESS 0x70002aa2 FORMAT "%.15" /end MEASUREMENT
/begin MEASUREMENT VeBCM_BMSHeatPreservatSt_flg "保温可调" UBYTE NO_COMPU_METHOD 0 0 0 1 ECU_ADDRESS 0x70014ad2 FORMAT "%.15" /end MEASUREMENT
/begin MEASUREMENT VeBCM_BMSHeatPreservatStEE_enum "保温可调" UBYTE NO_COMPU_METHOD 0 0 0 1 ECU_ADDRESS 0x70014ad1 FORMAT "%.15" /end MEASUREMENT
/begin MEASUREMENT KbBCM_WrmSet_flg_Batt1 "保温功能开关" UBYTE NO_COMPU_METHOD 0 0 0 1 ECU_ADDRESS 0xaf01009e FORMAT "%.15" /end MEASUREMENT
/begin MEASUREMENT KsBCM_WrmMaxChk_deg_Batt1 "进入保温最高温度阈值" UBYTE NO_COMPU_METHOD 0 0 0 1 ECU_ADDRESS 0xaf0101d6 FORMAT "%.15" /end MEASUREMENT
/begin MEASUREMENT KsBCM_WrmMinChk_deg_Batt1 "进入保温最低温度阈值" UBYTE NO_COMPU_METHOD 0 0 0 1 ECU_ADDRESS 0xaf010186 FORMAT "%.15" /end MEASUREMENT
/begin MEASUREMENT VeOUTDEAL_BattHeatWrmReq_enum "OUTDEAL输出的预加热保温需求" UBYTE NO_COMPU_METHOD 0 0 0 1 ECU_ADDRESS 0x70014b51 FORMAT "%.15" /end MEASUREMENT
/begin MEASUREMENT VbBCM_NoBattHeatManReq_flg "加热制冷冲突标志位" UBYTE NO_COMPU_METHOD 0 0 0 1 ECU_ADDRESS 0x700149f2 FORMAT "%.15" /end MEASUREMENT
/begin MEASUREMENT VbPBL_BalanceForbid_flg "均衡MOS诊断完成标志" UBYTE NO_COMPU_METHOD 0 0 0 1 ECU_ADDRESS 0x700098a2 FORMAT "%.15" /end MEASUREMENT
/begin MEASUREMENT HeatRlyCount "加热需求次数" UBYTE NO_COMPU_METHOD 0 0 0 1 ECU_ADDRESS 0x7001496c FORMAT "%.15" /end MEASUREMENT
/begin MEASUREMENT LslSOC_BattSysIRaw_A "充放电电流" SLONG NO_COMPU_METHOD 0 0 0 1 ECU_ADDRESS 0x7000c7c2 FORMAT "%.15" /end MEASUREMENT
/begin MEASUREMENT log_VfFSMOCR_FCMxCur_A "最大允许充电电流" FLOAT32_IEEE NO_COMPU_METHOD 0 0 0 1 ECU_ADDRESS 0x70018730 FORMAT "%.15" /end MEASUREMENT
/begin MEASUREMENT VbFTD_BCUChkHLVLockErr_flg "高低压互锁" UBYTE NO_COMPU_METHOD 0 0 0 1 ECU_ADDRESS 0x70014a5c FORMAT "%.15" /end MEASUREMENT
/begin MEASUREMENT LfFTD_HVLockVlt_V "高低压互锁输入信号" UWORD NO_COMPU_METHOD 0 0 0 1 ECU_ADDRESS 0x70005176 FORMAT "%.15" /end MEASUREMENT
/begin MEASUREMENT LuSOC_EEInActSOC_pct "初始化真实SOC" UWORD NO_COMPU_METHOD 0 0 0 1 ECU_ADDRESS 0x7000cda6 FORMAT "%.15" /end MEASUREMENT
/begin MEASUREMENT LlSOC_EEInAvlbCpAct_Ah "初始化真实可用容量" ULONG NO_COMPU_METHOD 0 0 0 1 ECU_ADDRESS 0x7000c76c FORMAT "%.15" /end MEASUREMENT
/begin MEASUREMENT LuSOC_EEInDispSOC_pct "初始化显示SOC" UWORD NO_COMPU_METHOD 0 0 0 1 ECU_ADDRESS 0x7000cdb6 FORMAT "%.15" /end MEASUREMENT
/begin MEASUREMENT LlSOC_EEInBattAvlbCp_Ah "初始化显示可用容量" ULONG NO_COMPU_METHOD 0 0 0 1 ECU_ADDRESS 0x7000c770 FORMAT "%.15" /end MEASUREMENT
/begin MEASUREMENT LlSOC_EEInBattRatedCp_Ah "初始化显示额定容量" ULONG NO_COMPU_METHOD 0 0 0 1 ECU_ADDRESS 0x7000c778 FORMAT "%.15" /end MEASUREMENT
/begin MEASUREMENT LlSOC_EEInBattChgRatedCp_Ah "初始化显示充电额定容量" ULONG NO_COMPU_METHOD 0 0 0 1 ECU_ADDRESS 0x7000c774 FORMAT "%.15" /end MEASUREMENT
/begin MEASUREMENT LuSOC_EEInfacBattDiff_enum "初始化一致性容量修正系数" UWORD NO_COMPU_METHOD 0 0 0 1 ECU_ADDRESS 0x7000cdc0 FORMAT "%.15" /end MEASUREMENT
/begin MEASUREMENT LuSOC_EEInfacDchOCV_enum "初始化放电OCV修正系数" UWORD NO_COMPU_METHOD 0 0 0 1 ECU_ADDRESS 0x7000cdc4 FORMAT "%.15" /end MEASUREMENT
/begin MEASUREMENT LuSOC_EEInfacBattDchDiff_enum "初始化放电一致性修正系数" UWORD NO_COMPU_METHOD 0 0 0 1 ECU_ADDRESS 0x7000cdbe FORMAT "%.15" /end MEASUREMENT
/begin MEASUREMENT LuSOC_EEInChgFullLast_flg "初始化上次充电结束状态" UBYTE NO_COMPU_METHOD 0 0 0 1 ECU_ADDRESS 0x7000d109 FORMAT "%.15" /end MEASUREMENT
/begin MEASUREMENT LuSOC_EEInBattDchCVLim_enum "初始化上次放电阶段状态" UBYTE NO_COMPU_METHOD 0 0 0 1 ECU_ADDRESS 0x7000d107 FORMAT "%.15" /end MEASUREMENT
/begin MEASUREMENT LuSOC_EEInBattDisChrgDnOff_flg "初始化上次放电降功率状态" UBYTE NO_COMPU_METHOD 0 0 0 1 ECU_ADDRESS 0x7000d108 FORMAT "%.15" /end MEASUREMENT
/begin MEASUREMENT LuSOC_EEInStatOCVDiffCV_enum "初始化静态一致性修正系数" UWORD NO_COMPU_METHOD 0 0 0 1 ECU_ADDRESS 0x7000cdbc FORMAT "%.15" /end MEASUREMENT
/begin MEASUREMENT LuSOC_EEInChgDiffCV_enum "初始化充电一致性修正系数" UWORD NO_COMPU_METHOD 0 0 0 1 ECU_ADDRESS 0x7000cdb4 FORMAT "%.15" /end MEASUREMENT
/begin MEASUREMENT LuSOC_EEInBattChgEnLast_enum "初始化上次下电状态(充电或行车)" UBYTE NO_COMPU_METHOD 0 0 0 1 ECU_ADDRESS 0x7000d106 FORMAT "%.15" /end MEASUREMENT
/begin MEASUREMENT LuSOC_EEInfacChgFullDiff_enum "初始化充电电流容量修正系数" UWORD NO_COMPU_METHOD 0 0 0 1 ECU_ADDRESS 0x7000cdc2 FORMAT "%.15" /end MEASUREMENT
/begin MEASUREMENT LuSOC_EEInCheckCode_enum "初始化CheckCode" UWORD NO_COMPU_METHOD 0 0 0 1 ECU_ADDRESS 0x7000cdb2 FORMAT "%.15" /end MEASUREMENT
/begin MEASUREMENT LuSOC_EEInSOCTempMax_pct "初始化当前温度上限SOC" UWORD NO_COMPU_METHOD 0 0 0 1 ECU_ADDRESS 0x7000cdb8 FORMAT "%.15" /end MEASUREMENT
/begin MEASUREMENT LuSOC_EEInSOCTempMin_pct "初始化当前温度下限SOC" UWORD NO_COMPU_METHOD 0 0 0 1 ECU_ADDRESS 0x7000cdba FORMAT "%.15" /end MEASUREMENT
/begin MEASUREMENT LuSOC_EEInfacTempCp_enum "初始化温度容量修正系数" UWORD NO_COMPU_METHOD 0 0 0 1 ECU_ADDRESS 0x7000cdc6 FORMAT "%.15" /end MEASUREMENT
/begin MEASUREMENT LeSOC_EepromErr_enum "EE故障标志位" UBYTE NO_COMPU_METHOD 0 0 0 1 ECU_ADDRESS 0x7000d0f9 FORMAT "%.15" /end MEASUREMENT
/begin MEASUREMENT LuSOC_EEInpActSOC_pct "EE读取的真实SOC" UWORD NO_COMPU_METHOD 0 0 0 1 ECU_ADDRESS 0x7000cdc8 FORMAT "%.15" /end MEASUREMENT
/begin MEASUREMENT LlSOC_EEInpAvlbCpAct_Ah "EE读取的真实可用容量" ULONG NO_COMPU_METHOD 0 0 0 1 ECU_ADDRESS 0x7000c77c FORMAT "%.15" /end MEASUREMENT
/begin MEASUREMENT LuSOC_EEInpDispSOC_pct "EE读取的显示SOC" UWORD NO_COMPU_METHOD 0 0 0 1 ECU_ADDRESS 0x7000ced2 FORMAT "%.15" /end MEASUREMENT
/begin MEASUREMENT LlSOC_EEInpBattAvlbCp_Ah "EE读取的显示可用容量" ULONG NO_COMPU_METHOD 0 0 0 1 ECU_ADDRESS 0x7000c780 FORMAT "%.15" /end MEASUREMENT
/begin MEASUREMENT LlSOC_EEInpBattRatedCp_Ah "EE读取的显示额定容量" ULONG NO_COMPU_METHOD 0 0 0 1 ECU_ADDRESS 0x7000c788 FORMAT "%.15" /end MEASUREMENT
/begin MEASUREMENT LlSOC_EEInpBattChgRatedCp_Ah "EE读取的显示充电额定容量" ULONG NO_COMPU_METHOD 0 0 0 1 ECU_ADDRESS 0x7000c784 FORMAT "%.15" /end MEASUREMENT
/begin MEASUREMENT LuSOC_EEInpfacBattDiff_enum "EE读取的一致性容量修正系数" UWORD NO_COMPU_METHOD 0 0 0 1 ECU_ADDRESS 0x7000cedc FORMAT "%.15" /end MEASUREMENT
/begin MEASUREMENT LuSOC_EEInpfacDchOCV_enum "EE读取的放电OCV修正系数" UWORD NO_COMPU_METHOD 0 0 0 1 ECU_ADDRESS 0x7000cee0 FORMAT "%.15" /end MEASUREMENT
/begin MEASUREMENT LuSOC_EEInpfacBattDchDiff_enum "EE读取的放电一致性修正系数" UWORD NO_COMPU_METHOD 0 0 0 1 ECU_ADDRESS 0x7000ceda FORMAT "%.15" /end MEASUREMENT
/begin MEASUREMENT LuSOC_EEInpChgFullLast_flg "EE读取的上次充电结束状态" UBYTE NO_COMPU_METHOD 0 0 0 1 ECU_ADDRESS 0x7000d10d FORMAT "%.15" /end MEASUREMENT
/begin MEASUREMENT LuSOC_EEInpBattDchCVLim_enum "EE读取的上次放电阶段状态" UBYTE NO_COMPU_METHOD 0 0 0 1 ECU_ADDRESS 0x7000d10b FORMAT "%.15" /end MEASUREMENT
/begin MEASUREMENT LuSOC_EEInpBattDisChrgDnOff_flg "EE读取的上次放电降功率状态" UBYTE NO_COMPU_METHOD 0 0 0 1 ECU_ADDRESS 0x7000d10c FORMAT "%.15" /end MEASUREMENT
/begin MEASUREMENT LuSOC_EEInpStatOCVDiffCV_enum "EE读取的静态一致性修正系数" UWORD NO_COMPU_METHOD 0 0 0 1 ECU_ADDRESS 0x7000ced8 FORMAT "%.15" /end MEASUREMENT
/begin MEASUREMENT LuSOC_EEInpChgDiffCV_enum "EE读取的充电一致性修正系数" UWORD NO_COMPU_METHOD 0 0 0 1 ECU_ADDRESS 0x7000ced0 FORMAT "%.15" /end MEASUREMENT
/begin MEASUREMENT LuSOC_EEInpBattChgEnLast_enum "EE读取的上次下电状态(充电或行车)" UBYTE NO_COMPU_METHOD 0 0 0 1 ECU_ADDRESS 0x7000d10a FORMAT "%.15" /end MEASUREMENT
/begin MEASUREMENT LuSOC_EEInpfacChgFullDiff_enum "EE读取的充电电流容量修正系数" UWORD NO_COMPU_METHOD 0 0 0 1 ECU_ADDRESS 0x7000cede FORMAT "%.15" /end MEASUREMENT
/begin MEASUREMENT LuSOC_EEInpCheckCode_enum "EE读取的CheckCode" UWORD NO_COMPU_METHOD 0 0 0 1 ECU_ADDRESS 0x7000cece FORMAT "%.15" /end MEASUREMENT
/begin MEASUREMENT LuSOC_EEInpSOCTempMax_pct "EE读取的当前温度上限SOC" UWORD NO_COMPU_METHOD 0 0 0 1 ECU_ADDRESS 0x7000ced4 FORMAT "%.15" /end MEASUREMENT
/begin MEASUREMENT LuSOC_EEInpSOCTempMin_pct "EE读取的当前温度下限SOC" UWORD NO_COMPU_METHOD 0 0 0 1 ECU_ADDRESS 0x7000ced6 FORMAT "%.15" /end MEASUREMENT
/begin MEASUREMENT LuSOC_EEInpfacTempCp_enum "EE读取的温度容量修正系数" UWORD NO_COMPU_METHOD 0 0 0 1 ECU_ADDRESS 0x7000cee2 FORMAT "%.15" /end MEASUREMENT
/begin MEASUREMENT LeSOC_TempMaxRaw_degC "单体电芯最高温度CCP" UBYTE NO_COMPU_METHOD 0 0 0 1 ECU_ADDRESS 0x7000d0fe FORMAT "%.15" /end MEASUREMENT
/begin MEASUREMENT LbSOC_TempMaxErr_flg "SOC最高温度异常标志位" UBYTE NO_COMPU_METHOD 0 0 0 1 ECU_ADDRESS 0x7000d006 FORMAT "%.15" /end MEASUREMENT
/begin MEASUREMENT LeSOC_TempMax_degC "SOC最高温度" UBYTE NO_COMPU_METHOD 0 0 0 1 ECU_ADDRESS 0x7000d0ff FORMAT "%.15" /end MEASUREMENT
/begin MEASUREMENT LeSOC_TempMinRaw_degC "单体电芯最低温度CCP" UBYTE NO_COMPU_METHOD 0 0 0 1 ECU_ADDRESS 0x7000d100 FORMAT "%.15" /end MEASUREMENT
/begin MEASUREMENT LbSOC_TempMinErr_flg "SOC最低温度异常标志位" UBYTE NO_COMPU_METHOD 0 0 0 1 ECU_ADDRESS 0x7000d007 FORMAT "%.15" /end MEASUREMENT
/begin MEASUREMENT LeSOC_TempMin_degC "SOC最低温度" UBYTE NO_COMPU_METHOD 0 0 0 1 ECU_ADDRESS 0x7000d101 FORMAT "%.15" /end MEASUREMENT
/begin MEASUREMENT LuSOC_CVMaxRaw_V "单体电芯最高电压CCP" UWORD NO_COMPU_METHOD 0 0 0 1 ECU_ADDRESS 0x7000cc82 FORMAT "%.15" /end MEASUREMENT
/begin MEASUREMENT LbSOC_CVMaxErr_flg "SOC单体最高电压异常标志位" UBYTE NO_COMPU_METHOD 0 0 0 1 ECU_ADDRESS 0x7000cfca FORMAT "%.15" /end MEASUREMENT
/begin MEASUREMENT LuSOC_CVMax_V "SOC单体最高电压" UWORD NO_COMPU_METHOD 0 0 0 1 ECU_ADDRESS 0x7000cc86 FORMAT "%.15" /end MEASUREMENT
/begin MEASUREMENT LuSOC_CVMinRaw_V "单体电芯最低电压CCP" UWORD NO_COMPU_METHOD 0 0 0 1 ECU_ADDRESS 0x7000cc8e FORMAT "%.15" /end MEASUREMENT
/begin MEASUREMENT LbSOC_CVMinErr_flg "SOC单体最低电压异常标志位" UBYTE NO_COMPU_METHOD 0 0 0 1 ECU_ADDRESS 0x7000cfcd FORMAT "%.15" /end MEASUREMENT
/begin MEASUREMENT LuSOC_CVMin_V "SOC单体最低电压" UWORD NO_COMPU_METHOD 0 0 0 1 ECU_ADDRESS 0x7000cc90 FORMAT "%.15" /end MEASUREMENT
/begin MEASUREMENT LuSOC_CVMinFlt_V "静态滤波最低电压" UWORD NO_COMPU_METHOD 0 0 0 1 ECU_ADDRESS 0x7000cc8c FORMAT "%.15" /end MEASUREMENT
/begin MEASUREMENT LbSOC_CVMinFltErr_flg "静态滤波最低电压无效标志位" UBYTE NO_COMPU_METHOD 0 0 0 1 ECU_ADDRESS 0x7000cfcf FORMAT "%.15" /end MEASUREMENT
/begin MEASUREMENT LuSOC_CVMaxFlt_V "静态滤波最高电压" UWORD NO_COMPU_METHOD 0 0 0 1 ECU_ADDRESS 0x7000cc80 FORMAT "%.15" /end MEASUREMENT
/begin MEASUREMENT LbSOC_CVMaxFltErr_flg "静态滤波最高电压无效标志位" UBYTE NO_COMPU_METHOD 0 0 0 1 ECU_ADDRESS 0x7000cfcc FORMAT "%.15" /end MEASUREMENT
/begin MEASUREMENT LbSOC_BattFchFull_flg "动力电池快充满充标志位" UBYTE NO_COMPU_METHOD 0 0 0 1 ECU_ADDRESS 0x7000cfc0 FORMAT "%.15" /end MEASUREMENT
/begin MEASUREMENT LbSOC_DispFullSt_flg "显示SOC满充标志位" UBYTE NO_COMPU_METHOD 0 0 0 1 ECU_ADDRESS 0x7000cfd3 FORMAT "%.15" /end MEASUREMENT
/begin MEASUREMENT LbSOC_ActFullSt_Flg "真实SOC满充标志位" UBYTE NO_COMPU_METHOD 0 0 0 1 ECU_ADDRESS 0x7000cfb7 FORMAT "%.15" /end MEASUREMENT
/begin MEASUREMENT LuSOC_VehSt_enum "整车状态机" UWORD NO_COMPU_METHOD 0 0 0 1 ECU_ADDRESS 0x7000cf62 FORMAT "%.15" /end MEASUREMENT
/begin MEASUREMENT LeSOC_CalcSt_enum "SOC模式" UBYTE NO_COMPU_METHOD 0 0 0 1 ECU_ADDRESS 0x7000d0f0 FORMAT "%.15" /end MEASUREMENT
/begin MEASUREMENT LbSOC_SOCTaskEn_flg "SOC估算使能标志位" UBYTE NO_COMPU_METHOD 0 0 0 1 ECU_ADDRESS 0x7000cffe FORMAT "%.15" /end MEASUREMENT
/begin MEASUREMENT LuSOC_facSysIIntglNeg_enum "Ah积分充电修正系数" UWORD NO_COMPU_METHOD 0 0 0 1 ECU_ADDRESS 0x7000cfae FORMAT "%.15" /end MEASUREMENT
/begin MEASUREMENT LlSOC_AdjChgCp_Ah "修正充电安时" ULONG NO_COMPU_METHOD 0 0 0 1 ECU_ADDRESS 0x7000c71c FORMAT "%.15" /end MEASUREMENT
/begin MEASUREMENT LlSOC_AdjDchCp_Ah "修正放电安时" ULONG NO_COMPU_METHOD 0 0 0 1 ECU_ADDRESS 0x7000c72c FORMAT "%.15" /end MEASUREMENT
/begin MEASUREMENT LuSOC_facSysIIntglPos_enum "Ah积分放电修正系数" UWORD NO_COMPU_METHOD 0 0 0 1 ECU_ADDRESS 0x7000cfb0 FORMAT "%.15" /end MEASUREMENT
/begin MEASUREMENT LuSOC_OCVMaxVSOC_pct "静态OCV最高单体SOC" UWORD NO_COMPU_METHOD 0 0 0 1 ECU_ADDRESS 0x7000cefa FORMAT "%.15" /end MEASUREMENT
/begin MEASUREMENT LuSOC_OCVMinVSOC_pct "静态OCV最低单体SOC" UWORD NO_COMPU_METHOD 0 0 0 1 ECU_ADDRESS 0x7000cefc FORMAT "%.15" /end MEASUREMENT
/begin MEASUREMENT LbSOC_OCVStatEna_enum "OCV使能状态标志位" UBYTE NO_COMPU_METHOD 0 0 0 1 ECU_ADDRESS 0x7000cfee FORMAT "%.15" /end MEASUREMENT
/begin MEASUREMENT LlSOC_OCVMaxVCp_Ah "静态OCV最高单体容量" ULONG NO_COMPU_METHOD 0 0 0 1 ECU_ADDRESS 0x7000c794 FORMAT "%.15" /end MEASUREMENT
/begin MEASUREMENT LlSOC_OCVMinVCp_Ah "静态OCV最低单体容量" ULONG NO_COMPU_METHOD 0 0 0 1 ECU_ADDRESS 0x7000c798 FORMAT "%.15" /end MEASUREMENT
/begin MEASUREMENT LlSOC_RatedCpBas_Ah "当前温度最大可用容量" ULONG NO_COMPU_METHOD 0 0 0 1 ECU_ADDRESS 0x7000c79c FORMAT "%.15" /end MEASUREMENT
/begin MEASUREMENT LuSOC_facTempCp_enum "温度修正容量系数" UWORD NO_COMPU_METHOD 0 0 0 1 ECU_ADDRESS 0x7000cfb2 FORMAT "%.15" /end MEASUREMENT
/begin MEASUREMENT LuSOC_facCmltCp_enum "SOH系数" UWORD NO_COMPU_METHOD 0 0 0 1 ECU_ADDRESS 0x7000cf84 FORMAT "%.15" /end MEASUREMENT
/begin MEASUREMENT LuSOC_facBattDiffCp_enum "电池一致性修正系数" UWORD NO_COMPU_METHOD 0 0 0 1 ECU_ADDRESS 0x7000cf6c FORMAT "%.15" /end MEASUREMENT
/begin MEASUREMENT LlSOC_CmltChgCpRaw_Ah "电池系统历史累积充电容量CCP" ULONG NO_COMPU_METHOD 0 0 0 1 ECU_ADDRESS 0x7000c74c FORMAT "%.15" /end MEASUREMENT
/begin MEASUREMENT LlSOC_CmltChgCp_Ah "SOC累积充电容量" ULONG NO_COMPU_METHOD 0 0 0 1 ECU_ADDRESS 0x7000c750 FORMAT "%.15" /end MEASUREMENT
/begin MEASUREMENT LlSOC_CmltDchCpRaw_Ah "电池系统历史累积放电容量CCP" ULONG NO_COMPU_METHOD 0 0 0 1 ECU_ADDRESS 0x7000c754 FORMAT "%.15" /end MEASUREMENT
/begin MEASUREMENT LlSOC_CmltDchCp_Ah "SOC累积放电容量" ULONG NO_COMPU_METHOD 0 0 0 1 ECU_ADDRESS 0x7000c758 FORMAT "%.15" /end MEASUREMENT
/begin MEASUREMENT Lb_SOCOCVCorEn_flg "OCV修正使能标志位" UBYTE NO_COMPU_METHOD 0 0 0 1 ECU_ADDRESS 0x7000d00b FORMAT "%.15" /end MEASUREMENT
/begin MEASUREMENT LbSOC_NegRlySt_flg "动力电池负端继电器控制指令CCP" UBYTE NO_COMPU_METHOD 0 0 0 1 ECU_ADDRESS 0x7000cfe9 FORMAT "%.15" /end MEASUREMENT
/begin MEASUREMENT LbSOC_NegRlyWait_flg "负极继电器闭合后等待完成标志位" UBYTE NO_COMPU_METHOD 0 0 0 1 ECU_ADDRESS 0x7000cfea FORMAT "%.15" /end MEASUREMENT
/begin MEASUREMENT LbSOC_OCVEna_flg "OCV锁存使能标志位" UBYTE NO_COMPU_METHOD 0 0 0 1 ECU_ADDRESS 0x7000cfec FORMAT "%.15" /end MEASUREMENT
/begin MEASUREMENT LbSOC_PreRlySt_flg "动力电池预充电继电器控制指令" UBYTE NO_COMPU_METHOD 0 0 0 1 ECU_ADDRESS 0x7000cff6 FORMAT "%.15" /end MEASUREMENT
/begin MEASUREMENT LbSOC_StatCVLck_flg "静态电压锁存完成标志位" UBYTE NO_COMPU_METHOD 0 0 0 1 ECU_ADDRESS 0x7000d004 FORMAT "%.15" /end MEASUREMENT
/begin MEASUREMENT LbSOC_StatCVValid_flg "静态锁存电压有效标志位" UBYTE NO_COMPU_METHOD 0 0 0 1 ECU_ADDRESS 0x7000d005 FORMAT "%.15" /end MEASUREMENT
/begin MEASUREMENT LbSOC_CVFltErr_flg "静态滤波电压无效标志位" UBYTE NO_COMPU_METHOD 0 0 0 1 ECU_ADDRESS 0x7000cfc9 FORMAT "%.15" /end MEASUREMENT
/begin MEASUREMENT LuSOC_SOCTempMax_pct "当前温度上限SOC" UWORD NO_COMPU_METHOD 0 0 0 1 ECU_ADDRESS 0x7000cf52 FORMAT "%.15" /end MEASUREMENT
/begin MEASUREMENT LuSOC_SOCTempMin_pct "当前温度下限SOC" UWORD NO_COMPU_METHOD 0 0 0 1 ECU_ADDRESS 0x7000cf54 FORMAT "%.15" /end MEASUREMENT
/begin MEASUREMENT LlSOC_EEErrCor_Ah "EE故障修正容量" ULONG NO_COMPU_METHOD 0 0 0 1 ECU_ADDRESS 0x7000c768 FORMAT "%.15" /end MEASUREMENT
/begin MEASUREMENT LuSOC_EEErrCor_V "EE故障修正单体电压" UWORD NO_COMPU_METHOD 0 0 0 1 ECU_ADDRESS 0x7000cda2 FORMAT "%.15" /end MEASUREMENT
/begin MEASUREMENT LuSOC_ActSOCCal_pct "真实计算SOC" UWORD NO_COMPU_METHOD 0 0 0 1 ECU_ADDRESS 0x7000c7e0 FORMAT "%.15" /end MEASUREMENT
/begin MEASUREMENT LlSOC_ActCpRaw_Ah "真实未处理可用容量" ULONG NO_COMPU_METHOD 0 0 0 1 ECU_ADDRESS 0x7000c6f4 FORMAT "%.15" /end MEASUREMENT
/begin MEASUREMENT LlSOC_ActCpCor_Ah "真实可用容量修正容量" SLONG NO_COMPU_METHOD 0 0 0 1 ECU_ADDRESS 0x7000c6ec FORMAT "%.15" /end MEASUREMENT
/begin MEASUREMENT LlSOC_AdjChgCpRaw_Ah "当前修正充电安时" ULONG NO_COMPU_METHOD 0 0 0 1 ECU_ADDRESS 0x7000c718 FORMAT "%.15" /end MEASUREMENT
/begin MEASUREMENT LlSOC_AdjDchCpRaw_Ah "当前修正放电安时" ULONG NO_COMPU_METHOD 0 0 0 1 ECU_ADDRESS 0x7000c728 FORMAT "%.15" /end MEASUREMENT
/begin MEASUREMENT LeSOC_PwrDnNum_enum "放电过程降功率阶段标识" UBYTE NO_COMPU_METHOD 0 0 0 1 ECU_ADDRESS 0x7000d0fd FORMAT "%.15" /end MEASUREMENT
/begin MEASUREMENT LuSOC_ActSOC_pct "真实SOC" UWORD NO_COMPU_METHOD 0 0 0 1 ECU_ADDRESS 0x7000c7e2 FORMAT "%.15" /end MEASUREMENT
/begin MEASUREMENT LslSOC_FullStCurrMaxLim_A "LslSOC_FullStCurrMaxLim_A" SLONG NO_COMPU_METHOD 0 0 0 1 ECU_ADDRESS 0x7000c7d2 FORMAT "%.15" /end MEASUREMENT
/begin MEASUREMENT LuSOC_DispSOC_pct "显示SOC" UWORD NO_COMPU_METHOD 0 0 0 1 ECU_ADDRESS 0x7000cda0 FORMAT "%.15" /end MEASUREMENT
/begin MEASUREMENT VuSOC_EPRCheckCode_enum "SOC校验标志" UWORD NO_COMPU_METHOD 0 0 0 1 ECU_ADDRESS 0x70014826 FORMAT "%.15" /end MEASUREMENT
/begin MEASUREMENT LbSOC_CHG1VSOCCorEn_flg "慢充模式Ah积分修正使能标志位" UBYTE NO_COMPU_METHOD 0 0 0 1 ECU_ADDRESS 0x7000cfc2 FORMAT "%.15" /end MEASUREMENT
/begin MEASUREMENT LuSOC_UDSSOCSetIn_pct "UDS设置SOC" UWORD NO_COMPU_METHOD 0 0 0 1 ECU_ADDRESS 0x7000cf5a FORMAT "%.15" /end MEASUREMENT
/begin MEASUREMENT LeSOC_ComptrLink_enum "上位机连接状态" UBYTE NO_COMPU_METHOD 0 0 0 1 ECU_ADDRESS 0x7000d0f6 FORMAT "%.15" /end MEASUREMENT
/begin MEASUREMENT LlSOC_AvlbCpActBas_Ah "真实可用容量基值" ULONG NO_COMPU_METHOD 0 0 0 1 ECU_ADDRESS 0x7000c734 FORMAT "%.15" /end MEASUREMENT
/begin MEASUREMENT LbSOC_AvlbCpActBasValid_flg "真实可用容量基值有效标志位" UBYTE NO_COMPU_METHOD 0 0 0 1 ECU_ADDRESS 0x7000cfb8 FORMAT "%.15" /end MEASUREMENT
/begin MEASUREMENT LlSOC_ActCpCal_Ah "真实计算可用容量" SLONG NO_COMPU_METHOD 0 0 0 1 ECU_ADDRESS 0x7000c6e8 FORMAT "%.15" /end MEASUREMENT
/begin MEASUREMENT LuSOC_CHGCorrSta_enum "慢充模式Ah积分修正阶段" UBYTE NO_COMPU_METHOD 0 0 0 1 ECU_ADDRESS 0x7000cc78 FORMAT "%.15" /end MEASUREMENT
/begin MEASUREMENT LuSOC_DispSOCRaw_pct "内部显示SOC" UWORD NO_COMPU_METHOD 0 0 0 1 ECU_ADDRESS 0x7000cd9c FORMAT "%.15" /end MEASUREMENT
/begin MEASUREMENT LbSOC_FCH1VSOCCorEn_flg "快充模式Ah积分修正使能标志位" UBYTE NO_COMPU_METHOD 0 0 0 1 ECU_ADDRESS 0x7000cfd9 FORMAT "%.15" /end MEASUREMENT
/begin MEASUREMENT LuSOC_FCHCorrSta_enum "快充模式Ah积分修正阶段" UBYTE NO_COMPU_METHOD 0 0 0 1 ECU_ADDRESS 0x7000ceea FORMAT "%.15" /end MEASUREMENT
/begin MEASUREMENT LuSOC_facFCHRaw_enum "快充模式Ah积分修正系数" UWORD NO_COMPU_METHOD 0 0 0 1 ECU_ADDRESS 0x7000cfa0 FORMAT "%.15" /end MEASUREMENT
/begin MEASUREMENT LuSOC_facCHGRaw_enum "慢充模式Ah积分修正系数" UWORD NO_COMPU_METHOD 0 0 0 1 ECU_ADDRESS 0x7000cf80 FORMAT "%.15" /end MEASUREMENT
/begin MEASUREMENT LbSOC_DispSOCValid_flg "显示SOC有效标志位" UBYTE NO_COMPU_METHOD 0 0 0 1 ECU_ADDRESS 0x7000cfd5 FORMAT "%.15" /end MEASUREMENT
/begin MEASUREMENT LslSOC_CHG2VoltIMax_A "充满标志CCS" SLONG NO_COMPU_METHOD 0 0 0 1 ECU_ADDRESS 0x7000c7ca FORMAT "%.15" /end MEASUREMENT
/begin MEASUREMENT LslSOC_FCH2VoltIMax_A "充满标志位FCS" SLONG NO_COMPU_METHOD 0 0 0 1 ECU_ADDRESS 0x7000c7ce FORMAT "%.15" /end MEASUREMENT
/begin MEASUREMENT LlSOC_SOCRateNegCor_pct "显示SOC下降修正步长" ULONG NO_COMPU_METHOD 0 0 0 1 ECU_ADDRESS 0x7000c7a8 FORMAT "%.15" /end MEASUREMENT
/begin MEASUREMENT LlSOC_SOCRatePosCor_pct "显示SOC上升修正步长" ULONG NO_COMPU_METHOD 0 0 0 1 ECU_ADDRESS 0x7000c7ac FORMAT "%.15" /end MEASUREMENT
/begin MEASUREMENT LlSOC_AvlbDispCp_Ah "显示可用容量" ULONG NO_COMPU_METHOD 0 0 0 1 ECU_ADDRESS 0x7000c738 FORMAT "%.15" /end MEASUREMENT
/begin MEASUREMENT LlSOC_SOCRateBasCor_pct "SOC基础修正步长" ULONG NO_COMPU_METHOD 0 0 0 1 ECU_ADDRESS 0x7000c7a4 FORMAT "%.15" /end MEASUREMENT
/begin MEASUREMENT LlSOC_SOCfacCor_pct "SOC系数修正步长" ULONG NO_COMPU_METHOD 0 0 0 1 ECU_ADDRESS 0x7000c7b0 FORMAT "%.15" /end MEASUREMENT
/begin MEASUREMENT LuSOC_facDetaSOCRatePos_enum "SOC偏差上升步长修正速率" UWORD NO_COMPU_METHOD 0 0 0 1 ECU_ADDRESS 0x7000cf8e FORMAT "%.15" /end MEASUREMENT
/begin MEASUREMENT LuSOC_facDetaSOCRateNeg_enum "SOC偏差下降步长修正速率" UWORD NO_COMPU_METHOD 0 0 0 1 ECU_ADDRESS 0x7000cf8c FORMAT "%.15" /end MEASUREMENT
/begin MEASUREMENT LuSOC_facSOCRatePos_enum "上升步长额定修正系数" UWORD NO_COMPU_METHOD 0 0 0 1 ECU_ADDRESS 0x7000cfac FORMAT "%.15" /end MEASUREMENT
/begin MEASUREMENT LuSOC_facSOCRateNeg_enum "下降步长额定修正系数" UWORD NO_COMPU_METHOD 0 0 0 1 ECU_ADDRESS 0x7000cfaa FORMAT "%.15" /end MEASUREMENT
/begin MEASUREMENT LlSOC_ActCp_Ah "真实可用容量" ULONG NO_COMPU_METHOD 0 0 0 1 ECU_ADDRESS 0x7000c6f8 FORMAT "%.15" /end MEASUREMENT
/begin MEASUREMENT LuSOH_EEInLastSOH_pct "初始化EE存储的SOH" UWORD NO_COMPU_METHOD 0 0 0 1 ECU_ADDRESS 0x7000d40e FORMAT "%.15" /end MEASUREMENT
/begin MEASUREMENT LuSOH_EEInVOCMaxV_V "初始化EE存储的第一次上电静态最高锁存电压" UWORD NO_COMPU_METHOD 0 0 0 1 ECU_ADDRESS 0x7000d414 FORMAT "%.15" /end MEASUREMENT
/begin MEASUREMENT LlSOH_EEInDeltaAh_Ah "初始化EE存储的上次行车放电安时" ULONG NO_COMPU_METHOD 0 0 0 1 ECU_ADDRESS 0x7000d3d6 FORMAT "%.15" /end MEASUREMENT
/begin MEASUREMENT LlSOH_EEInSumDeltaAh_Ah "初始化EE存储的行车放电总安时" ULONG NO_COMPU_METHOD 0 0 0 1 ECU_ADDRESS 0x7000d3da FORMAT "%.15" /end MEASUREMENT
/begin MEASUREMENT LuSOH_EEInCycleSOH_pct "初始化EE存储的循环使用寿命" UWORD NO_COMPU_METHOD 0 0 0 1 ECU_ADDRESS 0x7000d408 FORMAT "%.15" /end MEASUREMENT
/begin MEASUREMENT LeSOH_EEInAwakeNum_enum "初始化EE存储的上电唤醒次数" UBYTE NO_COMPU_METHOD 0 0 0 1 ECU_ADDRESS 0x7000d492 FORMAT "%.15" /end MEASUREMENT
/begin MEASUREMENT LuSOH_EEInWtngSOH_pct "初始化EE存储的累计权重SOH" UWORD NO_COMPU_METHOD 0 0 0 1 ECU_ADDRESS 0x7000d418 FORMAT "%.15" /end MEASUREMENT
/begin MEASUREMENT LuSOH_EEInWtngFactor_pct "初始化EE存储的累计权重因子" UWORD NO_COMPU_METHOD 0 0 0 1 ECU_ADDRESS 0x7000d416 FORMAT "%.15" /end MEASUREMENT
/begin MEASUREMENT LeSOH_EEInTiTboxPwrDown_enum "初始化上次下电时TBox时间" ULONG NO_COMPU_METHOD 0 0 0 1 ECU_ADDRESS 0x7000d3a6 FORMAT "%.15" /end MEASUREMENT
/begin MEASUREMENT LuSOH_EEInCalendarSOH_pct "初始化EE存储的日历寿命" UWORD NO_COMPU_METHOD 0 0 0 1 ECU_ADDRESS 0x7000d406 FORMAT "%.15" /end MEASUREMENT
/begin MEASUREMENT LeSOH_EEInSOHJump_flg "初始化EE存储的SOH跳变标志位" UBYTE NO_COMPU_METHOD 0 0 0 1 ECU_ADDRESS 0x7000d493 FORMAT "%.15" /end MEASUREMENT
/begin MEASUREMENT LbSOH_TiHVOFFVld_flg "整车断高压时间有效标志位" UBYTE NO_COMPU_METHOD 0 0 0 1 ECU_ADDRESS 0x7000d48b FORMAT "%.15" /end MEASUREMENT
/begin MEASUREMENT LbSOH_TboxTimeVld_flg "Tbox时间有效标志位" UBYTE NO_COMPU_METHOD 0 0 0 1 ECU_ADDRESS 0x7000d48a FORMAT "%.15" /end MEASUREMENT
/begin MEASUREMENT VbCRTINT_EfctCap_flg "累计容量有效标志位" UBYTE NO_COMPU_METHOD 0 0 0 1 ECU_ADDRESS 0x70014a08 FORMAT "%.15" /end MEASUREMENT
/begin MEASUREMENT BMSEEPROM_Err "BMS_EEPROM 故障标志位" UBYTE NO_COMPU_METHOD 0 0 0 1 ECU_ADDRESS 0x700036f6 FORMAT "%.15" /end MEASUREMENT
/begin MEASUREMENT VlCRTINT_DCHAhOrig_Ah "累计放电总安时初始值" ULONG NO_COMPU_METHOD 0 0 0 1 ECU_ADDRESS 0x700036f2 FORMAT "%.15" /end MEASUREMENT
/begin MEASUREMENT VlCRTINT_ChrgAhOrig_Ah "累计充电总安时初始值" ULONG NO_COMPU_METHOD 0 0 0 1 ECU_ADDRESS 0x700036ee FORMAT "%.15" /end MEASUREMENT
/begin MEASUREMENT LuSOH_EEInpLastSOH_pct "EE读取的上次计算的SOH" UWORD NO_COMPU_METHOD 0 0 0 1 ECU_ADDRESS 0x7000d422 FORMAT "%.15" /end MEASUREMENT
/begin MEASUREMENT LuSOH_EEInpVOCMaxV_V "EE读取的第一次上电静态最高锁存电压" UWORD NO_COMPU_METHOD 0 0 0 1 ECU_ADDRESS 0x7000d428 FORMAT "%.15" /end MEASUREMENT
/begin MEASUREMENT LlSOH_EEInpDeltaAh_Ah "EE读取的上次行车放电安时" ULONG NO_COMPU_METHOD 0 0 0 1 ECU_ADDRESS 0x7000d3de FORMAT "%.15" /end MEASUREMENT
/begin MEASUREMENT LlSOH_EEInpSumDeltaAh_Ah "EE读取的行车放电总安时" ULONG NO_COMPU_METHOD 0 0 0 1 ECU_ADDRESS 0x7000d3e2 FORMAT "%.15" /end MEASUREMENT
/begin MEASUREMENT LuSOH_EEInpCycleSOH_pct "EE读取的循环使用寿命" UWORD NO_COMPU_METHOD 0 0 0 1 ECU_ADDRESS 0x7000d41e FORMAT "%.15" /end MEASUREMENT
/begin MEASUREMENT LeSOH_EEInpAwakeNum_enum "EE读取的上电唤醒次数" UBYTE NO_COMPU_METHOD 0 0 0 1 ECU_ADDRESS 0x7000d494 FORMAT "%.15" /end MEASUREMENT
/begin MEASUREMENT LuSOH_EEInpWtngSOH_pct "EE读取的累计权重SOH" UWORD NO_COMPU_METHOD 0 0 0 1 ECU_ADDRESS 0x7000d42c FORMAT "%.15" /end MEASUREMENT
/begin MEASUREMENT LuSOH_EEInpWtngFactor_pct "EE读取的累计权重因子" UWORD NO_COMPU_METHOD 0 0 0 1 ECU_ADDRESS 0x7000d42a FORMAT "%.15" /end MEASUREMENT
/begin MEASUREMENT LeSOH_EEInpTiTboxPwrDown_enum "EE读取的上次下电时TBox时间" ULONG NO_COMPU_METHOD 0 0 0 1 ECU_ADDRESS 0x7000d3aa FORMAT "%.15" /end MEASUREMENT
/begin MEASUREMENT LuSOH_EEInpCalendarSOH_pct "EE读取的日历寿命" UWORD NO_COMPU_METHOD 0 0 0 1 ECU_ADDRESS 0x7000d41a FORMAT "%.15" /end MEASUREMENT
/begin MEASUREMENT LeSOH_EEInpSOHJump_flg "EE读取的SOH跳变标志位" UBYTE NO_COMPU_METHOD 0 0 0 1 ECU_ADDRESS 0x7000d495 FORMAT "%.15" /end MEASUREMENT
/begin MEASUREMENT LeSOH_TiHVOFFraw_min "整车断高压时间" ULONG NO_COMPU_METHOD 0 0 0 1 ECU_ADDRESS 0x7000d3b8 FORMAT "%.15" /end MEASUREMENT
/begin MEASUREMENT LbSOH_BCUCalendarVld_flg "控制器日历时间有效标志位" UBYTE NO_COMPU_METHOD 0 0 0 1 ECU_ADDRESS 0x7000d474 FORMAT "%.15" /end MEASUREMENT
/begin MEASUREMENT LeSOH_BCUCalendarraw_min "控制器日历时间" ULONG NO_COMPU_METHOD 0 0 0 1 ECU_ADDRESS 0x7000d39e FORMAT "%.15" /end MEASUREMENT
/begin MEASUREMENT LuSOH_UDSSOHSetIn_pct "UDS设置SOH" UBYTE NO_COMPU_METHOD 0 0 0 1 ECU_ADDRESS 0x7000d4a1 FORMAT "%.15" /end MEASUREMENT
/begin MEASUREMENT LbSOH_UDSSOHSetOK_flg "UDS设置SOH标志位" UBYTE NO_COMPU_METHOD 0 0 0 1 ECU_ADDRESS 0x7000d48d FORMAT "%.15" /end MEASUREMENT
/begin MEASUREMENT BMSI_uDIR_KL15Volt_V "KL15" UWORD NO_COMPU_METHOD 0 0 0 1 ECU_ADDRESS 0x70012c12 FORMAT "%.15" /end MEASUREMENT
/begin MEASUREMENT BMSI_uDIR_KL30Volt_V "KL30" UWORD NO_COMPU_METHOD 0 0 0 1 ECU_ADDRESS 0x70012c14 FORMAT "%.15" /end MEASUREMENT
/begin MEASUREMENT BMSO_eUDS_ActSOC_pct "动力电池真实SOC" UBYTE NO_COMPU_METHOD 0 0 0 1 ECU_ADDRESS 0x70012b6f FORMAT "%.15" /end MEASUREMENT
/begin MEASUREMENT BMSO_uUDS_ModlVolt_V "模组累加电压" UWORD NO_COMPU_METHOD 0 0 0 1 ECU_ADDRESS 0x700126fa FORMAT "%.15" /end MEASUREMENT
/begin MEASUREMENT BMSO_uUDS_CellAddVolt_V "单体累加电压" UWORD NO_COMPU_METHOD 0 0 0 1 ECU_ADDRESS 0x700126d2 FORMAT "%.15" /end MEASUREMENT
/begin MEASUREMENT BMSO_uUDS_SysEqVolt_V "总电压等效电压" UWORD NO_COMPU_METHOD 0 0 0 1 ECU_ADDRESS 0x70012700 FORMAT "%.15" /end MEASUREMENT
/begin MEASUREMENT BMSO_uUDS_facTempCp_enum "温度对容量影响系数" UWORD NO_COMPU_METHOD 0 0 0 1 ECU_ADDRESS 0x70012718 FORMAT "%.15" /end MEASUREMENT
/begin MEASUREMENT BMSO_uUDS_facStatDiff_enum "静态压差对容量影响系数" UWORD NO_COMPU_METHOD 0 0 0 1 ECU_ADDRESS 0x70012716 FORMAT "%.15" /end MEASUREMENT
/begin MEASUREMENT BMSO_uUDS_facChgDiff_enum "充电压差对容量影响系数" UWORD NO_COMPU_METHOD 0 0 0 1 ECU_ADDRESS 0x70012710 FORMAT "%.15" /end MEASUREMENT
/begin MEASUREMENT BMSO_uUDS_facCmltCp_enum "SOH系数" UWORD NO_COMPU_METHOD 0 0 0 1 ECU_ADDRESS 0x70012714 FORMAT "%.15" /end MEASUREMENT
/begin MEASUREMENT BMSO_uUDS_facChgSysI_enum "充电电流对容量影响系数" UWORD NO_COMPU_METHOD 0 0 0 1 ECU_ADDRESS 0x70012712 FORMAT "%.15" /end MEASUREMENT
/begin MEASUREMENT BMSO_uUDS_DiffVolt_mV "电池系统压差" UWORD NO_COMPU_METHOD 0 0 0 1 ECU_ADDRESS 0x700126ee FORMAT "%.15" /end MEASUREMENT
/begin MEASUREMENT BMSO_eUDS_DiffTemp_C "电池系统温差" UBYTE NO_COMPU_METHOD 0 0 0 1 ECU_ADDRESS 0x70012b84 FORMAT "%.15" /end MEASUREMENT
/begin MEASUREMENT BMSI_bICAN_B1Temp1SCErr_flg "从板1中1#温度采集电路故障" UBYTE NO_COMPU_METHOD 0 0 0 1 ECU_ADDRESS 0x700130d3 FORMAT "%.15" /end MEASUREMENT
/begin MEASUREMENT BMSI_bICAN_B1Temp2SCErr_flg "从板1中2#温度采集电路故障" UBYTE NO_COMPU_METHOD 0 0 0 1 ECU_ADDRESS 0x700130de FORMAT "%.15" /end MEASUREMENT
/begin MEASUREMENT BMSI_bICAN_B1Temp3SCErr_flg "从板1中3#温度采集电路故障" UBYTE NO_COMPU_METHOD 0 0 0 1 ECU_ADDRESS 0x700130e2 FORMAT "%.15" /end MEASUREMENT
/begin MEASUREMENT BMSI_bICAN_B1Temp4SCErr_flg "从板1中4#温度采集电路故障" UBYTE NO_COMPU_METHOD 0 0 0 1 ECU_ADDRESS 0x700130e3 FORMAT "%.15" /end MEASUREMENT
/begin MEASUREMENT BMSI_bICAN_B1Temp5SCErr_flg "从板1中5#温度采集电路故障" UBYTE NO_COMPU_METHOD 0 0 0 1 ECU_ADDRESS 0x700130e4 FORMAT "%.15" /end MEASUREMENT
/begin MEASUREMENT BMSI_bICAN_B1Temp6SCErr_flg "从板1中6#温度采集电路故障" UBYTE NO_COMPU_METHOD 0 0 0 1 ECU_ADDRESS 0x700130e5 FORMAT "%.15" /end MEASUREMENT
/begin MEASUREMENT BMSI_bICAN_B1Temp7SCErr_flg "从板1中7#温度采集电路故障" UBYTE NO_COMPU_METHOD 0 0 0 1 ECU_ADDRESS 0x700130e6 FORMAT "%.15" /end MEASUREMENT
/begin MEASUREMENT BMSI_bICAN_B1Temp8SCErr_flg "从板1中8#温度采集电路故障" UBYTE NO_COMPU_METHOD 0 0 0 1 ECU_ADDRESS 0x700130e7 FORMAT "%.15" /end MEASUREMENT
/begin MEASUREMENT BMSI_bICAN_B1Temp9SCErr_flg "从板1中9#温度采集电路故障" UBYTE NO_COMPU_METHOD 0 0 0 1 ECU_ADDRESS 0x700130e8 FORMAT "%.15" /end MEASUREMENT
/begin MEASUREMENT BMSI_bICAN_B1Temp10SCErr_flg "从板1中10#温度采集电路故障" UBYTE NO_COMPU_METHOD 0 0 0 1 ECU_ADDRESS 0x700130c9 FORMAT "%.15" /end MEASUREMENT
/begin MEASUREMENT BMSI_bICAN_B1Temp11SCErr_flg "从板1中11#温度采集电路故障" UBYTE NO_COMPU_METHOD 0 0 0 1 ECU_ADDRESS 0x700130ca FORMAT "%.15" /end MEASUREMENT
/begin MEASUREMENT BMSI_bICAN_B1Temp12SCErr_flg "从板1中12#温度采集电路故障" UBYTE NO_COMPU_METHOD 0 0 0 1 ECU_ADDRESS 0x700130cb FORMAT "%.15" /end MEASUREMENT
/begin MEASUREMENT BMSI_bICAN_B1Temp13SCErr_flg "从板1中13#温度采集电路故障" UBYTE NO_COMPU_METHOD 0 0 0 1 ECU_ADDRESS 0x700130cc FORMAT "%.15" /end MEASUREMENT
/begin MEASUREMENT BMSI_bICAN_B1Temp14SCErr_flg "从板1中14#温度采集电路故障" UBYTE NO_COMPU_METHOD 0 0 0 1 ECU_ADDRESS 0x700130cd FORMAT "%.15" /end MEASUREMENT
/begin MEASUREMENT BMSI_bICAN_B1Temp15SCErr_flg "从板1中15#温度采集电路故障" UBYTE NO_COMPU_METHOD 0 0 0 1 ECU_ADDRESS 0x700130ce FORMAT "%.15" /end MEASUREMENT
/begin MEASUREMENT BMSI_bICAN_B1Temp16SCErr_flg "从板1中16#温度采集电路故障" UBYTE NO_COMPU_METHOD 0 0 0 1 ECU_ADDRESS 0x700130cf FORMAT "%.15" /end MEASUREMENT
/begin MEASUREMENT BMSI_bICAN_B1Temp17SCErr_flg "从板1中17#温度采集电路故障" UBYTE NO_COMPU_METHOD 0 0 0 1 ECU_ADDRESS 0x700130d0 FORMAT "%.15" /end MEASUREMENT
/begin MEASUREMENT BMSI_bICAN_B1Temp18SCErr_flg "从板1中18#温度采集电路故障" UBYTE NO_COMPU_METHOD 0 0 0 1 ECU_ADDRESS 0x700130d1 FORMAT "%.15" /end MEASUREMENT
/begin MEASUREMENT BMSI_bICAN_B1Temp19SCErr_flg "从板1中19#温度采集电路故障" UBYTE NO_COMPU_METHOD 0 0 0 1 ECU_ADDRESS 0x700130d2 FORMAT "%.15" /end MEASUREMENT
/begin MEASUREMENT BMSI_bICAN_B1Temp20SCErr_flg "从板1中20#温度采集电路故障" UBYTE NO_COMPU_METHOD 0 0 0 1 ECU_ADDRESS 0x700130d4 FORMAT "%.15" /end MEASUREMENT
/begin MEASUREMENT BMSI_bICAN_B1Temp21SCErr_flg "从板1中21#温度采集电路故障" UBYTE NO_COMPU_METHOD 0 0 0 1 ECU_ADDRESS 0x700130d5 FORMAT "%.15" /end MEASUREMENT
/begin MEASUREMENT BMSI_bICAN_B1Temp22SCErr_flg "从板1中22#温度采集电路故障" UBYTE NO_COMPU_METHOD 0 0 0 1 ECU_ADDRESS 0x700130d6 FORMAT "%.15" /end MEASUREMENT
/begin MEASUREMENT BMSI_bICAN_B2Temp1SCErr_flg "从板2中1#温度采集电路故障" UBYTE NO_COMPU_METHOD 0 0 0 1 ECU_ADDRESS 0x700130f3 FORMAT "%.15" /end MEASUREMENT
/begin MEASUREMENT BMSI_bICAN_B2Temp2SCErr_flg "从板2中2#温度采集电路故障" UBYTE NO_COMPU_METHOD 0 0 0 1 ECU_ADDRESS 0x700130fe FORMAT "%.15" /end MEASUREMENT
/begin MEASUREMENT BMSI_bICAN_B2Temp3SCErr_flg "从板2中3#温度采集电路故障" UBYTE NO_COMPU_METHOD 0 0 0 1 ECU_ADDRESS 0x70013102 FORMAT "%.15" /end MEASUREMENT
/begin MEASUREMENT BMSI_bICAN_B2Temp4SCErr_flg "从板2中4#温度采集电路故障" UBYTE NO_COMPU_METHOD 0 0 0 1 ECU_ADDRESS 0x70013103 FORMAT "%.15" /end MEASUREMENT
/begin MEASUREMENT BMSI_bICAN_B2Temp5SCErr_flg "从板2中5#温度采集电路故障" UBYTE NO_COMPU_METHOD 0 0 0 1 ECU_ADDRESS 0x70013104 FORMAT "%.15" /end MEASUREMENT
/begin MEASUREMENT BMSI_bICAN_B2Temp6SCErr_flg "从板2中6#温度采集电路故障" UBYTE NO_COMPU_METHOD 0 0 0 1 ECU_ADDRESS 0x70013105 FORMAT "%.15" /end MEASUREMENT
/begin MEASUREMENT BMSI_bICAN_B2Temp7SCErr_flg "从板2中7#温度采集电路故障" UBYTE NO_COMPU_METHOD 0 0 0 1 ECU_ADDRESS 0x70013106 FORMAT "%.15" /end MEASUREMENT
/begin MEASUREMENT BMSI_bICAN_B2Temp8SCErr_flg "从板2中8#温度采集电路故障" UBYTE NO_COMPU_METHOD 0 0 0 1 ECU_ADDRESS 0x70013107 FORMAT "%.15" /end MEASUREMENT
/begin MEASUREMENT BMSI_bICAN_B2Temp9SCErr_flg "从板2中9#温度采集电路故障" UBYTE NO_COMPU_METHOD 0 0 0 1 ECU_ADDRESS 0x70013108 FORMAT "%.15" /end MEASUREMENT
/begin MEASUREMENT BMSI_bICAN_B2Temp10SCErr_flg "从板2中10#温度采集电路故障" UBYTE NO_COMPU_METHOD 0 0 0 1 ECU_ADDRESS 0x700130e9 FORMAT "%.15" /end MEASUREMENT
/begin MEASUREMENT BMSI_bICAN_B2Temp11SCErr_flg "从板2中11#温度采集电路故障" UBYTE NO_COMPU_METHOD 0 0 0 1 ECU_ADDRESS 0x700130ea FORMAT "%.15" /end MEASUREMENT
/begin MEASUREMENT BMSI_bICAN_B2Temp12SCErr_flg "从板2中12#温度采集电路故障" UBYTE NO_COMPU_METHOD 0 0 0 1 ECU_ADDRESS 0x700130eb FORMAT "%.15" /end MEASUREMENT
/begin MEASUREMENT BMSI_bICAN_B2Temp13SCErr_flg "从板2中13#温度采集电路故障" UBYTE NO_COMPU_METHOD 0 0 0 1 ECU_ADDRESS 0x700130ec FORMAT "%.15" /end MEASUREMENT
/begin MEASUREMENT BMSI_bICAN_B2Temp14SCErr_flg "从板2中14#温度采集电路故障" UBYTE NO_COMPU_METHOD 0 0 0 1 ECU_ADDRESS 0x700130ed FORMAT "%.15" /end MEASUREMENT
/begin MEASUREMENT BMSI_bICAN_B2Temp15SCErr_flg "从板2中15#温度采集电路故障" UBYTE NO_COMPU_METHOD 0 0 0 1 ECU_ADDRESS 0x700130ee FORMAT "%.15" /end MEASUREMENT
/begin MEASUREMENT BMSI_bICAN_B2Temp16SCErr_flg "从板2中16#温度采集电路故障" UBYTE NO_COMPU_METHOD 0 0 0 1 ECU_ADDRESS 0x700130ef FORMAT "%.15" /end MEASUREMENT
/begin MEASUREMENT BMSI_bICAN_B2Temp17SCErr_flg "从板2中17#温度采集电路故障" UBYTE NO_COMPU_METHOD 0 0 0 1 ECU_ADDRESS 0x700130f0 FORMAT "%.15" /end MEASUREMENT
/begin MEASUREMENT BMSI_bICAN_B2Temp18SCErr_flg "从板2中18#温度采集电路故障" UBYTE NO_COMPU_METHOD 0 0 0 1 ECU_ADDRESS 0x700130f1 FORMAT "%.15" /end MEASUREMENT
/begin MEASUREMENT BMSI_bICAN_B2Temp19SCErr_flg "从板2中19#温度采集电路故障" UBYTE NO_COMPU_METHOD 0 0 0 1 ECU_ADDRESS 0x700130f2 FORMAT "%.15" /end MEASUREMENT
/begin MEASUREMENT BMSI_bICAN_B2Temp20SCErr_flg "从板2中20#温度采集电路故障" UBYTE NO_COMPU_METHOD 0 0 0 1 ECU_ADDRESS 0x700130f4 FORMAT "%.15" /end MEASUREMENT
/begin MEASUREMENT BMSI_bICAN_B2Temp21SCErr_flg "从板2中21#温度采集电路故障" UBYTE NO_COMPU_METHOD 0 0 0 1 ECU_ADDRESS 0x700130f5 FORMAT "%.15" /end MEASUREMENT
/begin MEASUREMENT BMSI_bICAN_B2Temp22SCErr_flg "从板2中22#温度采集电路故障" UBYTE NO_COMPU_METHOD 0 0 0 1 ECU_ADDRESS 0x700130f6 FORMAT "%.15" /end MEASUREMENT
/begin MEASUREMENT BMSI_bICAN_B3Temp1SCErr_flg "从板3中1#温度采集电路故障" UBYTE NO_COMPU_METHOD 0 0 0 1 ECU_ADDRESS 0x70013113 FORMAT "%.15" /end MEASUREMENT
/begin MEASUREMENT BMSI_bICAN_B3Temp2SCErr_flg "从板3中2#温度采集电路故障" UBYTE NO_COMPU_METHOD 0 0 0 1 ECU_ADDRESS 0x7001311e FORMAT "%.15" /end MEASUREMENT
/begin MEASUREMENT BMSI_bICAN_B3Temp3SCErr_flg "从板3中3#温度采集电路故障" UBYTE NO_COMPU_METHOD 0 0 0 1 ECU_ADDRESS 0x70013122 FORMAT "%.15" /end MEASUREMENT
/begin MEASUREMENT BMSI_bICAN_B3Temp4SCErr_flg "从板3中4#温度采集电路故障" UBYTE NO_COMPU_METHOD 0 0 0 1 ECU_ADDRESS 0x70013123 FORMAT "%.15" /end MEASUREMENT
/begin MEASUREMENT BMSI_bICAN_B3Temp5SCErr_flg "从板3中5#温度采集电路故障" UBYTE NO_COMPU_METHOD 0 0 0 1 ECU_ADDRESS 0x70013124 FORMAT "%.15" /end MEASUREMENT
/begin MEASUREMENT BMSI_bICAN_B3Temp6SCErr_flg "从板3中6#温度采集电路故障" UBYTE NO_COMPU_METHOD 0 0 0 1 ECU_ADDRESS 0x70013125 FORMAT "%.15" /end MEASUREMENT
/begin MEASUREMENT BMSI_bICAN_B3Temp7SCErr_flg "从板3中7#温度采集电路故障" UBYTE NO_COMPU_METHOD 0 0 0 1 ECU_ADDRESS 0x70013126 FORMAT "%.15" /end MEASUREMENT
/begin MEASUREMENT BMSI_bICAN_B3Temp8SCErr_flg "从板3中8#温度采集电路故障" UBYTE NO_COMPU_METHOD 0 0 0 1 ECU_ADDRESS 0x70013127 FORMAT "%.15" /end MEASUREMENT
/begin MEASUREMENT BMSI_bICAN_B3Temp9SCErr_flg "从板3中9#温度采集电路故障" UBYTE NO_COMPU_METHOD 0 0 0 1 ECU_ADDRESS 0x70013128 FORMAT "%.15" /end MEASUREMENT
/begin MEASUREMENT BMSI_bICAN_B3Temp10SCErr_flg "从板3中10#温度采集电路故障" UBYTE NO_COMPU_METHOD 0 0 0 1 ECU_ADDRESS 0x70013109 FORMAT "%.15" /end MEASUREMENT
/begin MEASUREMENT BMSI_bICAN_B3Temp11SCErr_flg "从板3中11#温度采集电路故障" UBYTE NO_COMPU_METHOD 0 0 0 1 ECU_ADDRESS 0x7001310a FORMAT "%.15" /end MEASUREMENT
/begin MEASUREMENT BMSI_bICAN_B3Temp12SCErr_flg "从板3中12#温度采集电路故障" UBYTE NO_COMPU_METHOD 0 0 0 1 ECU_ADDRESS 0x7001310b FORMAT "%.15" /end MEASUREMENT
/begin MEASUREMENT BMSI_bICAN_B3Temp13SCErr_flg "从板3中13#温度采集电路故障" UBYTE NO_COMPU_METHOD 0 0 0 1 ECU_ADDRESS 0x7001310c FORMAT "%.15" /end MEASUREMENT
/begin MEASUREMENT BMSI_bICAN_B3Temp14SCErr_flg "从板3中14#温度采集电路故障" UBYTE NO_COMPU_METHOD 0 0 0 1 ECU_ADDRESS 0x7001310d FORMAT "%.15" /end MEASUREMENT
/begin MEASUREMENT BMSI_bICAN_B3Temp15SCErr_flg "从板3中15#温度采集电路故障" UBYTE NO_COMPU_METHOD 0 0 0 1 ECU_ADDRESS 0x7001310e FORMAT "%.15" /end MEASUREMENT
/begin MEASUREMENT BMSI_bICAN_B3Temp16SCErr_flg "从板3中16#温度采集电路故障" UBYTE NO_COMPU_METHOD 0 0 0 1 ECU_ADDRESS 0x7001310f FORMAT "%.15" /end MEASUREMENT
/begin MEASUREMENT BMSI_bICAN_B3Temp17SCErr_flg "从板3中17#温度采集电路故障" UBYTE NO_COMPU_METHOD 0 0 0 1 ECU_ADDRESS 0x70013110 FORMAT "%.15" /end MEASUREMENT
/begin MEASUREMENT BMSI_bICAN_B3Temp18SCErr_flg "从板3中18#温度采集电路故障" UBYTE NO_COMPU_METHOD 0 0 0 1 ECU_ADDRESS 0x70013111 FORMAT "%.15" /end MEASUREMENT
/begin MEASUREMENT BMSI_bICAN_B3Temp19SCErr_flg "从板3中19#温度采集电路故障" UBYTE NO_COMPU_METHOD 0 0 0 1 ECU_ADDRESS 0x70013112 FORMAT "%.15" /end MEASUREMENT
/begin MEASUREMENT BMSI_bICAN_B3Temp20SCErr_flg "从板3中20#温度采集电路故障" UBYTE NO_COMPU_METHOD 0 0 0 1 ECU_ADDRESS 0x70013114 FORMAT "%.15" /end MEASUREMENT
/begin MEASUREMENT BMSI_bICAN_B3Temp21SCErr_flg "从板3中21#温度采集电路故障" UBYTE NO_COMPU_METHOD 0 0 0 1 ECU_ADDRESS 0x70013115 FORMAT "%.15" /end MEASUREMENT
/begin MEASUREMENT BMSI_bICAN_B3Temp22SCErr_flg "从板3中22#温度采集电路故障" UBYTE NO_COMPU_METHOD 0 0 0 1 ECU_ADDRESS 0x70013116 FORMAT "%.15" /end MEASUREMENT
/begin MEASUREMENT BMSI_bICAN_B4Temp1SCErr_flg "从板4中1#温度采集电路故障" UBYTE NO_COMPU_METHOD 0 0 0 1 ECU_ADDRESS 0x70013133 FORMAT "%.15" /end MEASUREMENT
/begin MEASUREMENT BMSI_bICAN_B4Temp2SCErr_flg "从板4中2#温度采集电路故障" UBYTE NO_COMPU_METHOD 0 0 0 1 ECU_ADDRESS 0x7001313e FORMAT "%.15" /end MEASUREMENT
/begin MEASUREMENT BMSI_bICAN_B4Temp3SCErr_flg "从板4中3#温度采集电路故障" UBYTE NO_COMPU_METHOD 0 0 0 1 ECU_ADDRESS 0x70013142 FORMAT "%.15" /end MEASUREMENT
/begin MEASUREMENT BMSI_bICAN_B4Temp4SCErr_flg "从板4中4#温度采集电路故障" UBYTE NO_COMPU_METHOD 0 0 0 1 ECU_ADDRESS 0x70013143 FORMAT "%.15" /end MEASUREMENT
/begin MEASUREMENT BMSI_bICAN_B4Temp5SCErr_flg "从板4中5#温度采集电路故障" UBYTE NO_COMPU_METHOD 0 0 0 1 ECU_ADDRESS 0x70013144 FORMAT "%.15" /end MEASUREMENT
/begin MEASUREMENT BMSI_bICAN_B4Temp6SCErr_flg "从板4中6#温度采集电路故障" UBYTE NO_COMPU_METHOD 0 0 0 1 ECU_ADDRESS 0x70013145 FORMAT "%.15" /end MEASUREMENT
/begin MEASUREMENT BMSI_bICAN_B4Temp7SCErr_flg "从板4中7#温度采集电路故障" UBYTE NO_COMPU_METHOD 0 0 0 1 ECU_ADDRESS 0x70013146 FORMAT "%.15" /end MEASUREMENT
/begin MEASUREMENT BMSI_bICAN_B4Temp8SCErr_flg "从板4中8#温度采集电路故障" UBYTE NO_COMPU_METHOD 0 0 0 1 ECU_ADDRESS 0x70013147 FORMAT "%.15" /end MEASUREMENT
/begin MEASUREMENT BMSI_bICAN_B4Temp9SCErr_flg "从板4中9#温度采集电路故障" UBYTE NO_COMPU_METHOD 0 0 0 1 ECU_ADDRESS 0x70013148 FORMAT "%.15" /end MEASUREMENT
/begin MEASUREMENT BMSI_bICAN_B4Temp10SCErr_flg "从板4中10#温度采集电路故障" UBYTE NO_COMPU_METHOD 0 0 0 1 ECU_ADDRESS 0x70013129 FORMAT "%.15" /end MEASUREMENT
/begin MEASUREMENT BMSI_bICAN_B4Temp11SCErr_flg "从板4中11#温度采集电路故障" UBYTE NO_COMPU_METHOD 0 0 0 1 ECU_ADDRESS 0x7001312a FORMAT "%.15" /end MEASUREMENT
/begin MEASUREMENT BMSI_bICAN_B4Temp12SCErr_flg "从板4中12#温度采集电路故障" UBYTE NO_COMPU_METHOD 0 0 0 1 ECU_ADDRESS 0x7001312b FORMAT "%.15" /end MEASUREMENT
/begin MEASUREMENT BMSI_bICAN_B4Temp13SCErr_flg "从板4中13#温度采集电路故障" UBYTE NO_COMPU_METHOD 0 0 0 1 ECU_ADDRESS 0x7001312c FORMAT "%.15" /end MEASUREMENT
/begin MEASUREMENT BMSI_bICAN_B4Temp14SCErr_flg "从板4中14#温度采集电路故障" UBYTE NO_COMPU_METHOD 0 0 0 1 ECU_ADDRESS 0x7001312d FORMAT "%.15" /end MEASUREMENT
/begin MEASUREMENT BMSI_bICAN_B4Temp15SCErr_flg "从板4中15#温度采集电路故障" UBYTE NO_COMPU_METHOD 0 0 0 1 ECU_ADDRESS 0x7001312e FORMAT "%.15" /end MEASUREMENT
/begin MEASUREMENT BMSI_bICAN_B4Temp16SCErr_flg "从板4中16#温度采集电路故障" UBYTE NO_COMPU_METHOD 0 0 0 1 ECU_ADDRESS 0x7001312f FORMAT "%.15" /end MEASUREMENT
/begin MEASUREMENT BMSI_bICAN_B4Temp17SCErr_flg "从板4中17#温度采集电路故障" UBYTE NO_COMPU_METHOD 0 0 0 1 ECU_ADDRESS 0x70013130 FORMAT "%.15" /end MEASUREMENT
/begin MEASUREMENT BMSI_bICAN_B4Temp18SCErr_flg "从板4中18#温度采集电路故障" UBYTE NO_COMPU_METHOD 0 0 0 1 ECU_ADDRESS 0x70013131 FORMAT "%.15" /end MEASUREMENT
/begin MEASUREMENT BMSI_bICAN_B4Temp19SCErr_flg "从板4中19#温度采集电路故障" UBYTE NO_COMPU_METHOD 0 0 0 1 ECU_ADDRESS 0x70013132 FORMAT "%.15" /end MEASUREMENT
/begin MEASUREMENT BMSI_bICAN_B4Temp20SCErr_flg "从板4中20#温度采集电路故障" UBYTE NO_COMPU_METHOD 0 0 0 1 ECU_ADDRESS 0x70013134 FORMAT "%.15" /end MEASUREMENT
/begin MEASUREMENT BMSI_bICAN_B4Temp21SCErr_flg "从板4中21#温度采集电路故障" UBYTE NO_COMPU_METHOD 0 0 0 1 ECU_ADDRESS 0x70013135 FORMAT "%.15" /end MEASUREMENT
/begin MEASUREMENT BMSI_bICAN_B4Temp22SCErr_flg "从板4中22#温度采集电路故障" UBYTE NO_COMPU_METHOD 0 0 0 1 ECU_ADDRESS 0x70013136 FORMAT "%.15" /end MEASUREMENT
/begin MEASUREMENT LeSOH_EepromErr_enum "EE故障标志位_SOH" UBYTE NO_COMPU_METHOD 0 0 0 1 ECU_ADDRESS 0x7000d496 FORMAT "%.15" /end MEASUREMENT
/begin MEASUREMENT LeSOH_TboxYear_year "Tbox时间年" UWORD NO_COMPU_METHOD 0 0 0 1 ECU_ADDRESS 0x7000d3b6 FORMAT "%.15" /end MEASUREMENT
/begin MEASUREMENT LeSOH_TboxMonth_month "Tbox时间月" UBYTE NO_COMPU_METHOD 0 0 0 1 ECU_ADDRESS 0x7000d49b FORMAT "%.15" /end MEASUREMENT
/begin MEASUREMENT LeSOH_TboxDay_day "Tbox时间日" UBYTE NO_COMPU_METHOD 0 0 0 1 ECU_ADDRESS 0x7000d498 FORMAT "%.15" /end MEASUREMENT
/begin MEASUREMENT LeSOH_TboxHour_hour "Tbox时间时" UBYTE NO_COMPU_METHOD 0 0 0 1 ECU_ADDRESS 0x7000d499 FORMAT "%.15" /end MEASUREMENT
/begin MEASUREMENT VeCCS_HVDwnReqChg_enum "动力电池系统充电下电请求" UBYTE NO_COMPU_METHOD 0 0 0 1 ECU_ADDRESS 0x70014ae2 FORMAT "%.15" /end MEASUREMENT
/begin MEASUREMENT VeCCS_FCHVDwnReq_enum "动力电池系统快充充电下电请求" UBYTE NO_COMPU_METHOD 0 0 0 1 ECU_ADDRESS 0x70014ae1 FORMAT "%.15" /end MEASUREMENT
/begin MEASUREMENT BMSO_uUDS_ChgMaxIReq_A "动力电池最大允许充电电流" UWORD NO_COMPU_METHOD 0 0 0 1 ECU_ADDRESS 0x700126da FORMAT "%.15" /end MEASUREMENT
/begin MEASUREMENT VbCCS_BattChgrErrSC_flg "动力电池充电故障" UBYTE NO_COMPU_METHOD 0 0 0 1 ECU_ADDRESS 0x700149f9 FORMAT "%.15" /end MEASUREMENT
/begin MEASUREMENT VbCCS_BattDisChgrErrSC_flg "动力电池放电故障" UBYTE NO_COMPU_METHOD 0 0 0 1 ECU_ADDRESS 0x700149fa FORMAT "%.15" /end MEASUREMENT
/begin MEASUREMENT KsBCM_MotHeatSOCDnLimit_pct "SOC标定3" UBYTE NO_COMPU_METHOD 0 0 0 1 ECU_ADDRESS 0xaf0100dc FORMAT "%.15" /end MEASUREMENT
/begin MEASUREMENT LeSOH_TBoxTime_min "当前Tbox时间" ULONG NO_COMPU_METHOD 0 0 0 1 ECU_ADDRESS 0x7000d3b2 FORMAT "%.15" /end MEASUREMENT
/begin MEASUREMENT LbSOH_AwakeNumLck_flg "上电唤醒次数锁存标志位" UBYTE NO_COMPU_METHOD 0 0 0 1 ECU_ADDRESS 0x7000d473 FORMAT "%.15" /end MEASUREMENT
/begin MEASUREMENT LeSOH_AwakeNum_enum "上电唤醒次数" UBYTE NO_COMPU_METHOD 0 0 0 1 ECU_ADDRESS 0x7000d48f FORMAT "%.15" /end MEASUREMENT
/begin MEASUREMENT LeSOH_TiSelfDCH_min "自放电时间" ULONG NO_COMPU_METHOD 0 0 0 1 ECU_ADDRESS 0x7000d3c0 FORMAT "%.15" /end MEASUREMENT
/begin MEASUREMENT LlSOH_SumDeltaAh_Ah "行车放电总安时" ULONG NO_COMPU_METHOD 0 0 0 1 ECU_ADDRESS 0x7000d3ea FORMAT "%.15" /end MEASUREMENT
/begin MEASUREMENT LbSOH_OCVMAXVld_enum "OCV使能状态标志位_SOH" UBYTE NO_COMPU_METHOD 0 0 0 1 ECU_ADDRESS 0x7000d480 FORMAT "%.15" /end MEASUREMENT
/begin MEASUREMENT LbCRTINT_MCUCapLife_flg "MCU备份存储累计容量报文接收标志位" UBYTE NO_COMPU_METHOD 0 0 0 1 ECU_ADDRESS 0x700036f8 FORMAT "%.15" /end MEASUREMENT
/begin MEASUREMENT LbCRTINT_MCUE2Err_flg "MCU的EE故障标志位" UBYTE NO_COMPU_METHOD 0 0 0 1 ECU_ADDRESS 0x700036f9 FORMAT "%.15" /end MEASUREMENT
/begin MEASUREMENT LbCRTINT_ODOLife_flg "ODO报文生命信号" UBYTE NO_COMPU_METHOD 0 0 0 1 ECU_ADDRESS 0x700036fb FORMAT "%.15" /end MEASUREMENT
/begin MEASUREMENT LuSOH_SOHi_pct "SOHi" FLOAT32_IEEE NO_COMPU_METHOD 0 0 0 1 ECU_ADDRESS 0x7000d44c FORMAT "%.15" /end MEASUREMENT
/begin MEASUREMENT LuSOH_WtngFactor_pct "本次权重因子Pi" FLOAT32_IEEE NO_COMPU_METHOD 0 0 0 1 ECU_ADDRESS 0x7000d458 FORMAT "%.15" /end MEASUREMENT
/begin MEASUREMENT LuSOH_WtngSOH_pct "计算本次权重SOH" FLOAT32_IEEE NO_COMPU_METHOD 0 0 0 1 ECU_ADDRESS 0x7000d45e FORMAT "%.15" /end MEASUREMENT
/begin MEASUREMENT LuSOH_WtngFactorSum_pct "累计权重因子P" UWORD NO_COMPU_METHOD 0 0 0 1 ECU_ADDRESS 0x7000d456 FORMAT "%.15" /end MEASUREMENT
/begin MEASUREMENT LuSOH_WtngSOHSum_pct "累计权重SOH" UWORD NO_COMPU_METHOD 0 0 0 1 ECU_ADDRESS 0x7000d45c FORMAT "%.15" /end MEASUREMENT
/begin MEASUREMENT LuSOH_SOHEstim_pct "估算SOH" UWORD NO_COMPU_METHOD 0 0 0 1 ECU_ADDRESS 0x7000d442 FORMAT "%.15" /end MEASUREMENT
/begin MEASUREMENT VuSOH_EPRWtngFactor_pct "输出累计权重因子P" UWORD NO_COMPU_METHOD 0 0 0 1 ECU_ADDRESS 0x7001486c FORMAT "%.15" /end MEASUREMENT
/begin MEASUREMENT VuSOH_EPRWtngSOH_pct "输出累计权重SOH" UWORD NO_COMPU_METHOD 0 0 0 1 ECU_ADDRESS 0x7001486e FORMAT "%.15" /end MEASUREMENT
/begin MEASUREMENT VlSOH_EPRSumDeltaAh_Ah "输出行车放电总安时" ULONG NO_COMPU_METHOD 0 0 0 1 ECU_ADDRESS 0x70013de8 FORMAT "%.15" /end MEASUREMENT
/begin MEASUREMENT LuSOH_SOHCalc_pct "计算SOH" UWORD NO_COMPU_METHOD 0 0 0 1 ECU_ADDRESS 0x7000d440 FORMAT "%.15" /end MEASUREMENT
/begin MEASUREMENT LeSOH_TiPackPrdct_min "电池包下线时间" ULONG NO_COMPU_METHOD 0 0 0 1 ECU_ADDRESS 0x7000d3bc FORMAT "%.15" /end MEASUREMENT
/begin MEASUREMENT LbSOH_CalendarSOHVld_flg "日历寿命有效标志位" UBYTE NO_COMPU_METHOD 0 0 0 1 ECU_ADDRESS 0x7000d475 FORMAT "%.15" /end MEASUREMENT
/begin MEASUREMENT LeSOH_CalendarTime_min "日历时间" ULONG NO_COMPU_METHOD 0 0 0 1 ECU_ADDRESS 0x7000d3a2 FORMAT "%.15" /end MEASUREMENT
/begin MEASUREMENT LuSOH_CalendarSOH_pct "日历寿命" UWORD NO_COMPU_METHOD 0 0 0 1 ECU_ADDRESS 0x7000d3f8 FORMAT "%.15" /end MEASUREMENT
/begin MEASUREMENT LbSOH_CycleSOHVld_flg "循环使用寿命有效标志位" UBYTE NO_COMPU_METHOD 0 0 0 1 ECU_ADDRESS 0x7000d476 FORMAT "%.15" /end MEASUREMENT
/begin MEASUREMENT LuSOH_CycleSOH_pct "循环使用寿命" UWORD NO_COMPU_METHOD 0 0 0 1 ECU_ADDRESS 0x7000d3fc FORMAT "%.15" /end MEASUREMENT
/begin MEASUREMENT LuSOH_TolChaAhSOH_pct "累计安时寿命" UWORD NO_COMPU_METHOD 0 0 0 1 ECU_ADDRESS 0x7000d450 FORMAT "%.15" /end MEASUREMENT
/begin MEASUREMENT LbSOH_ODORangeVld_flg "ODO里程有效标志位" UBYTE NO_COMPU_METHOD 0 0 0 1 ECU_ADDRESS 0x7000d482 FORMAT "%.15" /end MEASUREMENT
/begin MEASUREMENT LlSOH_TolChaAh_Ah "累计充电容量" ULONG NO_COMPU_METHOD 0 0 0 1 ECU_ADDRESS 0x7000d3ee FORMAT "%.15" /end MEASUREMENT
/begin MEASUREMENT LuSOH_DeltaSOHlimit_pct "delta_SOHlimit" UWORD NO_COMPU_METHOD 0 0 0 1 ECU_ADDRESS 0x7000d404 FORMAT "%.15" /end MEASUREMENT
/begin MEASUREMENT LuSOH_SOHLi_pct "SOH_1" UWORD NO_COMPU_METHOD 0 0 0 1 ECU_ADDRESS 0x7000d446 FORMAT "%.15" /end MEASUREMENT
/begin MEASUREMENT LuSOH_SOH1_pct "SOH1" UWORD NO_COMPU_METHOD 0 0 0 1 ECU_ADDRESS 0x7000d43c FORMAT "%.15" /end MEASUREMENT
/begin MEASUREMENT LbSOH_MDLChange_flg "SOH模型变更标志位" UBYTE NO_COMPU_METHOD 0 0 0 1 ECU_ADDRESS 0x7000d47e FORMAT "%.15" /end MEASUREMENT
/begin MEASUREMENT VuSOH_EPRCheckCode_enum "输出checkcode" UWORD NO_COMPU_METHOD 0 0 0 1 ECU_ADDRESS 0x7001485e FORMAT "%.15" /end MEASUREMENT
/begin MEASUREMENT LuSOH_SOH2_pct "SOH2" UWORD NO_COMPU_METHOD 0 0 0 1 ECU_ADDRESS 0x7000d43e FORMAT "%.15" /end MEASUREMENT
/begin MEASUREMENT LuSOH_ActSOH_pct "真实SOH" UWORD NO_COMPU_METHOD 0 0 0 1 ECU_ADDRESS 0x7000d3f6 FORMAT "%.15" /end MEASUREMENT
/begin MEASUREMENT VeSOH_SOHJump_flg "SOH跳变标志位" UBYTE NO_COMPU_METHOD 0 0 0 1 ECU_ADDRESS 0x7000d4a2 FORMAT "%.15" /end MEASUREMENT
/begin MEASUREMENT LbSOH_MCUE2Err_flg "MCU控制器EE故障标志位" UBYTE NO_COMPU_METHOD 0 0 0 1 ECU_ADDRESS 0x7000d47a FORMAT "%.15" /end MEASUREMENT
/begin MEASUREMENT VuSOH_SOH_pct "输出SOH" UBYTE NO_COMPU_METHOD 0 0 0 1 ECU_ADDRESS 0x70014eef FORMAT "%.15" /end MEASUREMENT
/begin MEASUREMENT LbSOC_OCVReJudge_flg "OCV锁存不使能标志位" UBYTE NO_COMPU_METHOD 0 0 0 1 ECU_ADDRESS 0x7000cfed FORMAT "%.15" /end MEASUREMENT
/begin MEASUREMENT LbSOC_OCVUnEna_flg "压差再判断标志位" UBYTE NO_COMPU_METHOD 0 0 0 1 ECU_ADDRESS 0x7000cff0 FORMAT "%.15" /end MEASUREMENT
/begin MEASUREMENT LeSOC_VoltErrCorDone_enum "压差修正完成状态" UBYTE NO_COMPU_METHOD 0 0 0 1 ECU_ADDRESS 0x7000d103 FORMAT "%.15" /end MEASUREMENT
/begin MEASUREMENT LuSOC_BattAgingCor_V "电池系统老化修正电压" UWORD NO_COMPU_METHOD 0 0 0 1 ECU_ADDRESS 0x7000c8e4 FORMAT "%.15" /end MEASUREMENT
/begin MEASUREMENT LeSOC_BattAgingFacValid_enum "电池老化系数有效状态" UBYTE NO_COMPU_METHOD 0 0 0 1 ECU_ADDRESS 0x7000d00d FORMAT "%.15" /end MEASUREMENT
/begin MEASUREMENT LuSOC_OCVErrSOC_pct "电池系统压差偏差" UWORD NO_COMPU_METHOD 0 0 0 1 ECU_ADDRESS 0x7000cef8 FORMAT "%.15" /end MEASUREMENT
/begin MEASUREMENT LbSOC_SOCTempRangeEn_flg "SOC温度边界使能标志位" UBYTE NO_COMPU_METHOD 0 0 0 1 ECU_ADDRESS 0x7000d000 FORMAT "%.15" /end MEASUREMENT
/begin MEASUREMENT LbSOC_SOCTempMaxEn_flg "当前温度上限SOC使能标志位" UBYTE NO_COMPU_METHOD 0 0 0 1 ECU_ADDRESS 0x7000cfff FORMAT "%.15" /end MEASUREMENT
/begin MEASUREMENT LbSOC_UDSSOCSet_flg "LbSOC_UDSSOCSet_flg" UBYTE NO_COMPU_METHOD 0 0 0 1 ECU_ADDRESS 0x7000d009 FORMAT "%.15" /end MEASUREMENT
/begin MEASUREMENT LbSOC_SmallCurrMod_flg "小电流模式" UBYTE NO_COMPU_METHOD 0 0 0 1 ECU_ADDRESS 0x7000d002 FORMAT "%.15" /end MEASUREMENT
/begin MEASUREMENT log_VbFSMOCR_FluxADualChkErr_flg "磁通阀模拟通道冗余校验故障" UBYTE NO_COMPU_METHOD 0 0 0 1 ECU_ADDRESS 0x7001874f FORMAT "%.15" /end MEASUREMENT
/begin MEASUREMENT log_VbFSMOCR_FluxARngErr_flg "磁通阀模拟通道超范围校验故障" UBYTE NO_COMPU_METHOD 0 0 0 1 ECU_ADDRESS 0x70018751 FORMAT "%.15" /end MEASUREMENT
/begin MEASUREMENT log_VfFSMOCR_QMCurr_A "系统电流值" UBYTE NO_COMPU_METHOD 0 0 0 1 ECU_ADDRESS 0x7001873c FORMAT "%.15" /end MEASUREMENT
/begin MEASUREMENT log_VfFSMOCR_FSCurr_A "系统电流值FS" UBYTE NO_COMPU_METHOD 0 0 0 1 ECU_ADDRESS 0x70018734 FORMAT "%.15" /end MEASUREMENT
/begin MEASUREMENT LuSOH_EEInDispSOH_pct "初始化EE存储的显示SOH" UWORD NO_COMPU_METHOD 0 0 0 1 ECU_ADDRESS 0x7000d40a FORMAT "%.15" /end MEASUREMENT
/begin MEASUREMENT LuSOH_EEInODORange_Km "初始化EE存储的ODO里程" ULONG NO_COMPU_METHOD 0 0 0 1 ECU_ADDRESS 0x7000d410 FORMAT "%.15" /end MEASUREMENT
/begin MEASUREMENT LuSOH_SOHLimitUp_pct "SOHLimitUp" UWORD NO_COMPU_METHOD 0 0 0 1 ECU_ADDRESS 0x7000d44a FORMAT "%.15" /end MEASUREMENT
/begin MEASUREMENT LuSOH_SOHLimitDn_pct "SOHLimitDown" UWORD NO_COMPU_METHOD 0 0 0 1 ECU_ADDRESS 0x7000d448 FORMAT "%.15" /end MEASUREMENT
/begin MEASUREMENT LuSOH_EEInpDispSOH_pct "EE读取的显示SOH" UWORD NO_COMPU_METHOD 0 0 0 1 ECU_ADDRESS 0x7000d420 FORMAT "%.15" /end MEASUREMENT
/begin MEASUREMENT LuSOH_EEInpODORange_Km "EE读取的ODO里程" ULONG NO_COMPU_METHOD 0 0 0 1 ECU_ADDRESS 0x7000d424 FORMAT "%.15" /end MEASUREMENT
/begin MEASUREMENT LeSOH_AccFactor_enum "K系数" UWORD NO_COMPU_METHOD 0 0 0 1 ECU_ADDRESS 0x7000d39c FORMAT "%.15" /end MEASUREMENT
/begin MEASUREMENT LuSOH_RealSOH_pct "SOHre" UWORD NO_COMPU_METHOD 0 0 0 1 ECU_ADDRESS 0x7000d438 FORMAT "%.15" /end MEASUREMENT
/begin MEASUREMENT LuSOH_DeltaODO_Km "delta_ODO" SLONG NO_COMPU_METHOD 0 0 0 1 ECU_ADDRESS 0x7000d3fe FORMAT "%.15" /end MEASUREMENT
/begin MEASUREMENT VeCTM_ChgRePutStTEST_enum "再次插枪标志位" UBYTE NO_COMPU_METHOD 0 0 0 1 ECU_ADDRESS 0x70003c2e FORMAT "%.15" /end MEASUREMENT
/begin MEASUREMENT KbCRTINT_MCUEnable_flg "MCU替换容量使能标志位" UBYTE NO_COMPU_METHOD 0 0 0 1 ECU_ADDRESS 0xaf011d75 FORMAT "%.15" /end MEASUREMENT
/begin MEASUREMENT VeCRTINT_CapMod_enum "累计容量修正标志位" UBYTE NO_COMPU_METHOD 0 0 0 1 ECU_ADDRESS 0x70014aee FORMAT "%.15" /end MEASUREMENT
/begin MEASUREMENT LeCRTINT_CapMod_enum "EE存储的累计容量修正标志位" UBYTE NO_COMPU_METHOD 0 0 0 1 ECU_ADDRESS 0x70003700 FORMAT "%.15" /end MEASUREMENT
/begin MEASUREMENT LbCRTINT_MCUMsg_enum "MCU信号接收标志位" UBYTE NO_COMPU_METHOD 0 0 0 1 ECU_ADDRESS 0x700036fa FORMAT "%.15" /end MEASUREMENT
/begin MEASUREMENT log_VbCTCTR_BMSBrush_flg "BMS刷写" UBYTE NO_COMPU_METHOD 0 0 0 1 ECU_ADDRESS 0x700038ed FORMAT "%.15" /end MEASUREMENT
/begin MEASUREMENT log_VbCTCTR_BCUPowerDownCmd_flg "BMS下电指令" UBYTE NO_COMPU_METHOD 0 0 0 1 ECU_ADDRESS 0x700038eb FORMAT "%.15" /end MEASUREMENT
/begin MEASUREMENT log_VbCTCTR_AwakeValue_flg "BMS唤醒指令" UBYTE NO_COMPU_METHOD 0 0 0 1 ECU_ADDRESS 0x700038e8 FORMAT "%.15" /end MEASUREMENT
/begin MEASUREMENT VbCTCTR_BatIsoTestCmd_flg "绝缘功能开关标志位" UBYTE NO_COMPU_METHOD 0 0 0 1 ECU_ADDRESS 0x70014a0e FORMAT "%.15" /end MEASUREMENT
/begin MEASUREMENT VbFTD_PwrDbPrjErr_flg "动力电池二级保护故障标志" UBYTE NO_COMPU_METHOD 0 0 0 1 ECU_ADDRESS 0x70014a82 FORMAT "%.15" /end MEASUREMENT
/begin MEASUREMENT VuSOH_CycleSOH_pct "RX功率使用SOH" UWORD NO_COMPU_METHOD 0 0 0 1 ECU_ADDRESS 0x7001485a FORMAT "%.15" /end MEASUREMENT
/begin MEASUREMENT LuSOC_CVDispSOC_pct "CV显示SOC" UWORD NO_COMPU_METHOD 0 0 0 1 ECU_ADDRESS 0x7000cc7a FORMAT "%.15" /end MEASUREMENT
/begin MEASUREMENT LlCRTINT_MCUDisAhODO_Ah "MCUEE存储累计容量1" ULONG NO_COMPU_METHOD 0 0 0 1 ECU_ADDRESS 0x700036d0 FORMAT "%.15" /end MEASUREMENT
/begin MEASUREMENT LlCRTINT_MCUChrgAhODO_Ah "MCUEE存储累计容量2" ULONG NO_COMPU_METHOD 0 0 0 1 ECU_ADDRESS 0x700036cc FORMAT "%.15" /end MEASUREMENT
/begin MEASUREMENT LuSOC_BattDisChgCutoff_V "放电截止电压" UWORD NO_COMPU_METHOD 0 0 0 1 ECU_ADDRESS 0x7000cc70 FORMAT "%.15" /end MEASUREMENT
/begin MEASUREMENT LuSOC_facBattAgingCp_enum "荣休修正容量系数" UWORD NO_COMPU_METHOD 0 0 0 1 ECU_ADDRESS 0x7000cf6a FORMAT "%.15" /end MEASUREMENT
/begin MEASUREMENT LlSOC_ActCpMax_Ah "最大真实容量" ULONG NO_COMPU_METHOD 0 0 0 1 ECU_ADDRESS 0x7000c6f0 FORMAT "%.15" /end MEASUREMENT
/begin MEASUREMENT VeSOC_BattDiffSt_enum "静态不均衡故障标志位" UBYTE NO_COMPU_METHOD 0 0 0 1 ECU_ADDRESS 0x70014b70 FORMAT "%.15" /end MEASUREMENT
/begin MEASUREMENT VbSOC_BattOvrChgFault_flg "过充故障标志位" UBYTE NO_COMPU_METHOD 0 0 0 1 ECU_ADDRESS 0x70014abc FORMAT "%.15" /end MEASUREMENT
/begin MEASUREMENT VuSOC_BattSOHRatedCp_Ah "SOH衰减后的标称容量" UWORD NO_COMPU_METHOD 0 0 0 1 ECU_ADDRESS 0x70014718 FORMAT "%.15" /end MEASUREMENT
/begin MEASUREMENT VuSOC_BattCellSOC_pct "单体SOC" UWORD NO_COMPU_METHOD 0 0 0 1 ECU_ADDRESS 0x70014610 FORMAT "%.15" /end MEASUREMENT
/begin MEASUREMENT VbSOC_BattCellSOCOk_flg "单体SOC有效标志位" UBYTE NO_COMPU_METHOD 0 0 0 1 ECU_ADDRESS 0x70014abb FORMAT "%.15" /end MEASUREMENT
/begin MEASUREMENT LuSOC_EEInpAllCVSOC_pct "EE读取的单体SOC" UWORD NO_COMPU_METHOD 0 0 0 1 ECU_ADDRESS 0x7000cdca FORMAT "%.15" /end MEASUREMENT
/begin MEASUREMENT VeSOC_BattCellSOCOk_enum "单体SOC有效状态" UBYTE NO_COMPU_METHOD 0 0 0 1 ECU_ADDRESS 0x70014b6e FORMAT "%.15" /end MEASUREMENT
/begin MEASUREMENT LeSOC_CellVLowErr_enum "SOC单体欠压故障" UBYTE NO_COMPU_METHOD 0 0 0 1 ECU_ADDRESS 0x7000d0f1 FORMAT "%.15" /end MEASUREMENT
/begin MEASUREMENT LuSOC_facDCHTemp_enum "环境温度对安时修正系数" UWORD NO_COMPU_METHOD 0 0 0 1 ECU_ADDRESS 0x7000cf8a FORMAT "%.15" /end MEASUREMENT
/begin MEASUREMENT LeSOC_OutVehTempVld_enum "车外环境温度有效标志位" UBYTE NO_COMPU_METHOD 0 0 0 1 ECU_ADDRESS 0x7000d0fb FORMAT "%.15" /end MEASUREMENT
/begin MEASUREMENT LeSOC_OutVehTemp_degC "车外环境温度" UBYTE NO_COMPU_METHOD 0 0 0 1 ECU_ADDRESS 0x7000d0fc FORMAT "%.15" /end MEASUREMENT
/begin MEASUREMENT LlSOC_SemiOCVCp_Ah "查表容量" ULONG NO_COMPU_METHOD 0 0 0 1 ECU_ADDRESS 0x7000c7b4 FORMAT "%.15" /end MEASUREMENT
/begin MEASUREMENT LuSOH_EEInDispSOHraw_pct "EE存储的原始显示SOH" UWORD NO_COMPU_METHOD 0 0 0 1 ECU_ADDRESS 0x7000d40c FORMAT "%.15" /end MEASUREMENT
/begin MEASUREMENT LuSOH_SOHStoredInMCU_pct "MCU存储的动力电池SOH" UBYTE NO_COMPU_METHOD 0 0 0 1 ECU_ADDRESS 0x7000d4a0 FORMAT "%.15" /end MEASUREMENT
/begin MEASUREMENT LbSOH_MCUEepromErr_flg "MCU_EE故障标志位" UBYTE NO_COMPU_METHOD 0 0 0 1 ECU_ADDRESS 0x7000d47b FORMAT "%.15" /end MEASUREMENT
/begin MEASUREMENT LuSOH_SOHInMCU_pct "MCU备份SOH" UWORD NO_COMPU_METHOD 0 0 0 1 ECU_ADDRESS 0x7000d444 FORMAT "%.15" /end MEASUREMENT
/begin MEASUREMENT LbSOH_MCULck_flg "MCU锁存标志位" UBYTE NO_COMPU_METHOD 0 0 0 1 ECU_ADDRESS 0x7000d47c FORMAT "%.15" /end MEASUREMENT
/begin MEASUREMENT LlSOH_LittleCurr_A "小电流I1" SLONG NO_COMPU_METHOD 0 0 0 1 ECU_ADDRESS 0x7000d3e6 FORMAT "%.15" /end MEASUREMENT
/begin MEASUREMENT LlSOH_CapErr_Ah "小电流积分容量Q1" ULONG NO_COMPU_METHOD 0 0 0 1 ECU_ADDRESS 0x7000d3ce FORMAT "%.15" /end MEASUREMENT
/begin MEASUREMENT LbSOH_LittleCurrErr_flg "小电流误差有效标志位" UBYTE NO_COMPU_METHOD 0 0 0 1 ECU_ADDRESS 0x7000d479 FORMAT "%.15" /end MEASUREMENT
/begin MEASUREMENT LlSOH_BattCurr_A "动力电池充放电电流_SOH" SLONG NO_COMPU_METHOD 0 0 0 1 ECU_ADDRESS 0x7000d3c6 FORMAT "%.15" /end MEASUREMENT
/begin MEASUREMENT LuSOH_ODORange_Km "ODO总里程" ULONG NO_COMPU_METHOD 0 0 0 1 ECU_ADDRESS 0x7000d430 FORMAT "%.15" /end MEASUREMENT
/begin MEASUREMENT LbSOH_ODOLife_flg "整车ODO里程报文生命信号" UBYTE NO_COMPU_METHOD 0 0 0 1 ECU_ADDRESS 0x7000d481 FORMAT "%.15" /end MEASUREMENT
/begin MEASUREMENT LbSOH_SumDeltaAhToZero_flg "行车放电总安时清零标志位" UBYTE NO_COMPU_METHOD 0 0 0 1 ECU_ADDRESS 0x7000d489 FORMAT "%.15" /end MEASUREMENT
/begin MEASUREMENT LeSOH_BattE2Err_enum "底层E2故障标志位" UBYTE NO_COMPU_METHOD 0 0 0 1 ECU_ADDRESS 0x7000d490 FORMAT "%.15" /end MEASUREMENT
/begin MEASUREMENT LeSOH_CodeE2Re_enum "底层E2变量位置切换标志位" UBYTE NO_COMPU_METHOD 0 0 0 1 ECU_ADDRESS 0x7000d491 FORMAT "%.15" /end MEASUREMENT
/begin MEASUREMENT VuSOH_FirstOCVMaxV_V "输出第一次上电静态最高锁存电压" UWORD NO_COMPU_METHOD 0 0 0 1 ECU_ADDRESS 0x7000d468 FORMAT "%.15" /end MEASUREMENT
/begin MEASUREMENT LuSOH_OCVMaxV_V "静态最高锁存电压_SOH" UWORD NO_COMPU_METHOD 0 0 0 1 ECU_ADDRESS 0x7000d42e FORMAT "%.15" /end MEASUREMENT
/begin MEASUREMENT LuSOC_facK1SOCPos_enum "修正系数K1" UWORD NO_COMPU_METHOD 0 0 0 1 ECU_ADDRESS 0x7000cfa2 FORMAT "%.15" /end MEASUREMENT
/begin MEASUREMENT LuSOC_facK2SOCPos_enum "修正系数K2" UWORD NO_COMPU_METHOD 0 0 0 1 ECU_ADDRESS 0x7000cfa4 FORMAT "%.15" /end MEASUREMENT
/begin MEASUREMENT LuSOC_facK3SOCNeg_enum "修正系数K3" UWORD NO_COMPU_METHOD 0 0 0 1 ECU_ADDRESS 0x7000cfa6 FORMAT "%.15" /end MEASUREMENT
/begin MEASUREMENT LuSOC_facK4SOCNeg_enum "修正系数K4" UWORD NO_COMPU_METHOD 0 0 0 1 ECU_ADDRESS 0x7000cfa8 FORMAT "%.15" /end MEASUREMENT
/begin MEASUREMENT LuSOC_EEInCell1SOC_pct "单体SOC1" UWORD NO_COMPU_METHOD 0 0 0 1 ECU_ADDRESS 0x7000cdac FORMAT "%.15" /end MEASUREMENT
/begin MEASUREMENT LuSOC_EEInCell2SOC_pct "单体SOC2" UWORD NO_COMPU_METHOD 0 0 0 1 ECU_ADDRESS 0x7000cdae FORMAT "%.15" /end MEASUREMENT
/begin MEASUREMENT LuSOC_EEInCell3SOC_pct "单体SOC3" UWORD NO_COMPU_METHOD 0 0 0 1 ECU_ADDRESS 0x7000cdb0 FORMAT "%.15" /end MEASUREMENT
/begin MEASUREMENT LuSOC_BattCell1SOC_pct "EE读取的单体SOC1" UWORD NO_COMPU_METHOD 0 0 0 1 ECU_ADDRESS 0x7000cb68 FORMAT "%.15" /end MEASUREMENT
/begin MEASUREMENT LuSOC_BattCell2SOC_pct "EE读取的单体SOC2" UWORD NO_COMPU_METHOD 0 0 0 1 ECU_ADDRESS 0x7000cb6a FORMAT "%.15" /end MEASUREMENT
/begin MEASUREMENT LuSOC_BattCell3SOC_pct "EE读取的单体SOC3" UWORD NO_COMPU_METHOD 0 0 0 1 ECU_ADDRESS 0x7000cb6c FORMAT "%.15" /end MEASUREMENT
/begin MEASUREMENT LbSOH_ODOVld_flg "ODO里程有效标志位" UBYTE NO_COMPU_METHOD 0 0 0 1 ECU_ADDRESS 0x7000d483 FORMAT "%.15" /end MEASUREMENT
/begin MEASUREMENT LuSOH_ODO_Km "ODO里程_整车" ULONG NO_COMPU_METHOD 0 0 0 1 ECU_ADDRESS 0x7000d434 FORMAT "%.15" /end MEASUREMENT
/begin MEASUREMENT LuCCS_FCHendTcal_min "当前剩余时间" UWORD NO_COMPU_METHOD 0 0 0 1 ECU_ADDRESS 0x70003464 FORMAT "%.15" /end MEASUREMENT
/begin MEASUREMENT VuCCS_FCHendout_min "输出剩余时间" UWORD NO_COMPU_METHOD 0 0 0 1 ECU_ADDRESS 0x700145dc FORMAT "%.15" /end MEASUREMENT
/begin MEASUREMENT KuCCS_FCHendTcount_CT "时间计数器" FLOAT32_IEEE NO_COMPU_METHOD 0 0 0 1 ECU_ADDRESS 0x700138cc FORMAT "%.15" /end MEASUREMENT
/begin MEASUREMENT KuCCS_FCHendTcount1_CT "时间计数器1" FLOAT32_IEEE NO_COMPU_METHOD 0 0 0 1 ECU_ADDRESS 0x700138c8 FORMAT "%.15" /end MEASUREMENT
/begin MEASUREMENT VbCCS_DownCurrSta_flg "降电流标志" UBYTE NO_COMPU_METHOD 0 0 0 1 ECU_ADDRESS 0x700149fd FORMAT "%.15" /end MEASUREMENT
/begin MEASUREMENT KtFCH_DownCurStepNum_enum "降电流计数器" UBYTE NO_COMPU_METHOD 0 0 0 1 ECU_ADDRESS 0x7001496d FORMAT "%.15" /end MEASUREMENT
/begin MEASUREMENT LeSOC_VehicleMod_enum "整车模式" UBYTE NO_COMPU_METHOD 0 0 0 1 ECU_ADDRESS 0x7000d102 FORMAT "%.15" /end MEASUREMENT
/begin MEASUREMENT LuSOC_V2In_V "V2电压" UWORD NO_COMPU_METHOD 0 0 0 1 ECU_ADDRESS 0x7000cf5e FORMAT "%.15" /end MEASUREMENT
/begin MEASUREMENT LuSOC_V3In_V "V3电压" UWORD NO_COMPU_METHOD 0 0 0 1 ECU_ADDRESS 0x7000cf60 FORMAT "%.15" /end MEASUREMENT
/begin MEASUREMENT LbSOC_CrossCurrMod_flg "恒流模式标志位" UBYTE NO_COMPU_METHOD 0 0 0 1 ECU_ADDRESS 0x7000cfd1 FORMAT "%.15" /end MEASUREMENT
/begin MEASUREMENT LbSOC_BattDiffWarnClear_flg "诊断仪清除BMS不均衡预警标志位" UBYTE NO_COMPU_METHOD 0 0 0 1 ECU_ADDRESS 0x7000cfbf FORMAT "%.15" /end MEASUREMENT
/begin MEASUREMENT LbSOC_BattDiffErrorClear_flg "诊断仪清除BMS不均衡故障标志位" UBYTE NO_COMPU_METHOD 0 0 0 1 ECU_ADDRESS 0x7000cfbd FORMAT "%.15" /end MEASUREMENT
/begin MEASUREMENT LuSOC_EEInCVSOCAvlbTi_min "初始化被动均衡允许开启剩余时间" ULONG NO_COMPU_METHOD 0 0 0 1 ECU_ADDRESS 0x7000cda8 FORMAT "%.15" /end MEASUREMENT
/begin MEASUREMENT LuSOC_EEInpCVSOCAvlbTi_min "EE读取的被动均衡允许开启剩余时间" ULONG NO_COMPU_METHOD 0 0 0 1 ECU_ADDRESS 0x7000ceca FORMAT "%.15" /end MEASUREMENT
/begin MEASUREMENT LbSOC_DispSOCSETErr_flg "充电目标SOC异常标志位" UBYTE NO_COMPU_METHOD 0 0 0 1 ECU_ADDRESS 0x7000cfd4 FORMAT "%.15" /end MEASUREMENT
/begin MEASUREMENT LuSOC_DispSOCSET_pct "充电目标SOC" UWORD NO_COMPU_METHOD 0 0 0 1 ECU_ADDRESS 0x7000cd9e FORMAT "%.15" /end MEASUREMENT
/begin MEASUREMENT LuSOC_DispSOCSETraw_pct "用户设置充电目标SOC" UWORD NO_COMPU_METHOD 0 0 0 1 ECU_ADDRESS 0x7000d105 FORMAT "%.15" /end MEASUREMENT
/begin MEASUREMENT LbSOC_DownCurrSta_flg "基于时间修正标志位" UBYTE NO_COMPU_METHOD 0 0 0 1 ECU_ADDRESS 0x7000cfd8 FORMAT "%.15" /end MEASUREMENT
/begin MEASUREMENT LbSOC_BaseTiCor_flg "SOC基于时间修正标志位" UBYTE NO_COMPU_METHOD 0 0 0 1 ECU_ADDRESS 0x7000cfb9 FORMAT "%.15" /end MEASUREMENT
/begin MEASUREMENT LeSOC_CHGReTimeraw_min "充电剩余时间" UWORD NO_COMPU_METHOD 0 0 0 1 ECU_ADDRESS 0x7000c6d6 FORMAT "%.15" /end MEASUREMENT
/begin MEASUREMENT LeSOC_CHGReTime_min "SOC充电剩余时间" UWORD NO_COMPU_METHOD 0 0 0 1 ECU_ADDRESS 0x7000c6d4 FORMAT "%.15" /end MEASUREMENT
/begin MEASUREMENT LbSOC_CHGReTimeErr_flg "SOC充电剩余时间异常标志位" UBYTE NO_COMPU_METHOD 0 0 0 1 ECU_ADDRESS 0x7000cfc4 FORMAT "%.15" /end MEASUREMENT
/begin MEASUREMENT LlSOC_DispSOCCor2Lck_pct "显示SOC基础值锁存值" ULONG NO_COMPU_METHOD 0 0 0 1 ECU_ADDRESS 0x7000c75c FORMAT "%.15" /end MEASUREMENT
/begin MEASUREMENT LbSOC_PosStuck_flg "正极继电器粘连" UBYTE NO_COMPU_METHOD 0 0 0 1 ECU_ADDRESS 0x7000cff4 FORMAT "%.15" /end MEASUREMENT
/begin MEASUREMENT LbSOC_PosCmd_flg "正极继电器指令" UBYTE NO_COMPU_METHOD 0 0 0 1 ECU_ADDRESS 0x7000cff3 FORMAT "%.15" /end MEASUREMENT
/begin MEASUREMENT LbSOC_PreStuck_flg "预充继电器粘连" UBYTE NO_COMPU_METHOD 0 0 0 1 ECU_ADDRESS 0x7000cff7 FORMAT "%.15" /end MEASUREMENT
/begin MEASUREMENT LbSOC_PrecCmd_flg "预充继电器指令" UBYTE NO_COMPU_METHOD 0 0 0 1 ECU_ADDRESS 0x7000cff8 FORMAT "%.15" /end MEASUREMENT
/begin MEASUREMENT LbSOC_NegStuck_flg "负极继电器粘连" UBYTE NO_COMPU_METHOD 0 0 0 1 ECU_ADDRESS 0x7000cfeb FORMAT "%.15" /end MEASUREMENT
/begin MEASUREMENT LbSOC_NegCmd_flg "负极继电器指令" UBYTE NO_COMPU_METHOD 0 0 0 1 ECU_ADDRESS 0x7000cfe8 FORMAT "%.15" /end MEASUREMENT
/begin MEASUREMENT LeSOC_CVOCVCorEn_enum "单体SOC修正状态" UBYTE NO_COMPU_METHOD 0 0 0 1 ECU_ADDRESS 0x7000d0ef FORMAT "%.15" /end MEASUREMENT
/begin MEASUREMENT VuSOC_CVSOCAvlbTi_min "被动均衡允许开启剩余时间" UWORD NO_COMPU_METHOD 0 0 0 1 ECU_ADDRESS 0x7001471c FORMAT "%.15" /end MEASUREMENT
/begin MEASUREMENT LbSOC_RTCCVSOCEn_flg "CV修正使能标志位" UBYTE NO_COMPU_METHOD 0 0 0 1 ECU_ADDRESS 0x7000cffb FORMAT "%.15" /end MEASUREMENT
/begin MEASUREMENT LbSOC_RTCCVFltOk_flg "单体SOC修正完成标志位" UBYTE NO_COMPU_METHOD 0 0 0 1 ECU_ADDRESS 0x7000cff9 FORMAT "%.15" /end MEASUREMENT
/begin MEASUREMENT LbSOC_RTCEECorLck_flg "EE故障触发修正标志位" UBYTE NO_COMPU_METHOD 0 0 0 1 ECU_ADDRESS 0x7000cffc FORMAT "%.15" /end MEASUREMENT
/begin MEASUREMENT VfCURR_BMSCurr_A "模块BMS输出电流" SLONG NO_COMPU_METHOD 0 0 0 1 ECU_ADDRESS 0x70013bac FORMAT "%.15" /end MEASUREMENT
/begin MEASUREMENT VslCURRE_BMSHALCurr_A "霍尔输出电流" SLONG NO_COMPU_METHOD 0 0 0 1 ECU_ADDRESS 0x70013e20 FORMAT "%.15" /end MEASUREMENT
/begin MEASUREMENT VbCURRE_HALCurrErr_flg "霍尔电流故障" UBYTE NO_COMPU_METHOD 0 0 0 1 ECU_ADDRESS 0x70014a2f FORMAT "%.15" /end MEASUREMENT
/begin MEASUREMENT VbCURRE_twochanlerr_flg "双通道校验故障" UBYTE NO_COMPU_METHOD 0 0 0 1 ECU_ADDRESS 0x70014a31 FORMAT "%.15" /end MEASUREMENT
/begin MEASUREMENT VbCURRE_OutRangeErr_flg "霍尔电流超限故障" UBYTE NO_COMPU_METHOD 0 0 0 1 ECU_ADDRESS 0x70014a30 FORMAT "%.15" /end MEASUREMENT
/begin MEASUREMENT VbCURRE_AmplimitErr_flg "霍尔通道电压值超限故障" UBYTE NO_COMPU_METHOD 0 0 0 1 ECU_ADDRESS 0x70014a2d FORMAT "%.15" /end MEASUREMENT
/begin MEASUREMENT VbCURRE_ChangeErr_flg "电流变化过快故障" UBYTE NO_COMPU_METHOD 0 0 0 1 ECU_ADDRESS 0x70014a2e FORMAT "%.15" /end MEASUREMENT
/begin MEASUREMENT VslITSCUR_AnalgCurr_A "CAB输出模拟电流" SLONG NO_COMPU_METHOD 0 0 0 1 ECU_ADDRESS 0x70013e24 FORMAT "%.15" /end MEASUREMENT
/begin MEASUREMENT VslITSCUR_DigtlCurr_A "CAB输出数字电流" SLONG NO_COMPU_METHOD 0 0 0 1 ECU_ADDRESS 0x70013e28 FORMAT "%.15" /end MEASUREMENT
/begin MEASUREMENT VeITSCUR_StatusPwrSply_enum "CAB电流供电状态" UWORD NO_COMPU_METHOD 0 0 0 1 ECU_ADDRESS 0x70014b4d FORMAT "%.15" /end MEASUREMENT
/begin MEASUREMENT VbITSCUR_OverCurr_flg "CAB传感器输出过流故障" UBYTE NO_COMPU_METHOD 0 0 0 1 ECU_ADDRESS 0x70014a99 FORMAT "%.15" /end MEASUREMENT
/begin MEASUREMENT VbITSCUR_AnalgErr_flg "CAB模拟通道故障" UBYTE NO_COMPU_METHOD 0 0 0 1 ECU_ADDRESS 0x70014a92 FORMAT "%.15" /end MEASUREMENT
/begin MEASUREMENT VbITSCUR_DigtlErr_flg "CAB数字通道故障" UBYTE NO_COMPU_METHOD 0 0 0 1 ECU_ADDRESS 0x70014a97 FORMAT "%.15" /end MEASUREMENT
/begin MEASUREMENT VbITSCUR_CABCANErr_flg "CAB通讯丢失故障" UBYTE NO_COMPU_METHOD 0 0 0 1 ECU_ADDRESS 0x70014a93 FORMAT "%.15" /end MEASUREMENT
/begin MEASUREMENT VbITSCUR_CABCurrErr_flg "输出电流故障标志位" UBYTE NO_COMPU_METHOD 0 0 0 1 ECU_ADDRESS 0x70014a94 FORMAT "%.15" /end MEASUREMENT
/begin MEASUREMENT VuITSCUR_DriftCurr_A "CAB模拟通道电流零漂值" SLONG NO_COMPU_METHOD 0 0 0 1 ECU_ADDRESS 0x700145fa FORMAT "%.15" /end MEASUREMENT
/begin MEASUREMENT LbITSCUR_CABHardWareErr_flg "CAB传感器硬件故障" UBYTE NO_COMPU_METHOD 0 0 0 1 ECU_ADDRESS 0x70007f25 FORMAT "%.15" /end MEASUREMENT
/begin MEASUREMENT VbITSCUR_CABOverCurrErr_flg "CAB传感器过流故障" UBYTE NO_COMPU_METHOD 0 0 0 1 ECU_ADDRESS 0x70014a96 FORMAT "%.15" /end MEASUREMENT
/begin MEASUREMENT VbITSCUR_DriftCurrErr_flg "CAB传感器零漂预警标志位" UBYTE NO_COMPU_METHOD 0 0 0 1 ECU_ADDRESS 0x70014a98 FORMAT "%.15" /end MEASUREMENT
/begin MEASUREMENT VbITSCUR_AnalgOutRangeErr_flg "模拟通道电流超量程故障标志位" UBYTE NO_COMPU_METHOD 0 0 0 1 ECU_ADDRESS 0x70007f2f FORMAT "%.15" /end MEASUREMENT
/begin MEASUREMENT VbITSCUR_DigtlOutRangeErr_flg "数字通道电流超量程故障标志位" UBYTE NO_COMPU_METHOD 0 0 0 1 ECU_ADDRESS 0x70007f30 FORMAT "%.15" /end MEASUREMENT
/begin MEASUREMENT Out_VbCCS_DownCurrSta_flg "SOC可调降电流标志" UBYTE NO_COMPU_METHOD 0 0 0 1 ECU_ADDRESS 0x700034d7 FORMAT "%.15" /end MEASUREMENT
/begin MEASUREMENT VslCURR_ReplacCurr_A "输出替代电流" SLONG NO_COMPU_METHOD 0 0 0 1 ECU_ADDRESS 0x70003d1e FORMAT "%.15" /end MEASUREMENT
/begin MEASUREMENT LbSOC_CHGReTiDchSt_flg "时间修正放电状态标志位" UBYTE NO_COMPU_METHOD 0 0 0 1 ECU_ADDRESS 0x7000cfc3 FORMAT "%.15" /end MEASUREMENT
/begin MEASUREMENT LuSOC_DeltaDispSOC_pct "显示SOC锁存偏差" ULONG NO_COMPU_METHOD 0 0 0 1 ECU_ADDRESS 0x7000cd94 FORMAT "%.15" /end MEASUREMENT
/begin MEASUREMENT VbCURR_CurrErr_flg "输出电流故障" UBYTE NO_COMPU_METHOD 0 0 0 1 ECU_ADDRESS 0x70014a36 FORMAT "%.15" /end MEASUREMENT
/begin MEASUREMENT VeCURR_CurrErrType_enum "电流故障类型" UWORD NO_COMPU_METHOD 0 0 0 1 ECU_ADDRESS 0x70014afb FORMAT "%.15" /end MEASUREMENT
/begin MEASUREMENT VfCURR_BMSCurrCAN_A "模块BMS输出至CAN线电流" ULONG NO_COMPU_METHOD 0 0 0 1 ECU_ADDRESS 0x70013ba8 FORMAT "%.15" /end MEASUREMENT
/begin MEASUREMENT LfFTD_BMUMaxCellVlt_mV "单体最大" FLOAT32_IEEE NO_COMPU_METHOD 0 0 0 1 ECU_ADDRESS 0x700077fc FORMAT "%.15" /end MEASUREMENT
/begin MEASUREMENT LfFTD_BMUMinCellVlt_mV "单体最小" FLOAT32_IEEE NO_COMPU_METHOD 0 0 0 1 ECU_ADDRESS 0x700077fe FORMAT "%.15" /end MEASUREMENT
/begin MEASUREMENT VeBATEP_BMSHWAdjVer_NULL "BMS系统硬件版本号" UBYTE NO_COMPU_METHOD 0 0 0 1 ECU_ADDRESS 0x70014ac0 FORMAT "%.15" /end MEASUREMENT
/begin MEASUREMENT LuSOC_SOCRateNegAddCor_enum "SOC额定增加偏差下降修正系数" UWORD NO_COMPU_METHOD 0 0 0 1 ECU_ADDRESS 0x7000cf4e FORMAT "%.15" /end MEASUREMENT
/begin MEASUREMENT LuSOC_SOCRatePosAddCor_enum "SOC额定增加偏差上升修正系数" UWORD NO_COMPU_METHOD 0 0 0 1 ECU_ADDRESS 0x7000cf50 FORMAT "%.15" /end MEASUREMENT
/begin MEASUREMENT Log_VbFTD_TempMaxSecErrTR_flg "条件1" UBYTE NO_COMPU_METHOD 0 0 0 1 ECU_ADDRESS 0x70007d90 FORMAT "%.15" /end MEASUREMENT
/begin MEASUREMENT Log_VbFTD_TempMaxRiseErrTR_flg "条件2" UBYTE NO_COMPU_METHOD 0 0 0 1 ECU_ADDRESS 0x70007d8f FORMAT "%.15" /end MEASUREMENT
/begin MEASUREMENT Log_VbFTD_CellDrpStyErrTR_flg "条件3" UBYTE NO_COMPU_METHOD 0 0 0 1 ECU_ADDRESS 0x70007d89 FORMAT "%.15" /end MEASUREMENT
/begin MEASUREMENT Log_VbFTD_CellDrpDymErrTR_flg "条件4" UBYTE NO_COMPU_METHOD 0 0 0 1 ECU_ADDRESS 0x70007d87 FORMAT "%.15" /end MEASUREMENT
/begin MEASUREMENT Log_VbFTD_CellDrpSlpStyErrTR_flg "条件5" UBYTE NO_COMPU_METHOD 0 0 0 1 ECU_ADDRESS 0x70007d88 FORMAT "%.15" /end MEASUREMENT
/begin MEASUREMENT Log_VbFTD_CellVltDiffErrTR_flg "条件6" UBYTE NO_COMPU_METHOD 0 0 0 1 ECU_ADDRESS 0x70007d8a FORMAT "%.15" /end MEASUREMENT
/begin MEASUREMENT Log_VbFTD_VltChnlTmpRiseErrTR_flg "条件7" UBYTE NO_COMPU_METHOD 0 0 0 1 ECU_ADDRESS 0x70007d94 FORMAT "%.15" /end MEASUREMENT
/begin MEASUREMENT Log_VbFTD_MinVltMaxTmpErrTR_flg "条件8" UBYTE NO_COMPU_METHOD 0 0 0 1 ECU_ADDRESS 0x70007d8b FORMAT "%.15" /end MEASUREMENT
/begin MEASUREMENT Log_VbFTD_MinVltTmpRiseErrTR_flg "条件9" UBYTE NO_COMPU_METHOD 0 0 0 1 ECU_ADDRESS 0x70007d8c FORMAT "%.15" /end MEASUREMENT
/begin MEASUREMENT Log_VbFTD_MinVltTmpUnbaErrTR_flg "条件10" UBYTE NO_COMPU_METHOD 0 0 0 1 ECU_ADDRESS 0x70007d8d FORMAT "%.15" /end MEASUREMENT
/begin MEASUREMENT Log_VbFTD_TmpRiseMaxErrTR_flg "条件11" UBYTE NO_COMPU_METHOD 0 0 0 1 ECU_ADDRESS 0x70007d92 FORMAT "%.15" /end MEASUREMENT
/begin MEASUREMENT Log_VbFTD_TmpRiseUnbaErrTR_flg "条件12" UBYTE NO_COMPU_METHOD 0 0 0 1 ECU_ADDRESS 0x70007d93 FORMAT "%.15" /end MEASUREMENT
/begin MEASUREMENT Log_VbFTD_StyStateTR_flg "稳态工况" UBYTE NO_COMPU_METHOD 0 0 0 1 ECU_ADDRESS 0x70007d8e FORMAT "%.15" /end MEASUREMENT
/begin MEASUREMENT LuSOC_OCVDispSOC_pct "OCV显示SOC" UWORD NO_COMPU_METHOD 0 0 0 1 ECU_ADDRESS 0x7000cef6 FORMAT "%.15" /end MEASUREMENT
/begin MEASUREMENT BMSI_bICAN_HWFlt_flg "硬件故障标志位3" UBYTE NO_COMPU_METHOD 0 0 0 1 ECU_ADDRESS 0x70013459 FORMAT "%.15" /end MEASUREMENT
/begin MEASUREMENT Log_VfFTD_RawSOC_pct "标定SOC-tr1" UBYTE NO_COMPU_METHOD 0 0 0 1 ECU_ADDRESS 0x70007d95 FORMAT "%.15" /end MEASUREMENT
/begin MEASUREMENT LfFTD_RawSOC_pct "标定SOC-tr2" UWORD NO_COMPU_METHOD 0 0 0 1 ECU_ADDRESS 0x70007aba FORMAT "%.15" /end MEASUREMENT
/begin MEASUREMENT LuSOH_UDSSOHSet_pct "UDS设置SOH" UWORD NO_COMPU_METHOD 0 0 0 1 ECU_ADDRESS 0x7000d454 FORMAT "%.15" /end MEASUREMENT
/begin MEASUREMENT In_LuCCS_MaxCellVlt_mV "单体最高电压值" UWORD NO_COMPU_METHOD 0 0 0 1 ECU_ADDRESS 0x7000342a FORMAT "%.15" /end MEASUREMENT
/begin MEASUREMENT VbFTD_12BattErr_flg "BMS供电电源异常" UBYTE NO_COMPU_METHOD 0 0 0 1 ECU_ADDRESS 0x70014a5a FORMAT "%.15" /end MEASUREMENT
/begin MEASUREMENT B_MLoutPowDnTiVali_flg "有效位" UBYTE NO_COMPU_METHOD 0 0 0 1 ECU_ADDRESS 0x7000347e FORMAT "%.15" /end MEASUREMENT
/begin MEASUREMENT B_MLoutPowDnTi_day "静置天数" ULONG NO_COMPU_METHOD 0 0 0 1 ECU_ADDRESS 0x70003400 FORMAT "%.15" /end MEASUREMENT
/begin MEASUREMENT B_ResChgLimitAhEE_Ah "安时" ULONG NO_COMPU_METHOD 0 0 0 1 ECU_ADDRESS 0x70003404 FORMAT "%.15" /end MEASUREMENT
/begin MEASUREMENT B_Litcur_flg "小电流保护开关" UBYTE NO_COMPU_METHOD 0 0 0 1 ECU_ADDRESS 0x7000347b FORMAT "%.15" /end MEASUREMENT
/begin MEASUREMENT BMSO_lEPRM_ResChgLimitAhEE_Ah "EE存储的累计充电Ah" ULONG NO_COMPU_METHOD 0 0 0 1 ECU_ADDRESS 0x70012410 FORMAT "%.15" /end MEASUREMENT
/begin MEASUREMENT In_LfCCS_ChgSumAh_Ah "累积充电安时" ULONG NO_COMPU_METHOD 0 0 0 1 ECU_ADDRESS 0x7000341a FORMAT "%.15" /end MEASUREMENT
/begin MEASUREMENT BMSO_bECAN_TotCurrCirErr_flg "电流检测故障" UBYTE NO_COMPU_METHOD 0 0 0 1 ECU_ADDRESS 0x7001278a FORMAT "%.15" /end MEASUREMENT
/begin MEASUREMENT BMSI_uEPRM_TBOXTimeYearEE_year "TBOX年" UWORD NO_COMPU_METHOD 0 0 0 1 ECU_ADDRESS 0x70012d72 FORMAT "%.15" /end MEASUREMENT
/begin MEASUREMENT BMSI_eEPRM_TBOXTimeMonthEE_month "TBOX月" UBYTE NO_COMPU_METHOD 0 0 0 1 ECU_ADDRESS 0x70013659 FORMAT "%.15" /end MEASUREMENT
/begin MEASUREMENT BMSI_eEPRM_TBOXTimeDayEE_day "TBOX日" UBYTE NO_COMPU_METHOD 0 0 0 1 ECU_ADDRESS 0x70013656 FORMAT "%.15" /end MEASUREMENT
/begin MEASUREMENT LbSOC_JumpMod_trigger "跳变模式置位" UBYTE NO_COMPU_METHOD 0 0 0 1 ECU_ADDRESS 0x7000cfe6 FORMAT "%.15" /end MEASUREMENT
/begin MEASUREMENT Out_VuCCS_FCDownCurrStep_enum "快充充电阶段" UBYTE NO_COMPU_METHOD 0 0 0 1 ECU_ADDRESS 0x700034d8 FORMAT "%.15" /end MEASUREMENT
/begin MEASUREMENT LeCCS_BattChgStep_enum "慢充充电阶段" UBYTE NO_COMPU_METHOD 0 0 0 1 ECU_ADDRESS 0x700034be FORMAT "%.15" /end MEASUREMENT
/begin MEASUREMENT LeSOC_EEInBattDiffSt_enum "初始化静态电池单体电压不均衡状态" UBYTE NO_COMPU_METHOD 0 0 0 1 ECU_ADDRESS 0x7000d0f7 FORMAT "%.15" /end MEASUREMENT
/begin MEASUREMENT Out_VbCCSSOCsetOK_End "充电截止SOC标志" UBYTE NO_COMPU_METHOD 0 0 0 1 ECU_ADDRESS 0x700034d6 FORMAT "%.15" /end MEASUREMENT
/begin MEASUREMENT B_MLInPowDnTiErr_flg "整车静置时间故障标志位" UBYTE NO_COMPU_METHOD 0 0 0 1 ECU_ADDRESS 0x7000347d FORMAT "%.15" /end MEASUREMENT
/begin MEASUREMENT B_MLInPowDnTi_min "整车禁止时间输入" ULONG NO_COMPU_METHOD 0 0 0 1 ECU_ADDRESS 0x700033fc FORMAT "%.15" /end MEASUREMENT
/begin MEASUREMENT LbSOC_BattDiffStClear_flg "诊断仪清除不均衡状态标志位" UBYTE NO_COMPU_METHOD 0 0 0 1 ECU_ADDRESS 0x7000cfbe FORMAT "%.15" /end MEASUREMENT
/begin MEASUREMENT LsFTD_BatMaxTemp_deg "最高温度" SWORD NO_COMPU_METHOD 0 0 0 1 ECU_ADDRESS 0x70007e88 FORMAT "%.15" /end MEASUREMENT
/begin MEASUREMENT VuSOH_UDSSOH_pct "SOH" UWORD NO_COMPU_METHOD 0 0 0 1 ECU_ADDRESS 0x70014872 FORMAT "%.15" /end MEASUREMENT
/begin CHARACTERISTIC KbCRTINT_AChODOAhIntgDbF_flag "使能累计充电总安时" VALUE 0xaf011d6d __UBYTE_S 0 NO_COMPU_METHOD 0 255 FORMAT "%.15" /end CHARACTERISTIC
/begin CHARACTERISTIC KlCRTINT_AChODOAhIntgDbV_Ah "标定用累计充电总安时" VALUE 0xaf0103e0 __ULONG_S 0 NO_COMPU_METHOD 0 255 FORMAT "%.15" /end CHARACTERISTIC
/begin CHARACTERISTIC KbCRTINT_ADChODOAhIntgDbF_flag "使能用初始EEPROM历史累计放电总安时" VALUE 0xaf011d6e __UBYTE_S 0 NO_COMPU_METHOD 0 255 FORMAT "%.15" /end CHARACTERISTIC
/begin CHARACTERISTIC KlCRTINT_ADChODOAhIntgDbV_Ah "标定用初始EEPROM历史累计放电总安时" VALUE 0xaf0103e4 __ULONG_S 0 NO_COMPU_METHOD 0 255 FORMAT "%.15" /end CHARACTERISTIC
/begin CHARACTERISTIC KbPWRCTL_BattSOCCal_flg "BMS功率控制模块SOC_使能位" VALUE 0xaf011de8 __UBYTE_S 0 NO_COMPU_METHOD 0 255 FORMAT "%.15" /end CHARACTERISTIC
/begin CHARACTERISTIC KfPWRCTL_BattSOCCal_pct "BMS功率控制模块SOC" VALUE 0xaf010046 __UWORD_S 0 NO_COMPU_METHOD 0 255 FORMAT "%.15" /end CHARACTERISTIC
/begin CHARACTERISTIC KbCTM_Curr_swt "系统电流开关" VALUE 0xaf011d7e __UBYTE_S 0 NO_COMPU_METHOD 0 255 FORMAT "%.15" /end CHARACTERISTIC
/begin CHARACTERISTIC KbCTM_Curr_A "系统电流" VALUE 0xaf0103c4 __FLOAT32_IEEE_S 0 NO_COMPU_METHOD 0 255 FORMAT "%.15" /end CHARACTERISTIC
/begin CHARACTERISTIC KbCTM_CurrNeed_swt "最大允许电流开关" VALUE 0xaf011d7d __UBYTE_S 0 NO_COMPU_METHOD 0 255 FORMAT "%.15" /end CHARACTERISTIC
/begin CHARACTERISTIC KbCTM_CurrNeed_A "最大允许电流" VALUE 0xaf0103c0 __FLOAT32_IEEE_S 0 NO_COMPU_METHOD 0 255 FORMAT "%.15" /end CHARACTERISTIC
/begin CHARACTERISTIC KbCTM_CurrErr_swt "系统电流检测电路故障开关" VALUE 0xaf011d7c __UBYTE_S 0 NO_COMPU_METHOD 0 255 FORMAT "%.15" /end CHARACTERISTIC
/begin CHARACTERISTIC KbCTM_CurrErr_flg "系统电流检测电路故障" VALUE 0xaf011d7b __UBYTE_S 0 NO_COMPU_METHOD 0 255 FORMAT "%.15" /end CHARACTERISTIC
/begin CHARACTERISTIC KbCEL_S2CMD_swt "S2开关命令 开关" VALUE 0x8014483d __UBYTE_S 0 NO_COMPU_METHOD 0 255 FORMAT "%.15" /end CHARACTERISTIC
/begin CHARACTERISTIC KbCEL_S2CMD_enum "S2开关命令 值" VALUE 0x8014483d __UBYTE_S 0 NO_COMPU_METHOD 0 255 FORMAT "%.15" /end CHARACTERISTIC
/begin CHARACTERISTIC KbCTM_ChgVolt_swt "动力电池需求电压开关" VALUE 0xaf011d7a __UBYTE_S 0 NO_COMPU_METHOD 0 255 FORMAT "%.15" /end CHARACTERISTIC
/begin CHARACTERISTIC KbCTM_ChgVolt_V "动力电池需求电压" VALUE 0xaf0103bc __FLOAT32_IEEE_S 0 NO_COMPU_METHOD 0 255 FORMAT "%.15" /end CHARACTERISTIC
/begin CHARACTERISTIC KbCTM_CanErr_swt "动力电池系统内部通讯故障开关" VALUE 0xaf011d79 __UBYTE_S 0 NO_COMPU_METHOD 0 255 FORMAT "%.15" /end CHARACTERISTIC
/begin CHARACTERISTIC KbCTM_CanErr_enum "动力电池系统内部通讯故障" VALUE 0xaf011d78 __UBYTE_S 0 NO_COMPU_METHOD 0 255 FORMAT "%.15" /end CHARACTERISTIC
/begin CHARACTERISTIC KbCTM_HVOff_swt "高压下电请求开关" VALUE 0xaf011d80 __UBYTE_S 0 NO_COMPU_METHOD 0 255 FORMAT "%.15" /end CHARACTERISTIC
/begin CHARACTERISTIC KbCTM_HVOff_enum "高压下电请求" VALUE 0xaf011d7f __UBYTE_S 0 NO_COMPU_METHOD 0 255 FORMAT "%.15" /end CHARACTERISTIC
/begin CHARACTERISTIC KbBTM_WrmSumTiTest_flg "保温时间开关_架构三" VALUE 0xaf011d5e __UBYTE_S 0 NO_COMPU_METHOD 0 255 FORMAT "%.15" /end CHARACTERISTIC
/begin CHARACTERISTIC KlBTM_WrmSumTi_CT_Test "保温时间_架构三" VALUE 0xaf010250 __UWORD_S 0 NO_COMPU_METHOD 0 255 FORMAT "%.15" /end CHARACTERISTIC
/begin CHARACTERISTIC KbPWRCTL_RealSOCCal_flg "真实SOC标定开关" VALUE 0xaf011df6 __UBYTE_S 0 NO_COMPU_METHOD 0 255 FORMAT "%.15" /end CHARACTERISTIC
/begin CHARACTERISTIC KePWRCTL_RealSOCCal_pct "真实SOC标定量" VALUE 0xaf01003c __UWORD_S 0 NO_COMPU_METHOD 0 255 FORMAT "%.15" /end CHARACTERISTIC
/begin CHARACTERISTIC KbDBAL_CellUnbaSOCAhMdfy_flg "SOC输出的不均衡标志位使能" VALUE 0xaf011d81 __UBYTE_S 0 NO_COMPU_METHOD 0 255 FORMAT "%.15" /end CHARACTERISTIC
/begin CHARACTERISTIC KeDBVL_CellUnbaSOCAhMdfy_enum "SOC输出的不均衡标志位赋值" VALUE 0xaf011e17 __UBYTE_S 0 NO_COMPU_METHOD 0 255 FORMAT "%.15" /end CHARACTERISTIC
/begin CHARACTERISTIC KbPWRCTL_RealSOCAftDeal_flg "最终SOC标定开关" VALUE 0xaf011df5 __UBYTE_S 0 NO_COMPU_METHOD 0 255 FORMAT "%.15" /end CHARACTERISTIC
/begin CHARACTERISTIC KePWRCTL_RealSOCAftDeal_pct "最终SOC标定量" VALUE 0xaf01003a __UWORD_S 0 NO_COMPU_METHOD 0 255 FORMAT "%.15" /end CHARACTERISTIC
/begin CHARACTERISTIC KbBCM_WrmSumTiTest_flg "保温时间使能量" VALUE 0xaf011d5c __UBYTE_S 0 NO_COMPU_METHOD 0 255 FORMAT "%.15" /end CHARACTERISTIC
/begin CHARACTERISTIC KlBCM_WrmSumTi_CT_Test "保温时间复写值" VALUE 0xaf01024e __ULONG_S 0 NO_COMPU_METHOD 0 255 FORMAT "%.15" /end CHARACTERISTIC
/begin CHARACTERISTIC KlBCM_BattAvailCapForHeat_pct_Test "可用容量标定值" VALUE 0xaf0101ac __UWORD_S 0 NO_COMPU_METHOD 0 255 FORMAT "%.15" /end CHARACTERISTIC
/begin CHARACTERISTIC KbBCM_BattAvailCapForHeatpctTest_flg "可用容量标定开关" VALUE 0xaf011d59 __UBYTE_S 0 NO_COMPU_METHOD 0 255 FORMAT "%.15" /end CHARACTERISTIC
/begin CHARACTERISTIC KbBCM_BattAvailCapForHeat_pct "可用容量限制" VALUE 0xaf0101aa __UWORD_S 0 NO_COMPU_METHOD 0 255 FORMAT "%.15" /end CHARACTERISTIC
/begin CHARACTERISTIC LfPWRCTL_SOH_pct "功率SOH" VALUE 0x7000a8e2 __UWORD_S 0 NO_COMPU_METHOD 0 255 FORMAT "%.15" /end CHARACTERISTIC
/begin CHARACTERISTIC KbPWRCTL_BattSOHCal_flg "功率SOH_sw" VALUE 0xaf011de9 __UBYTE_S 0 NO_COMPU_METHOD 0 255 FORMAT "%.15" /end CHARACTERISTIC
/begin CHARACTERISTIC KsTEMP_MaxTempUpRate1_CS "最高温度小于55度升高速率" VALUE 0xaf010428 __ULONG_S 0 NO_COMPU_METHOD 0 255 FORMAT "%.15" /end CHARACTERISTIC
/begin CHARACTERISTIC KsTEMP_MaxTempUpRate2_CS "最高温度大于55度升高速率" VALUE 0xaf01042c __ULONG_S 0 NO_COMPU_METHOD 0 255 FORMAT "%.15" /end CHARACTERISTIC
/begin CHARACTERISTIC KsTEMP_MaxTempDownRate_CS "最高温度下降速率" VALUE 0xaf010424 __ULONG_S 0 NO_COMPU_METHOD 0 255 FORMAT "%.15" /end CHARACTERISTIC
/begin CHARACTERISTIC KsTEMP_MinTempUpRate1_CS "最低温度小于55度升高速率" VALUE 0xaf010434 __ULONG_S 0 NO_COMPU_METHOD 0 255 FORMAT "%.15" /end CHARACTERISTIC
/begin CHARACTERISTIC KsTEMP_MinTempUpRate2_CS "最低温度大于55度升高速率" VALUE 0xaf010438 __ULONG_S 0 NO_COMPU_METHOD 0 255 FORMAT "%.15" /end CHARACTERISTIC
/begin CHARACTERISTIC KsTEMP_MinTempDownRate_CS "最低温度下降速率" VALUE 0xaf010430 __ULONG_S 0 NO_COMPU_METHOD 0 255 FORMAT "%.15" /end CHARACTERISTIC
/begin CHARACTERISTIC KbCRTINT_CCPBattAdptNumSwt_flg "标定窗口计数器" VALUE 0xaf011d6f __UBYTE_S 0 NO_COMPU_METHOD 0 255 FORMAT "%.15" /end CHARACTERISTIC
/begin CHARACTERISTIC KbCRTINT_CCPBattAdptNum_enum "窗口计数器值" VALUE 0xaf011d70 __UBYTE_S 0 NO_COMPU_METHOD 0 255 FORMAT "%.15" /end CHARACTERISTIC
/begin CHARACTERISTIC KbPWRCTL_TempFilterOnOrOff_flg "功率温度控制开关" VALUE 0xaf011e75 __UBYTE_S 0 NO_COMPU_METHOD 0 255 FORMAT "%.15" /end CHARACTERISTIC
/begin CHARACTERISTIC KbTEMP_FilterMaxMinEn_flg "功率温度控制开关" VALUE 0xaf011e0c __UBYTE_S 0 NO_COMPU_METHOD 0 255 FORMAT "%.15" /end CHARACTERISTIC
/begin CHARACTERISTIC LlSOC_CmltChgCpRaw_Ah_ovrdflg "电池包历史累积充电容量Debug开关" VALUE 0xaf011e25 __UBYTE_S 0 NO_COMPU_METHOD 0 255 FORMAT "%.15" /end CHARACTERISTIC
/begin CHARACTERISTIC LlSOC_CmltChgCpRaw_Ah_ovrdval "电池包历史累积充电容量Debug数值" VALUE 0xaf0103f8 __ULONG_S 0 NO_COMPU_METHOD 0 255 FORMAT "%.15" /end CHARACTERISTIC
/begin CHARACTERISTIC LlSOC_CmltDchCpRaw_Ah_ovrdflg "电池包历史累积充电容量Debug开关" VALUE 0xaf011e26 __UBYTE_S 0 NO_COMPU_METHOD 0 255 FORMAT "%.15" /end CHARACTERISTIC
/begin CHARACTERISTIC LlSOC_CmltDchCpRaw_Ah_ovrdval "电池包历史累积放电容量Debug数值" VALUE 0xaf0103fc __ULONG_S 0 NO_COMPU_METHOD 0 255 FORMAT "%.15" /end CHARACTERISTIC
/begin CHARACTERISTIC LlSOC_BattStandgTi_min_ovrdflg "整车静置时间Debug开关" VALUE 0xaf011e24 __UBYTE_S 0 NO_COMPU_METHOD 0 255 FORMAT "%.15" /end CHARACTERISTIC
/begin CHARACTERISTIC LlSOC_BattStandgTi_min_ovrdval "整车静置时间Debug数值（=最小整车静置时间+1）" VALUE 0xaf0105cc __ULONG_S 0 NO_COMPU_METHOD 0 255 FORMAT "%.15" /end CHARACTERISTIC
/begin CHARACTERISTIC LlSOC_EEInAvlbCpAct_Ah_ovrdflg "真实可用容量存EE使能" VALUE 0xaf011e27 __UBYTE_S 0 NO_COMPU_METHOD 0 255 FORMAT "%.15" /end CHARACTERISTIC
/begin CHARACTERISTIC LlSOC_EEInAvlbCpAct_Ah_ovrdval "真实可用容量存EE标定值" VALUE 0xaf010400 __ULONG_S 0 NO_COMPU_METHOD 0 255 FORMAT "%.15" /end CHARACTERISTIC
/begin CHARACTERISTIC KeSOC_BattE2ErrDeSw_flg "CHECKCODE标定使能" VALUE 0xaf011e18 __UBYTE_S 0 NO_COMPU_METHOD 0 255 FORMAT "%.15" /end CHARACTERISTIC
/begin CHARACTERISTIC KeSOC_BattE2ErrCHECKCODE_enum "CHECKCODE标定值" VALUE 0xaf01003e __ULONG_S 0 NO_COMPU_METHOD 0 255 FORMAT "%.15" /end CHARACTERISTIC
/begin CHARACTERISTIC LlSOC_EEInBattRatedCp_Ah_ovrdflg "EE故障标志位标定值" VALUE 0xaf011e28 __UBYTE_S 0 NO_COMPU_METHOD 0 255 FORMAT "%.15" /end CHARACTERISTIC
/begin CHARACTERISTIC LlSOC_EEInBattRatedCp_Ah_ovrdval "EE故障标志位使能" VALUE 0xaf010404 __UWORD_S 0 NO_COMPU_METHOD 0 255 FORMAT "%.15" /end CHARACTERISTIC
/begin CHARACTERISTIC KbCCS_LsohSwitch_flg "LSOH标定使能" VALUE 0xaf011d67 __UBYTE_S 0 NO_COMPU_METHOD 0 255 FORMAT "%.15" /end CHARACTERISTIC
/begin CHARACTERISTIC KfCCS_Lsoh_pct "LSOH标定值" VALUE 0xaf010044 __UWORD_S 0 NO_COMPU_METHOD 0 255 FORMAT "%.15" /end CHARACTERISTIC
/begin CHARACTERISTIC KbCCS_SOHSwitch_flg "SOH标定使能" VALUE 0xaf011d6b __UBYTE_S 0 NO_COMPU_METHOD 0 255 FORMAT "%.15" /end CHARACTERISTIC
/begin CHARACTERISTIC KfCCS_SOH_pct "SOH标定值" VALUE 0xaf01035c __UWORD_S 0 NO_COMPU_METHOD 0 255 FORMAT "%.15" /end CHARACTERISTIC
/begin CHARACTERISTIC KbCCS_SumAhSwitch_flg "累积安时标定使能" VALUE 0xaf011d6c __UBYTE_S 0 NO_COMPU_METHOD 0 255 FORMAT "%.15" /end CHARACTERISTIC
/begin CHARACTERISTIC KfCCS_SumChgAh_Ah "累积安时标定值" VALUE 0xaf0103d4 __ULONG_S 0 NO_COMPU_METHOD 0 255 FORMAT "%.15" /end CHARACTERISTIC
/begin CHARACTERISTIC KbSOH_TiHVOFFSw_flg "整车断高压时间标定开关" VALUE 0xaf011e09 __UBYTE_S 0 NO_COMPU_METHOD 0 255 FORMAT "%.15" /end CHARACTERISTIC
/begin CHARACTERISTIC KeSOH_TiHVOFF_min "整车断高压时间标定值" VALUE 0xaf0103d0 __ULONG_S 0 NO_COMPU_METHOD 0 255 FORMAT "%.15" /end CHARACTERISTIC
/begin CHARACTERISTIC KbSOH_CCPLastSOHSw_flg "底层SOH标定开关" VALUE 0xaf011e04 __UBYTE_S 0 NO_COMPU_METHOD 0 255 FORMAT "%.15" /end CHARACTERISTIC
/begin CHARACTERISTIC KuSOH_CCPLastSOH_pct "底层SOH标定值" VALUE 0xaf010082 __UWORD_S 0 NO_COMPU_METHOD 0 255 FORMAT "%.15" /end CHARACTERISTIC
/begin CHARACTERISTIC KbSOH_BCUCalendarSw_flg "控制器日历时间使能" VALUE 0xaf011e01 __UBYTE_S 0 NO_COMPU_METHOD 0 255 FORMAT "%.15" /end CHARACTERISTIC
/begin CHARACTERISTIC KeSOH_BCUCalendar_min "控制器日历时间标定" VALUE 0xaf0103c8 __ULONG_S 0 NO_COMPU_METHOD 0 255 FORMAT "%.15" /end CHARACTERISTIC
/begin CHARACTERISTIC KlSOH_CCPSumDeltaAhSw_flg "使能写入E2的行车放电总安时" VALUE 0xaf011e1f __UBYTE_S 0 NO_COMPU_METHOD 0 255 FORMAT "%.15" /end CHARACTERISTIC
/begin CHARACTERISTIC KlSOH_CCPSumDeltaAh_Ah "标定写入E2的行车放电总安时" VALUE 0xaf0103f4 __ULONG_S 0 NO_COMPU_METHOD 0 255 FORMAT "%.15" /end CHARACTERISTIC
/begin CHARACTERISTIC KbSOH_CheckCodeSw_flg "标定checkcode" VALUE 0xaf011e08 __UBYTE_S 0 NO_COMPU_METHOD 0 255 FORMAT "%.15" /end CHARACTERISTIC
/begin CHARACTERISTIC KuSOH_CheckCode_enum "标定checkcode" VALUE 0xaf010086 __UWORD_S 0 NO_COMPU_METHOD 0 255 FORMAT "%.15" /end CHARACTERISTIC
/begin CHARACTERISTIC LuSOC_BattAgingFac_enum_ovrdval "标定电池系统老化系数" VALUE 0xaf010088 __UWORD_S 0 NO_COMPU_METHOD 0 255 FORMAT "%.15" /end CHARACTERISTIC
/begin CHARACTERISTIC LuSOC_BattAgingFac_enum_ovrdflg "使能电池系统老化系数" VALUE 0xaf011e29 __UBYTE_S 0 NO_COMPU_METHOD 0 255 FORMAT "%.15" /end CHARACTERISTIC
/begin CHARACTERISTIC LeSOC_AgingFacValid_ovrdflg "使能电池老化系数有效状态" VALUE 0xaf011e22 __UBYTE_S 0 NO_COMPU_METHOD 0 255 FORMAT "%.15" /end CHARACTERISTIC
/begin CHARACTERISTIC LeSOC_AgingFacValid_ovrdval "标定电池老化系数有效状态" VALUE 0xaf011e23 __UBYTE_S 0 NO_COMPU_METHOD 0 255 FORMAT "%.15" /end CHARACTERISTIC
/begin CHARACTERISTIC KIBCM_FchWrmSumTI_CT "退出快充保温累计时间阈值" VALUE 0xaf010648 __ULONG_S 0 NO_COMPU_METHOD 0 255 FORMAT "%.15" /end CHARACTERISTIC
/begin CHARACTERISTIC LbSOC_OCVStatEna_enum_ovrdflg "OCV是能状态使能" VALUE 0xaf011e20 __UBYTE_S 0 NO_COMPU_METHOD 0 255 FORMAT "%.15" /end CHARACTERISTIC
/begin CHARACTERISTIC LbSOC_OCVStatEna_enum_ovrdval "OCV是能状态标定" VALUE 0xaf011e21 __UBYTE_S 0 NO_COMPU_METHOD 0 255 FORMAT "%.15" /end CHARACTERISTIC
/begin CHARACTERISTIC KbSOC_SmallCurrModDebug_flg "小电流时间标定使能" VALUE 0xaf011e00 __UBYTE_S 0 NO_COMPU_METHOD 0 255 FORMAT "%.15" /end CHARACTERISTIC
/begin CHARACTERISTIC KbSOC_SemiOCVModDebug_flg "准静态时间开关" VALUE 0xaf011dff __UBYTE_S 0 NO_COMPU_METHOD 0 255 FORMAT "%.15" /end CHARACTERISTIC
/begin CHARACTERISTIC KbSOC_SOCRangeDebug_flg "当前温度SOC滤波开关" VALUE 0xaf011dfe __UBYTE_S 0 NO_COMPU_METHOD 0 255 FORMAT "%.15" /end CHARACTERISTIC
/begin CHARACTERISTIC KlSOH_CCPMaxCapErr_Ah "标定小电流积分" VALUE 0xaf0103f0 __ULONG_S 0 NO_COMPU_METHOD 0 255 FORMAT "%.15" /end CHARACTERISTIC
/begin CHARACTERISTIC KlSOH_CCPMaxCapErrSw_flg "使能小电流积分" VALUE 0xaf011e1e __UBYTE_S 0 NO_COMPU_METHOD 0 255 FORMAT "%.15" /end CHARACTERISTIC
/begin CHARACTERISTIC KuSOH_CCPDispSOH_pct "原始SOH标定" VALUE 0xaf01007e __UWORD_S 0 NO_COMPU_METHOD 0 255 FORMAT "%.15" /end CHARACTERISTIC
/begin CHARACTERISTIC KbSOH_CCPDispSOHSw_flg "原始SOH开关" VALUE 0xaf011e02 __UBYTE_S 0 NO_COMPU_METHOD 0 255 FORMAT "%.15" /end CHARACTERISTIC
/begin CHARACTERISTIC KbBCM_BattSocSwitch_flg "液冷SOC标定开关" VALUE 0xaf011d5a __UBYTE_S 0 NO_COMPU_METHOD 0 255 FORMAT "%.15" /end CHARACTERISTIC
/begin CHARACTERISTIC KfBCM_BattSocTest_pct "液冷SOC标定值" VALUE 0xaf011e9e __UBYTE_S 0 NO_COMPU_METHOD 0 255 FORMAT "%.15" /end CHARACTERISTIC
/begin CHARACTERISTIC KbRTC_ChaReTimeSwt_flg "直流充电剩余时间标定开关" VALUE 0xaf011df7 __UBYTE_S 0 NO_COMPU_METHOD 0 255 FORMAT "%.15" /end CHARACTERISTIC
/begin CHARACTERISTIC KuRTC_ChargeRemainTime_min "直流充电剩余时间标定值" VALUE 0xaf0101a4 __UWORD_S 0 NO_COMPU_METHOD 0 255 FORMAT "%.15" /end CHARACTERISTIC
/begin CHARACTERISTIC KbSOC_CHGReTimeDebug_flg "使能充电剩余时间" VALUE 0xaf011df8 __UBYTE_S 0 NO_COMPU_METHOD 0 255 FORMAT "%.15" /end CHARACTERISTIC
/begin CHARACTERISTIC KuSOC_CHGReTime_min "标定充电剩余时间" VALUE 0xaf01036e __ULONG_S 0 NO_COMPU_METHOD 0 255 FORMAT "%.15" /end CHARACTERISTIC
/begin CHARACTERISTIC KbSOC_CVSOCAvlbTi1Debug_flg "使能剩余允许均衡时间1" VALUE 0xaf011df9 __UBYTE_S 0 NO_COMPU_METHOD 0 255 FORMAT "%.15" /end CHARACTERISTIC
/begin CHARACTERISTIC KbSOC_CVSOCAvlbTi2Debug_flg "使能剩余允许均衡时间2" VALUE 0xaf011dfa __UBYTE_S 0 NO_COMPU_METHOD 0 255 FORMAT "%.15" /end CHARACTERISTIC
/begin CHARACTERISTIC KbSOC_DownCurrStaDebug_flg "使能基于时间修正标志位" VALUE 0xaf011dfc __UBYTE_S 0 NO_COMPU_METHOD 0 255 FORMAT "%.15" /end CHARACTERISTIC
/begin CHARACTERISTIC KbSOC_DownCurrSta_flg "标定基于时间修正标志位" VALUE 0xaf011dfd __UBYTE_S 0 NO_COMPU_METHOD 0 255 FORMAT "%.15" /end CHARACTERISTIC
/begin CHARACTERISTIC KbSOC_CrossCurrModDebug_flg "恒流模式开关" VALUE 0xaf011dfb __UBYTE_S 0 NO_COMPU_METHOD 0 255 FORMAT "%.15" /end CHARACTERISTIC
/begin CHARACTERISTIC KbDBGAL_RawSOC_pct_flg "SOC标定开关_TR" VALUE 0xaf011da0 __UBYTE_S 0 NO_COMPU_METHOD 0 255 FORMAT "%.15" /end CHARACTERISTIC
/begin CHARACTERISTIC KbDBGVL_RawSOC_pct "SOC标定值_TR" VALUE 0xaf010038 __UWORD_S 0 NO_COMPU_METHOD 0 255 FORMAT "%.15" /end CHARACTERISTIC
/begin CHARACTERISTIC KbDBGAL_flashstate_flg "BMS刷写标志位开关_TR" VALUE 0xaf011dac __UBYTE_S 0 NO_COMPU_METHOD 0 255 FORMAT "%.15" /end CHARACTERISTIC
/begin CHARACTERISTIC KbDBGVL_flashstate_flg "BMS刷写标志位_TR" VALUE 0xaf011de3 __UWORD_S 0 NO_COMPU_METHOD 0 255 FORMAT "%.15" /end CHARACTERISTIC
/begin CHARACTERISTIC KbCCS_ChaReTimeSwt_flg "快充内部直流充电剩余时间标定开关" VALUE 0xaf011d65 __UBYTE_S 0 NO_COMPU_METHOD 0 255 FORMAT "%.15" /end CHARACTERISTIC
/begin CHARACTERISTIC KuCCS_ChargeRemainTime_min "快充内部直流充电剩余时间标定值" VALUE 0xaf0100c4 __UWORD_S 0 NO_COMPU_METHOD 0 255 FORMAT "%.15" /end CHARACTERISTIC
/begin CHARACTERISTIC KbCCS_MLInPowDnTi_flg "整车断高压静置时间标定开关" VALUE 0xaf011d68 __UBYTE_S 0 NO_COMPU_METHOD 0 255 FORMAT "%.15" /end CHARACTERISTIC
/begin CHARACTERISTIC KuCCS_MLInPowDnTi_min "整车断高压静置时间" VALUE 0xaf010574 __ULONG_S 0 NO_COMPU_METHOD 0 255 FORMAT "%.15" /end CHARACTERISTIC
/begin CHARACTERISTIC KbDBGAL_CellVoltUnderErr_flg "欠压故障开关" VALUE 0xaf011d8e __UBYTE_S 0 NO_COMPU_METHOD 0 255 FORMAT "%.15" /end CHARACTERISTIC
/begin CHARACTERISTIC KbDBGVL_CellVoltUnderErr_flg "欠压故障值" VALUE 0xaf011dbd __UBYTE_S 0 NO_COMPU_METHOD 0 255 FORMAT "%.15" /end CHARACTERISTIC
/begin CHARACTERISTIC KbDBGAL_CellVoltOverErr_flg "单体过压开关" VALUE 0xaf011d8c __UBYTE_S 0 NO_COMPU_METHOD 0 255 FORMAT "%.15" /end CHARACTERISTIC
/begin CHARACTERISTIC KbDBGVL_CellVoltOverErr_flg "单体过压值" VALUE 0xaf011dbb __UBYTE_S 0 NO_COMPU_METHOD 0 255 FORMAT "%.15" /end CHARACTERISTIC
/begin CHARACTERISTIC KbDBGAL_InSumVoltOverErr_flg "总压过压开关" VALUE 0xaf011d96 __UBYTE_S 0 NO_COMPU_METHOD 0 255 FORMAT "%.15" /end CHARACTERISTIC
/begin CHARACTERISTIC KbDBGVL_InSumVoltOverErr_flg "总压过压值" VALUE 0xaf011dcc __UBYTE_S 0 NO_COMPU_METHOD 0 255 FORMAT "%.15" /end CHARACTERISTIC
/begin CHARACTERISTIC KbDBGAL_CellVoltUnbaErr_flg "单体电压不均衡开关" VALUE 0xaf011d8d __UBYTE_S 0 NO_COMPU_METHOD 0 255 FORMAT "%.15" /end CHARACTERISTIC
/begin CHARACTERISTIC KbDBGVL_CellVoltUnbaErr_flg "单体电压不均衡值" VALUE 0xaf011dbc __UBYTE_S 0 NO_COMPU_METHOD 0 255 FORMAT "%.15" /end CHARACTERISTIC
/begin CHARACTERISTIC KbDBGAL_BattExtShrtErr_flg "外部短路开关" VALUE 0xaf011d85 __UBYTE_S 0 NO_COMPU_METHOD 0 255 FORMAT "%.15" /end CHARACTERISTIC
/begin CHARACTERISTIC KbDBGVL_BattExtShrtErr_flg "外部短路值" VALUE 0xaf011db3 __UBYTE_S 0 NO_COMPU_METHOD 0 255 FORMAT "%.15" /end CHARACTERISTIC
/begin CHARACTERISTIC KbDBGAL_BattInShrtErr_flg "内部短路开关" VALUE 0xaf011d86 __UBYTE_S 0 NO_COMPU_METHOD 0 255 FORMAT "%.15" /end CHARACTERISTIC
/begin CHARACTERISTIC KbDBGVL_BattInShrtErr_flg "内部短路值" VALUE 0xaf011db4 __UBYTE_S 0 NO_COMPU_METHOD 0 255 FORMAT "%.15" /end CHARACTERISTIC
/begin CHARACTERISTIC KbDBGAL_TempOverErr_flg "温度过高开关" VALUE 0xaf011da4 __UBYTE_S 0 NO_COMPU_METHOD 0 255 FORMAT "%.15" /end CHARACTERISTIC
/begin CHARACTERISTIC KbDBGVL_TempOverErr_flg "温度过高值" VALUE 0xaf011ddb __UBYTE_S 0 NO_COMPU_METHOD 0 255 FORMAT "%.15" /end CHARACTERISTIC
/begin CHARACTERISTIC KbDBGAL_TempUnbaErr_flg "温度不均衡开关" VALUE 0xaf011da6 __UBYTE_S 0 NO_COMPU_METHOD 0 255 FORMAT "%.15" /end CHARACTERISTIC
/begin CHARACTERISTIC KbDBGVL_TempUnbaErr_flg "温度不均衡值" VALUE 0xaf011ddd __UBYTE_S 0 NO_COMPU_METHOD 0 255 FORMAT "%.15" /end CHARACTERISTIC
/begin CHARACTERISTIC KbDBGAL_TempRiseQuickErr_flg "温升过快开关" VALUE 0xaf011da5 __UBYTE_S 0 NO_COMPU_METHOD 0 255 FORMAT "%.15" /end CHARACTERISTIC
/begin CHARACTERISTIC KbDBGVL_TempRiseQuickErr_flg "温升过快值" VALUE 0xaf011ddc __UBYTE_S 0 NO_COMPU_METHOD 0 255 FORMAT "%.15" /end CHARACTERISTIC
/begin CHARACTERISTIC KbDBGAL_IsoWorstErr_flg "绝缘故障开关" VALUE 0xaf011d9a __UBYTE_S 0 NO_COMPU_METHOD 0 255 FORMAT "%.15" /end CHARACTERISTIC
/begin CHARACTERISTIC KbDBGVL_IsoWorstErr_flg "绝缘故障值" VALUE 0xaf011dcf __UBYTE_S 0 NO_COMPU_METHOD 0 255 FORMAT "%.15" /end CHARACTERISTIC
/begin CHARACTERISTIC KbDBGAL_ChgCurrOverErr_flg "充电电流过高开关" VALUE 0xaf011e64 __UBYTE_S 0 NO_COMPU_METHOD 0 255 FORMAT "%.15" /end CHARACTERISTIC
/begin CHARACTERISTIC KbDBGVL_ChgCurrOverErr_flg "充电电流过高值" VALUE 0xaf011dc0 __UBYTE_S 0 NO_COMPU_METHOD 0 255 FORMAT "%.15" /end CHARACTERISTIC
/begin CHARACTERISTIC KbDBGAL_InterCANErr_flg "内部通讯故障开关" VALUE 0xaf011d99 __UBYTE_S 0 NO_COMPU_METHOD 0 255 FORMAT "%.15" /end CHARACTERISTIC
/begin CHARACTERISTIC KbDBGVL_InterCANErr_flg "内部通讯故障值" VALUE 0xaf011dce __UBYTE_S 0 NO_COMPU_METHOD 0 255 FORMAT "%.15" /end CHARACTERISTIC
/begin CHARACTERISTIC KbDBGAL_ChgCANErr_flg "快充通讯故障开关" VALUE 0xaf011e63 __UBYTE_S 0 NO_COMPU_METHOD 0 255 FORMAT "%.15" /end CHARACTERISTIC
/begin CHARACTERISTIC KbDBGVL_ChgCANErr_flg "快充通讯故障值" VALUE 0xaf011dbf __UBYTE_S 0 NO_COMPU_METHOD 0 255 FORMAT "%.15" /end CHARACTERISTIC
/begin CHARACTERISTIC KbDBGAL_InSumVolErr_flg "内部电压检测故障开关" VALUE 0xaf011d95 __UBYTE_S 0 NO_COMPU_METHOD 0 255 FORMAT "%.15" /end CHARACTERISTIC
/begin CHARACTERISTIC KbDBGVL_InSumVolErr_flg "内部电压检测故障值" VALUE 0xaf011dcb __UBYTE_S 0 NO_COMPU_METHOD 0 255 FORMAT "%.15" /end CHARACTERISTIC
/begin CHARACTERISTIC KbDBGAL_ExtSumVoltErr_flg "外部电压检测故障开关" VALUE 0xaf011d92 __UBYTE_S 0 NO_COMPU_METHOD 0 255 FORMAT "%.15" /end CHARACTERISTIC
/begin CHARACTERISTIC KbDBGVL_ExtSumVoltErr_flg "外部电压检测故障值" VALUE 0xaf011dc2 __UBYTE_S 0 NO_COMPU_METHOD 0 255 FORMAT "%.15" /end CHARACTERISTIC
/begin CHARACTERISTIC KbDBGAL_BMUEEErr_flg "eeprom故障开关" VALUE 0xaf011e60 __UBYTE_S 0 NO_COMPU_METHOD 0 255 FORMAT "%.15" /end CHARACTERISTIC
/begin CHARACTERISTIC KbDBGVL_BMUEEErr_flg "eeprom故障值" VALUE 0xaf011db1 __UBYTE_S 0 NO_COMPU_METHOD 0 255 FORMAT "%.15" /end CHARACTERISTIC
/begin RECORD_LAYOUT __UBYTE_Z FNC_VALUES 1 UBYTE ROW_DIR DIRECT /end RECORD_LAYOUT
/begin RECORD_LAYOUT __UWORD_Z FNC_VALUES 1 UWORD ROW_DIR DIRECT /end RECORD_LAYOUT
/begin RECORD_LAYOUT __ULONG_Z FNC_VALUES 1 ULONG ROW_DIR DIRECT /end RECORD_LAYOUT
/begin RECORD_LAYOUT __SBYTE_Z FNC_VALUES 1 SBYTE ROW_DIR DIRECT /end RECORD_LAYOUT
/begin RECORD_LAYOUT __SWORD_Z FNC_VALUES 1 SWORD ROW_DIR DIRECT /end RECORD_LAYOUT
/begin RECORD_LAYOUT __SLONG_Z FNC_VALUES 1 SLONG ROW_DIR DIRECT /end RECORD_LAYOUT
/begin RECORD_LAYOUT __FLOAT32_IEEE_Z FNC_VALUES 1 FLOAT32_IEEE ROW_DIR DIRECT /end RECORD_LAYOUT
/begin RECORD_LAYOUT __FLOAT64_IEEE_Z FNC_VALUES 1 FLOAT64_IEEE ROW_DIR DIRECT /end RECORD_LAYOUT
/begin RECORD_LAYOUT __UBYTE_S FNC_VALUES 1 UBYTE COLUMN_DIR DIRECT /end RECORD_LAYOUT
/begin RECORD_LAYOUT __UWORD_S FNC_VALUES 1 UWORD COLUMN_DIR DIRECT /end RECORD_LAYOUT
/begin RECORD_LAYOUT __ULONG_S FNC_VALUES 1 ULONG COLUMN_DIR DIRECT /end RECORD_LAYOUT
/begin RECORD_LAYOUT __SBYTE_S FNC_VALUES 1 SBYTE COLUMN_DIR DIRECT /end RECORD_LAYOUT
/begin RECORD_LAYOUT __SWORD_S FNC_VALUES 1 SWORD COLUMN_DIR DIRECT /end RECORD_LAYOUT
/begin RECORD_LAYOUT __SLONG_S FNC_VALUES 1 SLONG COLUMN_DIR DIRECT /end RECORD_LAYOUT
/begin RECORD_LAYOUT __FLOAT32_IEEE_S FNC_VALUES 1 FLOAT32_IEEE COLUMN_DIR DIRECT /end RECORD_LAYOUT
/begin RECORD_LAYOUT __FLOAT64_IEEE_S FNC_VALUES 1 FLOAT64_IEEE COLUMN_DIR DIRECT /end RECORD_LAYOUT
/begin RECORD_LAYOUT SSV__UBYTE_S AXIS_PTS_X 1 UBYTE INDEX_INCR DIRECT /end RECORD_LAYOUT
/begin RECORD_LAYOUT SSV__UWORD_S AXIS_PTS_X 1 UWORD INDEX_INCR DIRECT /end RECORD_LAYOUT
/begin RECORD_LAYOUT SSV__ULONG_S AXIS_PTS_X 1 ULONG INDEX_INCR DIRECT /end RECORD_LAYOUT
/begin RECORD_LAYOUT SSV__SBYTE_S AXIS_PTS_X 1 SBYTE INDEX_INCR DIRECT /end RECORD_LAYOUT
/begin RECORD_LAYOUT SSV__SWORD_S AXIS_PTS_X 1 SWORD INDEX_INCR DIRECT /end RECORD_LAYOUT
/begin RECORD_LAYOUT SSV__SLONG_S AXIS_PTS_X 1 SLONG INDEX_INCR DIRECT /end RECORD_LAYOUT
/begin RECORD_LAYOUT SSV__FLOAT32_IEEE_S AXIS_PTS_X 1 FLOAT32_IEEE INDEX_INCR DIRECT /end RECORD_LAYOUT
/begin RECORD_LAYOUT SSV__FLOAT64_IEEE_S AXIS_PTS_X 1 FLOAT64_IEEE INDEX_INCR DIRECT /end RECORD_LAYOUT
/begin RECORD_LAYOUT __A_UINT64_Z FNC_VALUES 1 A_UINT64 ROW_DIR DIRECT /end RECORD_LAYOUT
/begin RECORD_LAYOUT __A_INT64_Z FNC_VALUES 1 A_INT64 ROW_DIR DIRECT /end RECORD_LAYOUT
/begin RECORD_LAYOUT __A_UINT64_S FNC_VALUES 1 A_UINT64 COLUMN_DIR DIRECT /end RECORD_LAYOUT
/begin RECORD_LAYOUT __A_INT64_S FNC_VALUES 1 A_INT64 COLUMN_DIR DIRECT /end RECORD_LAYOUT
/begin RECORD_LAYOUT SSV__A_UINT64_S AXIS_PTS_X 1 A_UINT64 INDEX_INCR DIRECT /end RECORD_LAYOUT
/begin RECORD_LAYOUT SSV__A_INT64_S AXIS_PTS_X 1 A_INT64 INDEX_INCR DIRECT /end RECORD_LAYOUT
/end MODULE
/end PROJECT
